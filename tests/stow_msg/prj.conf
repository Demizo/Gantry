## CMakeLists.txt
```
cmake_minimum_required(VERSION 3.20.0)

find_package(Zephyr REQUIRED HINTS $ENV{ZEPHYR_BASE})
project(stow_msg_test)

set(GANTRY_ROOT ${CMAKE_CURRENT_SOURCE_DIR}/../..)
set(GANTRY_LIB ${GANTRY_ROOT}/lib)
set(GANTRY_INC ${GANTRY_ROOT}/include)

# The fixture's generated items give the test resolver its codecs, and Describe Responses their items
gantry_stow_generate(YAML ${GANTRY_ROOT}/protocols/stow/stow.yaml APP_DIR ${GANTRY_ROOT}/protocols/stow)

target_sources(app PRIVATE
    src/test_common.c
    src/test_stow_msg.c
    src/test_stow_msg_vectors.c
    ${GANTRY_LIB}/memory.c
    ${GANTRY_LIB}/stow/stow_msg.c
    ${GANTRY_LIB}/stow/types/stow_type_enum.c
    ${GANTRY_LIB}/stow/types/stow_type_int.c
    ${GANTRY_LIB}/stow/types/stow_type_float.c
    ${GANTRY_LIB}/stow/types/stow_type_string.c
    ${GANTRY_LIB}/stow/types/stow_type_byte_array.c
    ${GANTRY_LIB}/stow/types/stow_type_buffer.c
)

target_include_directories(app PRIVATE
    ${GANTRY_INC}
    ${GANTRY_ROOT}/tests/common
)

gantry_protocol_vectors(app ${GANTRY_ROOT}/protocols/stow stow)
```

## prj.conf
```kconfig
CONFIG_MEM_POOL_COUNT=3
CONFIG_MEM_POOL1_BLOCK_SIZE=64
CONFIG_MEM_POOL1_BLOCK_COUNT=32
CONFIG_MEM_POOL2_BLOCK_SIZE=256
CONFIG_MEM_POOL2_BLOCK_COUNT=16
CONFIG_MEM_POOL3_BLOCK_SIZE=1024
CONFIG_MEM_POOL3_BLOCK_COUNT=4

CONFIG_ZCBOR=y
```

## src/test_common.c
```c
/*
 * Copyright (c) 2026 Demizo
 *
 * SPDX-License-Identifier: Apache-2.0
 */

#include "test_common.h"

#include <gantry/error.h>
#include <sys/errno.h>

static int resolve(const struct stow_msg_items* items, struct stow_msg_entry* entry)
{
    ARG_UNUSED(items);
    if (entry->id >= STOW_ID_COUNT)
    {
        return -ENOENT;
    }
    entry->local = (uint16_t)entry->id;
    entry->codec = g_stow_const_metadata[entry->id].interface;
    return SUCCESS;
}

const struct stow_msg_items test_items = { .resolve = resolve };
```

## src/test_common.h
```c
/*
 * Copyright (c) 2026 Demizo
 *
 * SPDX-License-Identifier: Apache-2.0
 */

#pragma once

#include <gantry/stow/stow_msg.h>
#include <generated_stow_items.h>
#include <zephyr/ztest.h>

/**
 * @brief Resolver of the fixture's items, whose wire IDs are their fixture IDs
 */
extern const struct stow_msg_items test_items;
```

## src/test_stow_msg.c
```c
/*
 * Copyright (c) 2026 Demizo
 *
 * SPDX-License-Identifier: Apache-2.0
 */

#include <gantry/stow/types/stow_types.h>
#include <string.h>

#include "test_common.h"

ZTEST_SUITE(stow_msg, NULL, NULL, NULL, NULL, NULL);

static const struct stow_item_const_metadata* item(enum stow_item_id id) { return &g_stow_const_metadata[id]; }

static struct stow_msg_entry int_entry(uint32_t id, int value)
{
    return (struct stow_msg_entry){
        .id = id,
        .codec = item(STOW_ID_TEST_INT)->interface,
        .value = { .type = STOW_ITEM_TYPE_INT, .data.int_value = value },
    };
}

static size_t finish(struct stow_msg_writer* writer)
{
    size_t len = 0;
    zassert_ok(stow_msg_finish(writer, &len));
    return len;
}

/**
 * @brief Find the smallest budget a Describe Response holding only @p described fits
 */
static size_t smallest_budget(const struct stow_item_const_metadata* described, uint8_t* out)
{
    for (size_t budget = 0;; budget++)
    {
        struct stow_msg_writer writer;
        stow_msg_writer_init(&writer, out, budget);
        (void)stow_msg_write(&writer, &(struct stow_msg){ .code = STOW_MSG_DESCRIBE_RESPONSE, .tag = 1 });
        if (stow_msg_put_description(&writer, described) == 0)
        {
            return budget;
        }
    }
}

ZTEST(stow_msg, test_an_error_replaces_a_partly_written_get_response)
{
    uint8_t out[64];
    struct stow_msg_writer writer;
    stow_msg_writer_init(&writer, out, sizeof(out));
    zassert_ok(stow_msg_write(&writer, &(struct stow_msg){ .code = STOW_MSG_GET_RESPONSE, .tag = 5, .count = 2 }));
    struct stow_msg_entry first = int_entry(STOW_ID_TEST_INT, 7);
    zassert_ok(stow_msg_put_entry(&writer, &first));

    struct stow_msg error = { .code = STOW_MSG_ERROR, .tag = 5, .error = { -EACCES, STOW_ID_TEST_STRING, 1 } };
    zassert_ok(stow_msg_write(&writer, &error));

    const uint8_t expected[] = { 0x85, STOW_MSG_ERROR, 5, STOW_ERR_PERMISSION_DENIED, STOW_ID_TEST_STRING, 1 };
    zassert_equal(finish(&writer), sizeof(expected));
    zassert_mem_equal(out, expected, sizeof(expected));
}

ZTEST(stow_msg, test_the_first_error_sticks_until_the_next_message)
{
    uint8_t out[8];
    struct stow_msg_writer writer;
    stow_msg_writer_init(&writer, out, 6); /* one entry fits, a second does not */
    zassert_ok(stow_msg_write(&writer, &(struct stow_msg){ .code = STOW_MSG_GET_RESPONSE, .tag = 1, .count = 3 }));
    struct stow_msg_entry entry = int_entry(STOW_ID_TEST_INT, 7);
    zassert_ok(stow_msg_put_entry(&writer, &entry));
    zassert_equal(stow_msg_put_entry(&writer, &entry), -E2BIG);
    zassert_equal(stow_msg_put_entry(&writer, &entry), -E2BIG);

    size_t len = 0;
    zassert_equal(stow_msg_finish(&writer, &len), -E2BIG);
    zassert_ok(stow_msg_write(&writer, &(struct stow_msg){ .code = STOW_MSG_OK, .tag = 1 }));
    zassert_equal(finish(&writer), 3);
}

ZTEST(stow_msg, test_an_entry_that_does_not_fit_is_too_large)
{
    uint8_t out[16];
    struct stow_msg_writer writer;
    stow_msg_writer_init(&writer, out, sizeof(out));
    zassert_ok(stow_msg_write(&writer, &(struct stow_msg){ .code = STOW_MSG_GET_RESPONSE, .tag = 1, .count = 1 }));
    struct stow_msg_entry entry = {
        .id = STOW_ID_TEST_STRING,
        .codec = item(STOW_ID_TEST_STRING)->interface,
        .value = { .type = STOW_ITEM_TYPE_STRING, .data.string_value = "longer than sixteen bytes" },
    };
    zassert_equal(stow_msg_put_entry(&writer, &entry), -E2BIG);
}

ZTEST(stow_msg, test_a_description_that_does_not_fit_is_rolled_back_and_becomes_next)
{
    uint8_t out[512];
    size_t budget = smallest_budget(item(STOW_ID_TEST_INT), out);

    struct stow_msg_writer writer;
    stow_msg_writer_init(&writer, out, budget);
    zassert_ok(stow_msg_write(&writer, &(struct stow_msg){ .code = STOW_MSG_DESCRIBE_RESPONSE, .tag = 1 }));
    zassert_ok(stow_msg_put_description(&writer, item(STOW_ID_TEST_INT)));
    zassert_equal(stow_msg_put_description(&writer, item(STOW_ID_TEST_STRING)), -E2BIG);
    zassert_equal(
        stow_msg_put_description(&writer, item(STOW_ID_TEST_ENUM)), -E2BIG, "a later put fit after a rejection");
    size_t len = finish(&writer);

    struct stow_msg_reader reader;
    struct stow_msg msg;
    zassert_ok(stow_msg_read(&reader, out, len, &test_items, &msg));
    zassert_equal(msg.count, 1);
    zassert_equal(msg.describe_response.next, STOW_ID_TEST_STRING);
    struct stow_msg_description description;
    zassert_ok(stow_msg_next_description(&reader, &description));
    zassert_equal(description.id, STOW_ID_TEST_INT);
}

ZTEST(stow_msg, test_next_is_null_when_no_description_is_rejected)
{
    uint8_t out[512];
    struct stow_msg_writer writer;
    stow_msg_writer_init(&writer, out, sizeof(out));
    zassert_ok(stow_msg_write(&writer, &(struct stow_msg){ .code = STOW_MSG_DESCRIBE_RESPONSE, .tag = 1 }));
    zassert_ok(stow_msg_put_description(&writer, item(STOW_ID_TEST_INT)));
    zassert_ok(stow_msg_put_description(&writer, item(STOW_ID_TEST_STRING)));
    size_t len = finish(&writer);

    struct stow_msg_reader reader;
    struct stow_msg msg;
    zassert_ok(stow_msg_read(&reader, out, len, &test_items, &msg));
    zassert_equal(msg.count, 2);
    zassert_equal(msg.describe_response.next, STOW_MSG_ABSENT);
}

ZTEST(stow_msg, test_an_empty_describe_response_is_valid)
{
    uint8_t out[16];
    struct stow_msg_writer writer;
    stow_msg_writer_init(&writer, out, sizeof(out));
    zassert_ok(stow_msg_write(&writer, &(struct stow_msg){ .code = STOW_MSG_DESCRIBE_RESPONSE, .tag = 4 }));

    const uint8_t expected[] = { 0x84, STOW_MSG_DESCRIBE_RESPONSE, 4, 0xF6, 0x40 }; /* [3, 4, null, h''] */
    zassert_equal(finish(&writer), sizeof(expected));
    zassert_mem_equal(out, expected, sizeof(expected));
}

ZTEST(stow_msg, test_a_list_whose_first_element_is_rejected_is_too_large)
{
    uint8_t out[512];
    size_t budget = smallest_budget(item(STOW_ID_TEST_INT), out) - 1;

    struct stow_msg_writer writer;
    stow_msg_writer_init(&writer, out, budget);
    zassert_ok(stow_msg_write(&writer, &(struct stow_msg){ .code = STOW_MSG_DESCRIBE_RESPONSE, .tag = 1 }));
    zassert_equal(stow_msg_put_description(&writer, item(STOW_ID_TEST_INT)), -E2BIG);
    size_t len = 0;
    zassert_equal(stow_msg_finish(&writer, &len), -E2BIG);
}

ZTEST(stow_msg, test_a_group_of_names_that_fits_fits_from_any_start)
{
    static const char* const names[] = { "TestInt", "TestString", "TestSessionInt", "TestDevInt", "TestBuffer" };
    uint8_t out[40];
    struct stow_msg_writer writer;
    stow_msg_writer_init(&writer, out, sizeof(out));
    zassert_ok(stow_msg_write(
        &writer, &(struct stow_msg){ .code = STOW_MSG_DESCRIBE, .tag = 1, .describe = { .start = 0, .named = true } }));
    size_t fit = 0;
    while (fit < ARRAY_SIZE(names) && stow_msg_put_name(&writer, names[fit]) == 0)
    {
        fit++;
    }
    zassert_true(fit > 0 && fit < ARRAY_SIZE(names), "the budget should split the names");

    zassert_ok(stow_msg_write(
        &writer, &(struct stow_msg){ .code = STOW_MSG_DESCRIBE,
                                     .tag = STOW_TAG_MAX,
                                     .describe = { .start = UINT32_MAX - 1U, .named = true } }));
    for (size_t i = 0; i < fit; i++)
    {
        zassert_ok(stow_msg_put_name(&writer, names[i]));
    }
    zassert_true(finish(&writer) <= sizeof(out));
}

ZTEST(stow_msg, test_a_hello_response_reports_the_writers_budget)
{
    uint8_t out[128];
    struct stow_msg_writer writer;
    stow_msg_writer_init(&writer, out, 100);
    struct stow_msg hello = {
        .code = STOW_MSG_HELLO_RESPONSE,
        .tag = 2,
        .hello = {
            .max_message = 9999,
            .stow_hash = { .value = (const uint8_t*)"hash", .len = 4 },
            .roles = 1,
            .role_names = g_stow_role_names,
            .role_count = STOW_ROLE_COUNT,
        },
    };
    zassert_ok(stow_msg_write(&writer, &hello));
    size_t len = finish(&writer);

    struct stow_msg_reader reader;
    struct stow_msg msg;
    zassert_ok(stow_msg_read(&reader, out, len, &test_items, &msg));
    zassert_equal(msg.hello.max_message, 100);
    zassert_equal(msg.hello.roles, 1);
    zassert_equal(msg.hello.stow_hash.len, 4);
}

ZTEST(stow_msg, test_unknown_items_pass_the_read_and_are_reported_by_the_walk)
{
    const uint8_t set[] = { 0x84, STOW_MSG_SET, 1, 0x18, 99, 5 };                /* [6, 1, 99, 5] */
    const uint8_t get[] = { 0x84, STOW_MSG_GET, 1, STOW_ID_TEST_INT, 0x18, 99 }; /* [4, 1, 1, 99] */

    struct stow_msg_reader reader;
    struct stow_msg msg;
    struct stow_msg_entry entry;
    zassert_ok(stow_msg_read(&reader, set, sizeof(set), &test_items, &msg));
    zassert_equal(msg.count, 1);
    zassert_equal(stow_msg_next_entry(&reader, &entry), -ENOENT);
    zassert_equal(entry.id, 99);

    zassert_ok(stow_msg_read(&reader, get, sizeof(get), &test_items, &msg));
    zassert_equal(msg.count, 2);
    zassert_ok(stow_msg_next_entry(&reader, &entry));
    zassert_equal(entry.local, STOW_ID_TEST_INT);
    stow_msg_entry_release(&entry);
    zassert_equal(stow_msg_next_entry(&reader, &entry), -ENOENT);
}

ZTEST(stow_msg, test_unknown_hello_keys_are_skipped)
{
    /* [1, 0, 1, {0: 200, 1: "h", 2: 1, 3: ["Guest"], 9: "later"}] */
    const uint8_t hello[] = { 0x84, STOW_MSG_HELLO_RESPONSE,
                              0,    STOW_PROTOCOL_VERSION,
                              0xA5, 0x00,
                              0x18, 200,
                              0x01, 0x61,
                              'h',  0x02,
                              0x01, 0x03,
                              0x81, 0x65,
                              'G',  'u',
                              'e',  's',
                              't',  0x09,
                              0x65, 'l',
                              'a',  't',
                              'e',  'r' };
    struct stow_msg_reader reader;
    struct stow_msg msg;
    zassert_ok(stow_msg_read(&reader, hello, sizeof(hello), &test_items, &msg));
    zassert_equal(msg.hello.max_message, 200);
    zassert_equal(msg.hello.roles, 1);
}

ZTEST(stow_msg, test_an_update_with_a_tag_is_malformed_without_a_tag)
{
    const uint8_t update[] = { 0x84, STOW_MSG_UPDATE, 5, STOW_ID_TEST_INT, 42 }; /* [9, 5, 1, 42] */
    struct stow_msg_reader reader;
    struct stow_msg msg;
    zassert_equal(stow_msg_read(&reader, update, sizeof(update), &test_items, &msg), -EBADMSG);
    zassert_equal(msg.tag, STOW_TAG_NONE);
}

ZTEST(stow_msg, test_each_errno_travels_as_its_error_code)
{
    static const struct
    {
        int err;
        uint8_t code;
    } errnos[] = {
        { -EBADMSG, STOW_ERR_MALFORMED_MSG },    { -EPROTO, STOW_ERR_UNKNOWN_MSG },
        { -ENOENT, STOW_ERR_INVALID_ITEM },      { -ENOMEM, STOW_ERR_OUT_OF_MEMORY },
        { -EACCES, STOW_ERR_PERMISSION_DENIED }, { -EINVAL, STOW_ERR_INVALID_VALUE },
        { -EALREADY, STOW_ERR_ALREADY_SET },     { -E2BIG, STOW_ERR_TOO_LARGE },
    };
    for (size_t i = 0; i < ARRAY_SIZE(errnos); i++)
    {
        uint8_t out[8];
        struct stow_msg_writer writer;
        stow_msg_writer_init(&writer, out, sizeof(out));
        struct stow_msg error = { .code = STOW_MSG_ERROR,
                                  .tag = 1,
                                  .error = { errnos[i].err, STOW_MSG_ABSENT, STOW_MSG_ABSENT } };
        zassert_ok(stow_msg_write(&writer, &error));
        size_t len = finish(&writer);
        zassert_equal(out[3], errnos[i].code);

        struct stow_msg_reader reader;
        struct stow_msg msg;
        zassert_ok(stow_msg_read(&reader, out, len, &test_items, &msg));
        zassert_equal(msg.error.err, errnos[i].err);
    }
}

ZTEST(stow_msg, test_other_errnos_and_codes_are_unknown)
{
    uint8_t out[8];
    struct stow_msg_writer writer;
    stow_msg_writer_init(&writer, out, sizeof(out));
    zassert_ok(stow_msg_write(
        &writer, &(struct stow_msg){
                     .code = STOW_MSG_ERROR, .tag = 1, .error = { -ETIMEDOUT, STOW_MSG_ABSENT, STOW_MSG_ABSENT } }));
    size_t len = finish(&writer);
    zassert_equal(out[3], STOW_ERR_UNKNOWN);

    struct stow_msg_reader reader;
    struct stow_msg msg;
    zassert_ok(stow_msg_read(&reader, out, len, &test_items, &msg));
    zassert_equal(msg.error.err, -EIO);

    const uint8_t later[] = { 0x83, STOW_MSG_ERROR, 1, 0x18, 42 }; /* [11, 1, 42] */
    zassert_ok(stow_msg_read(&reader, later, sizeof(later), &test_items, &msg));
    zassert_equal(msg.error.err, -EIO);
}

ZTEST(stow_msg, test_constraints_nested_deeper_than_this_side_decodes_are_read)
{
    /* [3, 1, null, <<{0: 1, 1: "X", 6: 1, 8: [[...0...]]}>>], the constraints STOW_DEPTH_MAX + 3 lists deep */
    const size_t depth = STOW_DEPTH_MAX + 3;
    const size_t description_len = 10 + depth;
    uint8_t response[64] = { 0x84,
                             STOW_MSG_DESCRIBE_RESPONSE,
                             1,
                             0xF6,
                             (uint8_t)(0x40 | description_len),
                             0xA4,
                             0x00,
                             0x01,
                             0x01,
                             0x61,
                             'X',
                             0x06,
                             0x01,
                             0x08 };
    zassert_true(description_len < 24 && 14 + depth + 1 <= sizeof(response));
    memset(&response[14], 0x81, depth);
    response[14 + depth] = 0x00;

    struct stow_msg_reader reader;
    struct stow_msg msg;
    zassert_ok(stow_msg_read(&reader, response, 15 + depth, &test_items, &msg));
    zassert_equal(msg.count, 1);
    struct stow_msg_description description;
    zassert_ok(stow_msg_next_description(&reader, &description));
    zassert_equal(description.constraints.len, depth + 1);
}
```

## src/test_stow_msg_vectors.c
```c
/*
 * Copyright (c) 2026 Demizo
 *
 * SPDX-License-Identifier: Apache-2.0
 */

#include <gantry/error.h>
#include <protocol_vector_print.h>
#include <stow_vectors.h>
#include <string.h>

#include "test_common.h"

/**
 * @brief Largest message written back; a vector's message is never longer than its Hello's max_message
 */
#define OUT_SIZE 512

/**
 * @brief Index of the client in stow_sides
 */
#define CLIENT_SIDE 0

/**
 * @brief The budget the vectors were recorded with, from their first Hello Response
 */
static size_t budget;

static void* setup(void)
{
    for (size_t vector_index = 0; budget == 0 && vector_index < stow_exchanges_count; vector_index++)
    {
        for (size_t step_index = 0; step_index < stow_exchanges[vector_index]->step_count; step_index++)
        {
            const struct protocol_step* step = &stow_exchanges[vector_index]->steps[step_index];
            struct stow_msg_reader reader;
            struct stow_msg msg;
            if (stow_msg_read(&reader, step->data, step->len, &test_items, &msg) == 0 &&
                msg.code == STOW_MSG_HELLO_RESPONSE)
            {
                budget = msg.hello.max_message;
                break;
            }
        }
    }
    zassert_true(budget > 0 && budget <= OUT_SIZE, "No Hello Response gives the vectors' budget");
    return NULL;
}

ZTEST_SUITE(stow_msg_vectors, NULL, setup, NULL, NULL, NULL);

/**
 * @brief Write a message back from what was read, walking its list
 *
 * @return SUCCESS, or -ENOENT when an entry names an item the fixture lacks, whose value cannot be written
 */
static int write_back(struct stow_msg_reader* reader, const struct stow_msg* msg, uint8_t* out, size_t* len)
{
    struct stow_msg written = *msg;
    if (msg->code == STOW_MSG_HELLO_RESPONSE)
    {
        written.hello.role_names = g_stow_role_names;
        written.hello.role_count = STOW_ROLE_COUNT;
    }

    struct stow_msg_writer writer;
    stow_msg_writer_init(&writer, out, budget);
    zassert_ok(stow_msg_write(&writer, &written));

    if (msg->code == STOW_MSG_DESCRIBE && msg->describe.named)
    {
        for (uint16_t i = 0; i < msg->count; i++)
        {
            struct zcbor_string name;
            char text[64] = { 0 };
            zassert_ok(stow_msg_next_name(reader, &name));
            zassert_true(name.len < sizeof(text));
            memcpy(text, name.value, name.len);
            zassert_ok(stow_msg_put_name(&writer, text));
        }
    }
    else if (msg->code == STOW_MSG_DESCRIBE_RESPONSE)
    {
        for (uint16_t i = 0; i < msg->count; i++)
        {
            struct stow_msg_description description;
            zassert_ok(stow_msg_next_description(reader, &description));
            zassert_ok(stow_msg_put_description(&writer, &g_stow_const_metadata[description.id]));
        }
        if (msg->describe_response.next != STOW_MSG_ABSENT)
        {
            zassert_equal(
                stow_msg_put_description(&writer, &g_stow_const_metadata[msg->describe_response.next]), -E2BIG);
        }
    }
    else
    {
        for (uint16_t i = 0; i < msg->count; i++)
        {
            struct stow_msg_entry entry;
            int ret = stow_msg_next_entry(reader, &entry);
            if (ret == -ENOENT)
            {
                return ret;
            }
            zassert_ok(ret);
            zassert_ok(stow_msg_put_entry(&writer, &entry));
            stow_msg_entry_release(&entry);
        }
    }

    zassert_ok(stow_msg_finish(&writer, len));
    return SUCCESS;
}

/**
 * @brief Check that written bytes are a step's, printing them in hex for `protocol-spec diag` when they aren't
 */
static void expect_step(const struct protocol_vector* vector, size_t index, const uint8_t* out, size_t len)
{
    const struct protocol_step* step = &vector->steps[index];
    bool same = len == step->len && memcmp(out, step->data, len) == 0;
    if (!same)
    {
        protocol_vector_print_hex("wrote", out, len);
    }
    zassert_true(same, "%s.steps[%zu]: expected %s", vector->name, index, step->edn);
}

/**
 * @brief Check that the step after a request this side failed to read is the Error written from the failure
 */
static void check_failure_answered(
    const struct protocol_vector* vector, size_t index, int ret, const struct stow_msg* failed)
{
    zassert_true(index + 1 < vector->step_count, "%s.steps[%zu]: failed with %d, unanswered", vector->name, index, ret);
    const struct protocol_step* answer = &vector->steps[index + 1];

    struct stow_msg_reader reader;
    struct stow_msg error;
    zassert_ok(
        stow_msg_read(&reader, answer->data, answer->len, &test_items, &error), "%s: %s", vector->name, answer->edn);
    zassert_equal(error.code, STOW_MSG_ERROR, "%s: %s", vector->name, answer->edn);
    zassert_equal(error.error.err, ret, "%s: %s", vector->name, answer->edn);

    uint8_t out[OUT_SIZE];
    struct stow_msg_writer writer;
    stow_msg_writer_init(&writer, out, budget);
    zassert_ok(stow_msg_write(
        &writer, &(struct stow_msg){ .code = STOW_MSG_ERROR, .tag = failed->tag, .error = failed->error }));
    size_t len = 0;
    zassert_ok(stow_msg_finish(&writer, &len));
    expect_step(vector, index + 1, out, len);
}

/**
 * @brief Check that a step reads and writes back to the same bytes, or fails to read with the Error that answers it
 *
 * @return NULL, or why the step does not apply to the codec
 */
static const char* check_step(const struct protocol_vector* vector, size_t index)
{
    const struct protocol_step* step = &vector->steps[index];
    struct stow_msg_reader reader;
    struct stow_msg msg;
    int ret = stow_msg_read(&reader, step->data, step->len, &test_items, &msg);
    if (ret != 0 && step->side == CLIENT_SIDE)
    {
        check_failure_answered(vector, index, ret, &msg);
        return NULL;
    }
    zassert_ok(ret, "%s.steps[%zu]: %s", vector->name, index, step->edn);

    uint8_t out[OUT_SIZE];
    size_t len = 0;
    if (write_back(&reader, &msg, out, &len) == -ENOENT)
    {
        return "an entry names an item the fixture lacks, whose value can't be written";
    }
    expect_step(vector, index, out, len);
    return NULL;
}

/**
 * @brief Check that a malformed vector's request fails to read with the Error that answers it
 *
 * @return NULL, or why the request does not apply to the codec
 */
static const char* check_malformed_request(const struct protocol_vector* vector)
{
    const struct protocol_step* request = &vector->steps[0];
    uint32_t code = STOW_MSG_ABSENT;
    uint8_t tag = STOW_TAG_NONE;
    (void)stow_msg_peek(request->data, request->len, &code, &tag);
    if (code < STOW_MSG_COUNT && !stow_msg_is_request(code))
    {
        return "the server answers a message that isn't a request from its code and tag alone";
    }

    struct stow_msg_reader reader;
    struct stow_msg failed;
    int ret = stow_msg_read(&reader, request->data, request->len, &test_items, &failed);
    zassert_not_equal(ret, 0, "%s: the request was read", vector->name);
    check_failure_answered(vector, 0, ret, &failed);
    return NULL;
}

/**
 * @brief Log why a step does not apply to the codec
 *
 * @return Whether the step was skipped
 */
static bool skipped(const struct protocol_vector* vector, size_t index, const char* reason)
{
    if (reason != NULL)
    {
        TC_PRINT("%s.steps[%zu] skipped: %s\n", vector->name, index, reason);
    }
    return reason != NULL;
}

/**
 * @brief Check every step from @p first on, then skip the test if any step did not apply, so a skip never hides a
 * failure
 *
 * @param earlier_skipped Whether a step before @p first did not apply
 */
static void check_steps(const struct protocol_vector* vector, size_t first, bool earlier_skipped)
{
    bool any_skipped = earlier_skipped;
    for (size_t i = first; i < vector->step_count; i++)
    {
        any_skipped |= skipped(vector, i, check_step(vector, i));
    }
    if (any_skipped)
    {
        ztest_test_skip();
    }
}

/**
 * @brief Check an exchange
 */
static void check(const struct protocol_vector* vector) { check_steps(vector, 0, false); }

/**
 * @brief Check a malformed vector, whose request fails to read with the Error that answers it
 */
static void check_malformed(const struct protocol_vector* vector)
{
    check_steps(vector, 1, skipped(vector, 0, check_malformed_request(vector)));
}

#define CHECK(name) \
    ZTEST(stow_msg_vectors, test_##name) { check(&stow_vector_##name); }

#define CHECK_MALFORMED(name) \
    ZTEST(stow_msg_vectors, test_##name) { check_malformed(&stow_vector_##name); }

STOW_EXCHANGES(CHECK)
STOW_MALFORMED(CHECK_MALFORMED)
```

## CMakeLists.txt
```
cmake_minimum_required(VERSION 3.20.0)

find_package(Zephyr REQUIRED HINTS $ENV{ZEPHYR_BASE})
project(stow_test)

set(GANTRY_ROOT ${CMAKE_CURRENT_SOURCE_DIR}/../..)
set(GANTRY_LIB ${GANTRY_ROOT}/lib)
set(GANTRY_INC ${GANTRY_ROOT}/include)

gantry_stow_generate(YAML stow.yaml)

target_sources(app PRIVATE
    src/test_stow_int.c
    src/test_stow_float.c
    src/test_stow_enum.c
    src/test_stow_string.c
    src/test_stow_byte_array.c
    src/test_stow_buffer.c
    src/test_stow_access.c
    src/test_stow_subscribe.c
    src/test_stow_static_subscribe.c
    src/test_stow_struct.c
    src/test_stow_nested_struct.c
    src/test_stow_custom.c
    src/test_stow_isr.c
    src/test_stow_concurrency.c
    src/test_stow_watermark.c
    src/test_stow_persistence.c
    src/stow_storage_stub.c
    ${GANTRY_LIB}/memory.c
    ${GANTRY_LIB}/event.c
    ${GANTRY_LIB}/stow/stow.c
    ${GANTRY_LIB}/stow/stow_event.c
    ${GANTRY_LIB}/stow/types/stow_type_enum.c
    ${GANTRY_LIB}/stow/types/stow_type_int.c
    ${GANTRY_LIB}/stow/types/stow_type_float.c
    ${GANTRY_LIB}/stow/types/stow_type_string.c
    ${GANTRY_LIB}/stow/types/stow_type_byte_array.c
    ${GANTRY_LIB}/stow/types/stow_type_buffer.c
)

target_include_directories(app PRIVATE
    ${GANTRY_INC}
)
```

## prj.conf
```kconfig
CONFIG_GANTRY_MEMORY=y
CONFIG_MEM_WATERMARK=y
CONFIG_MEM_POOL_COUNT=3
CONFIG_MEM_POOL1_BLOCK_SIZE=64
CONFIG_MEM_POOL1_BLOCK_COUNT=16
CONFIG_MEM_POOL2_BLOCK_SIZE=256
CONFIG_MEM_POOL2_BLOCK_COUNT=8
CONFIG_MEM_POOL3_BLOCK_SIZE=1024
CONFIG_MEM_POOL3_BLOCK_COUNT=4

CONFIG_GANTRY_EVENTS=y
CONFIG_GANTRY_STOW=y
CONFIG_ZCBOR=y
CONFIG_STOW_STORAGE_FLUSH_DELAY_MS=50

CONFIG_IRQ_OFFLOAD=y
```

## src/stow_storage_stub.c
```c
/*
 * Copyright (c) 2026 Demizo
 *
 * SPDX-License-Identifier: Apache-2.0
 */

#include "stow_storage_stub.h"

#include <gantry/error.h>
#include <gantry/stow/stow_storage.h>
#include <zephyr/sys/util.h>

struct stow_storage_stub g_stow_storage_stub;

int stow_storage_load(void) { return SUCCESS; }

int stow_storage_save_item(const struct stow_item_const_metadata* item)
{
    if (g_stow_storage_stub.save_count < STOW_STORAGE_STUB_MAX_SAVES)
    {
        g_stow_storage_stub.saved_ids[g_stow_storage_stub.save_count] = item->id;
    }
    g_stow_storage_stub.save_count++;

    // Stands in for a write landing while the real backend is busy in flash.
    void (*hook)(void) = g_stow_storage_stub.during_save;
    if (hook != NULL)
    {
        g_stow_storage_stub.during_save = NULL;
        hook();
    }

    int result = g_stow_storage_stub.next_save_result;
    g_stow_storage_stub.next_save_result = SUCCESS;
    return result;
}

void stow_storage_stub_reset(void) { g_stow_storage_stub = (struct stow_storage_stub){ 0 }; }

int stow_storage_stub_item_save_count(enum stow_item_id id)
{
    int count = 0;
    int recorded = MIN(g_stow_storage_stub.save_count, STOW_STORAGE_STUB_MAX_SAVES);

    for (int i = 0; i < recorded; i++)
    {
        if (g_stow_storage_stub.saved_ids[i] == (uint32_t)id)
        {
            count++;
        }
    }

    return count;
}
```

## src/stow_storage_stub.h
```c
/*
 * Copyright (c) 2026 Demizo
 *
 * SPDX-License-Identifier: Apache-2.0
 */

#pragma once

#include <generated_stow_items.h>

#define STOW_STORAGE_STUB_MAX_SAVES 16

/**
 * @brief Record of what the stubbed persistent storage backend was asked to save
 */
struct stow_storage_stub
{
    int save_count;                                  /**< Total saves requested */
    uint32_t saved_ids[STOW_STORAGE_STUB_MAX_SAVES]; /**< Item IDs saved, oldest first */
    void (*during_save)(void);                       /**< Runs once, inside the next save */
    int next_save_result;                            /**< Returned by the next save, then cleared */
};

extern struct stow_storage_stub g_stow_storage_stub;

/**
 * @brief Forget every recorded save and clear the during_save hook
 */
void stow_storage_stub_reset(void);

/**
 * @brief Count how many times an item was saved
 */
int stow_storage_stub_item_save_count(enum stow_item_id id);
```

## src/test_common.h
```c
/*
 * Copyright (c) 2026 Demizo
 *
 * SPDX-License-Identifier: Apache-2.0
 */

#pragma once

#include <gantry/memory.h>
#include <gantry/stow/stow.h>
#include <gantry/stow/types/stow_type_enum.h>
#include <generated_stow_enums.h>
#include <generated_stow_items.h>
#include <stdint.h>
#include <string.h>
#include <zcbor_decode.h>
#include <zcbor_encode.h>
#include <zephyr/ztest.h>
#include <zephyr/ztest_assert.h>

#include "stow_storage_stub.h"

static inline void reset_stow(void* fixture)
{
    (void)fixture;
    stow_init();
    stow_storage_stub_reset();
}

static inline uint32_t blocks_in_use(void)
{
    uint32_t total_used = 0;
    for (uint8_t pool = 0; pool < CONFIG_MEM_POOL_COUNT; pool++)
    {
        uint32_t used = 0;
        uint32_t total = 0;
        (void)mem_get_pool_usage(pool, &used, &total);
        total_used += used;
    }
    return total_used;
}
```

## src/test_stow_access.c
```c
/*
 * Copyright (c) 2026 Demizo
 *
 * SPDX-License-Identifier: Apache-2.0
 */

#include "test_common.h"

ZTEST_SUITE(stow_access, NULL, NULL, reset_stow, NULL, NULL);

ZTEST(stow_access, test_external_write_requires_session)
{
    data_value_t val = { .type = STOW_ITEM_TYPE_STRING, .data.string_value = "newname" };
    int ret = stow_set_external(STOW_ROLE_GUEST, STOW_ID_TEST_STRING, val);
    zassert_equal(ret, -EACCES);
}

ZTEST(stow_access, test_external_write_with_session_succeeds)
{
    data_value_t val = { .type = STOW_ITEM_TYPE_STRING, .data.string_value = "newname" };
    int ret = stow_set_external(STOW_ROLE_SESSION, STOW_ID_TEST_STRING, val);
    zassert_equal(ret, 0);
}

ZTEST(stow_access, test_external_read_only_item_cannot_be_written_by_session)
{
    data_value_t val = { .type = STOW_ITEM_TYPE_INT, .data.int_value = 10 };
    int ret = stow_set_external(STOW_ROLE_SESSION, STOW_ID_TEST_READ_ONLY, val);
    zassert_equal(ret, -EACCES);
}

ZTEST(stow_access, test_external_cannot_write_internal_only_item)
{
    data_value_t val = { .type = STOW_ITEM_TYPE_INT, .data.int_value = 10 };
    int ret = stow_set_external(STOW_ROLE_ANY, STOW_ID_TEST_READ_ONLY, val);
    zassert_equal(ret, -EACCES);
}

ZTEST(stow_access, test_internal_write_bypasses_permissions)
{
    data_value_t val = { .type = STOW_ITEM_TYPE_INT, .data.int_value = 10 };
    int ret = stow_set(STOW_ID_TEST_READ_ONLY, val);
    zassert_equal(ret, 0);
}

ZTEST(stow_access, test_external_tofu_can_be_written_from_default)
{
    data_value_t val = { .type = STOW_ITEM_TYPE_STRING, .data.string_value = "myvalue" };
    int ret = stow_set_external(STOW_ROLE_SESSION, STOW_ID_TEST_TOFU, val);
    zassert_equal(ret, 0);
}

ZTEST(stow_access, test_external_tofu_cannot_be_overwritten)
{
    data_value_t val1 = { .type = STOW_ITEM_TYPE_STRING, .data.string_value = "first" };
    int ret = stow_set_external(STOW_ROLE_SESSION, STOW_ID_TEST_TOFU, val1);
    zassert_equal(ret, 0);

    data_value_t val2 = { .type = STOW_ITEM_TYPE_STRING, .data.string_value = "second" };
    ret = stow_set_external(STOW_ROLE_SESSION, STOW_ID_TEST_TOFU, val2);
    zassert_equal(ret, -EALREADY);
}

ZTEST(stow_access, test_external_read_allowed_for_read_only_item)
{
    data_value_t val = { 0 };
    int ret = stow_get_external(STOW_ROLE_GUEST, STOW_ID_TEST_READ_ONLY, &val);
    zassert_equal(ret, 0);
    stow_release(STOW_ID_TEST_READ_ONLY, &val);
}

ZTEST(stow_access, test_external_subscribe_allowed_for_read_only_item)
{
    struct stow_subscription sub = { .mode = STOW_SUBSCRIPTION_HANDLE, .cb = NULL };
    int ret = stow_subscribe_external(STOW_ROLE_ANY, STOW_ID_TEST_READ_ONLY, &sub);
    zassert_equal(ret, 0);
    stow_unsubscribe(STOW_ID_TEST_READ_ONLY, &sub);
}

ZTEST(stow_access, test_invalid_id)
{
    zassert_false(stow_is_id_valid(STOW_ID_COUNT));
    zassert_false(stow_is_id_valid(0xFFFFFFFF));
}

ZTEST(stow_access, test_valid_ids)
{
    for (uint32_t id = 0; id < STOW_ID_COUNT; id++)
    {
        zassert_true(stow_is_id_valid(id));
    }
}

ZTEST(stow_access, test_can_read_with_a_granted_role)
{
    zassert_true(stow_can_read(STOW_ROLE_SESSION, STOW_ID_TEST_SESSION_ONLY));
}

ZTEST(stow_access, test_cannot_read_with_a_denied_role)
{
    zassert_false(stow_can_read(STOW_ROLE_GUEST, STOW_ID_TEST_SESSION_ONLY));
}

ZTEST(stow_access, test_cannot_read_with_no_role) { zassert_false(stow_can_read(0, STOW_ID_TEST_READ_ONLY)); }

ZTEST(stow_access, test_find_an_item_by_name)
{
    const struct stow_item_const_metadata* item = stow_item_find("TestInt", strlen("TestInt"));
    zassert_not_null(item);
    zassert_equal(item->id, STOW_ID_TEST_INT);
}

ZTEST(stow_access, test_find_an_absent_name) { zassert_is_null(stow_item_find("TestMissing", strlen("TestMissing"))); }

ZTEST(stow_access, test_find_a_prefix_of_a_name) { zassert_is_null(stow_item_find("TestIn", strlen("TestIn"))); }

ZTEST(stow_access, test_find_matches_exactly_len_bytes)
{
    const char* name = "TestStaticSubscribeInt2";
    const struct stow_item_const_metadata* item = stow_item_find(name, strlen("TestStaticSubscribeInt"));
    zassert_not_null(item);
    zassert_equal(item->id, STOW_ID_TEST_STATIC_SUBSCRIBE_INT);
}
```

## src/test_stow_buffer.c
```c
/*
 * Copyright (c) 2026 Demizo
 *
 * SPDX-License-Identifier: Apache-2.0
 */

#include "test_common.h"

ZTEST_SUITE(stow_buffer, NULL, NULL, reset_stow, NULL, NULL);

ZTEST(stow_buffer, test_get_default)
{
    data_value_t value;
    int ret = stow_get(STOW_ID_TEST_BUFFER, &value);
    zassert_equal(ret, 0);
    zassert_equal(value.type, STOW_ITEM_TYPE_BUFFER);
    zassert_equal(value.data.buffer_value->len, 0);
    stow_release(STOW_ID_TEST_BUFFER, &value);
}

ZTEST(stow_buffer, test_set_and_get)
{
    uint8_t raw_buf[sizeof(buffer_t) + 8];
    buffer_t* buf = (buffer_t*)raw_buf;
    buf->len = 8;
    memset(buf->buf, 0x5A, 8);

    data_value_t val = { .type = STOW_ITEM_TYPE_BUFFER, .data.buffer_value = buf };
    int ret = stow_set(STOW_ID_TEST_BUFFER, val);
    zassert_equal(ret, 0);

    data_value_t got;
    ret = stow_get(STOW_ID_TEST_BUFFER, &got);
    zassert_equal(ret, 0);
    zassert_equal(got.data.buffer_value->len, 8);
    zassert_equal(got.data.buffer_value->buf[0], 0x5A);
    stow_release(STOW_ID_TEST_BUFFER, &got);
}

ZTEST(stow_buffer, test_set_exceeds_max)
{
    uint8_t raw_buf[sizeof(buffer_t) + 65];
    buffer_t* buf = (buffer_t*)raw_buf;
    buf->len = 65;

    data_value_t val = { .type = STOW_ITEM_TYPE_BUFFER, .data.buffer_value = buf };
    int ret = stow_set(STOW_ID_TEST_BUFFER, val);
    zassert_equal(ret, -EINVAL);
}

ZTEST(stow_buffer, test_set_reports_allocation_failure)
{
    uint8_t raw_buf[sizeof(buffer_t) + 4];
    buffer_t* buf = (buffer_t*)raw_buf;
    buf->len = 4;
    memset(buf->buf, 0x11, 4);
    data_value_t val = { .type = STOW_ITEM_TYPE_BUFFER, .data.buffer_value = buf };

    void* blocks[256] = { 0 };
    size_t block_count = 0;
    while (block_count < ARRAY_SIZE(blocks) && mem_alloc(1, &blocks[block_count]) == 0)
    {
        block_count++;
    }
    zassert_true(block_count < ARRAY_SIZE(blocks), "memory pools were not exhausted");

    int ret = stow_set(STOW_ID_TEST_BUFFER, val);

    for (size_t i = 0; i < block_count; i++)
    {
        mem_unref(&blocks[i]);
    }

    zassert_equal(ret, -ENOMEM, "expected -ENOMEM, got %d", ret);

    data_value_t got;
    zassert_equal(stow_get(STOW_ID_TEST_BUFFER, &got), 0);
    zassert_equal(got.data.buffer_value->len, 0, "value changed despite the failed set");
    stow_release(STOW_ID_TEST_BUFFER, &got);
}

ZTEST(stow_buffer, test_encode_decode)
{
    uint8_t raw_buf[sizeof(buffer_t) + 3];
    buffer_t* buf = (buffer_t*)raw_buf;
    buf->len = 3;
    buf->buf[0] = 0xCA;
    buf->buf[1] = 0xFE;
    buf->buf[2] = 0xBA;

    uint8_t cbor_buf[64];
    zcbor_state_t enc[2];
    zcbor_new_encode_state(enc, ARRAY_SIZE(enc), cbor_buf, sizeof(cbor_buf), 1);

    data_value_t val = { .type = STOW_ITEM_TYPE_BUFFER, .data.buffer_value = buf };
    int ret = stow_encode(enc, STOW_ID_TEST_BUFFER, val);
    zassert_equal(ret, 0);

    size_t encoded_len = enc[0].payload - cbor_buf;
    zcbor_state_t dec[2];
    zcbor_new_decode_state(dec, ARRAY_SIZE(dec), cbor_buf, encoded_len, 1, NULL, 0);

    data_value_t decoded;
    ret = stow_decode(dec, STOW_ID_TEST_BUFFER, &decoded);
    zassert_equal(ret, 0);
    zassert_equal(decoded.data.buffer_value->len, 3);
    zassert_equal(decoded.data.buffer_value->buf[1], 0xFE);
    stow_release(STOW_ID_TEST_BUFFER, &decoded);
}
```

## src/test_stow_byte_array.c
```c
/*
 * Copyright (c) 2026 Demizo
 *
 * SPDX-License-Identifier: Apache-2.0
 */

#include "test_common.h"

ZTEST_SUITE(stow_byte_array, NULL, NULL, reset_stow, NULL, NULL);

ZTEST(stow_byte_array, test_get_default)
{
    data_value_t value;
    int ret = stow_get(STOW_ID_TEST_BYTES, &value);
    zassert_equal(ret, 0);
    zassert_equal(value.type, STOW_ITEM_TYPE_BYTE_ARRAY);
    zassert_equal(value.data.buffer_value->len, 4);
    zassert_equal(value.data.buffer_value->buf[0], 0x01);
    zassert_equal(value.data.buffer_value->buf[3], 0x04);
    stow_release(STOW_ID_TEST_BYTES, &value);
}

ZTEST(stow_byte_array, test_set_and_get)
{
    uint8_t raw_buf[sizeof(buffer_t) + 4];
    buffer_t* buf = (buffer_t*)raw_buf;
    buf->len = 4;
    buf->buf[0] = 0xAA;
    buf->buf[1] = 0xBB;
    buf->buf[2] = 0xCC;
    buf->buf[3] = 0xDD;

    data_value_t val = { .type = STOW_ITEM_TYPE_BYTE_ARRAY, .data.buffer_value = buf };
    int ret = stow_set(STOW_ID_TEST_BYTES, val);
    zassert_equal(ret, 0);

    data_value_t got;
    ret = stow_get(STOW_ID_TEST_BYTES, &got);
    zassert_equal(ret, 0);
    zassert_equal(got.data.buffer_value->len, 4);
    zassert_equal(got.data.buffer_value->buf[0], 0xAA);
    zassert_equal(got.data.buffer_value->buf[3], 0xDD);
    stow_release(STOW_ID_TEST_BYTES, &got);
}

ZTEST(stow_byte_array, test_wrong_length)
{
    uint8_t raw_buf[sizeof(buffer_t) + 2];
    buffer_t* buf = (buffer_t*)raw_buf;
    buf->len = 2;

    data_value_t val = { .type = STOW_ITEM_TYPE_BYTE_ARRAY, .data.buffer_value = buf };
    int ret = stow_set(STOW_ID_TEST_BYTES, val);
    zassert_equal(ret, -EINVAL);
}

ZTEST(stow_byte_array, test_encode_decode)
{
    uint8_t raw_buf[sizeof(buffer_t) + 4];
    buffer_t* buf = (buffer_t*)raw_buf;
    buf->len = 4;
    buf->buf[0] = 0x10;
    buf->buf[1] = 0x20;
    buf->buf[2] = 0x30;
    buf->buf[3] = 0x40;

    uint8_t cbor_buf[64];
    zcbor_state_t enc[2];
    zcbor_new_encode_state(enc, ARRAY_SIZE(enc), cbor_buf, sizeof(cbor_buf), 1);

    data_value_t val = { .type = STOW_ITEM_TYPE_BYTE_ARRAY, .data.buffer_value = buf };
    int ret = stow_encode(enc, STOW_ID_TEST_BYTES, val);
    zassert_equal(ret, 0);

    size_t encoded_len = enc[0].payload - cbor_buf;
    zcbor_state_t dec[2];
    zcbor_new_decode_state(dec, ARRAY_SIZE(dec), cbor_buf, encoded_len, 1, NULL, 0);

    data_value_t decoded;
    ret = stow_decode(dec, STOW_ID_TEST_BYTES, &decoded);
    zassert_equal(ret, 0);
    zassert_equal(decoded.data.buffer_value->len, 4);
    zassert_equal(decoded.data.buffer_value->buf[0], 0x10);
    stow_release(STOW_ID_TEST_BYTES, &decoded);
}
```

## src/test_stow_concurrency.c
```c
/*
 * Copyright (c) 2026 Demizo
 *
 * SPDX-License-Identifier: Apache-2.0
 */

#include <gantry/error.h>
#include <gantry/ownership.h>
#include <zephyr/kernel.h>

#include "generated_struct_NestedStruct.h"
#include "generated_struct_TestStruct.h"
#include "test_common.h"

#define WRITER_STACK_SIZE 1024
#define WRITER_PRIORITY 5

K_THREAD_STACK_DEFINE(writer_a_stack, WRITER_STACK_SIZE);
K_THREAD_STACK_DEFINE(writer_b_stack, WRITER_STACK_SIZE);
static struct k_thread writer_a_data;
static struct k_thread writer_b_data;

K_SEM_DEFINE(writer_start, 0, 2);
K_SEM_DEFINE(releaser_start, 0, 1);

#define RELEASE_ROUNDS 200

struct tofu_writer_args
{
    const char* value;
    int ret;
};

static void tofu_writer_thread(void* arg1, void* arg2, void* arg3)
{
    ARG_UNUSED(arg2);
    ARG_UNUSED(arg3);
    struct tofu_writer_args* args = (struct tofu_writer_args*)arg1;

    // Wait so both writer threads attempt stow_set() on the same TOFU item as close together as
    // possible, genuinely contending rather than running sequentially.
    k_sem_take(&writer_start, K_FOREVER);

    data_value_t value = { .type = STOW_ITEM_TYPE_STRING, .data.string_value = (char*)args->value };
    args->ret = stow_set(STOW_ID_TEST_TOFU, value);
}

ZTEST_SUITE(stow_concurrency, NULL, NULL, reset_stow, NULL, NULL);

ZTEST(stow_concurrency, test_concurrent_tofu_writers_exactly_one_succeeds)
{
    struct tofu_writer_args args_a = { .value = "writer_a", .ret = -1 };
    struct tofu_writer_args args_b = { .value = "writer_b", .ret = -1 };

    k_tid_t tid_a = k_thread_create(
        &writer_a_data, writer_a_stack, WRITER_STACK_SIZE, tofu_writer_thread, &args_a, NULL, NULL, WRITER_PRIORITY, 0,
        K_NO_WAIT);
    k_tid_t tid_b = k_thread_create(
        &writer_b_data, writer_b_stack, WRITER_STACK_SIZE, tofu_writer_thread, &args_b, NULL, NULL, WRITER_PRIORITY, 0,
        K_NO_WAIT);

    k_sem_give(&writer_start);
    k_sem_give(&writer_start);

    k_thread_join(tid_a, K_FOREVER);
    k_thread_join(tid_b, K_FOREVER);

    int success_count = (args_a.ret == SUCCESS) + (args_b.ret == SUCCESS);
    int denied_count = (args_a.ret == -EALREADY) + (args_b.ret == -EALREADY);

    zassert_equal(success_count, 1, "Expected exactly one writer to succeed");
    zassert_equal(denied_count, 1, "Expected exactly one writer to be denied with -EALREADY");

    // The stored value must match whichever writer actually won, not a mix of both.
    data_value_t got = { 0 };
    stow_get(STOW_ID_TEST_TOFU, &got);
    const char* winner = (args_a.ret == SUCCESS) ? args_a.value : args_b.value;
    zassert_str_equal(got.data.string_value, winner);
    stow_release(STOW_ID_TEST_TOFU, &got);
}

static void releaser_thread(void* arg1, void* arg2, void* arg3)
{
    ARG_UNUSED(arg2);
    ARG_UNUSED(arg3);
    data_value_t* held = arg1;
    k_sem_take(&releaser_start, K_FOREVER);
    stow_release(STOW_ID_TEST_NESTED_STRUCT_ITEM, held);
}

ZTEST(stow_concurrency, test_two_holders_releasing_a_nested_struct_at_once_free_every_block)
{
    uint8_t buf_storage[sizeof(buffer_t) + 1];
    buffer_t* buf = (buffer_t*)buf_storage;
    buf->len = 1;
    buf->buf[0] = 0x5A;
    TestStruct_t inner = { .enum_field = Color_BLUE, .string_field = "hi", .buf_field = buf };
    NestedStruct_t outer = { .inner = &inner };
    data_value_t next = { .type = STOW_ITEM_TYPE_STRUCT, .data.raw_value = &outer };

    uint32_t blocks = blocks_in_use();
    for (int round = 0; round < RELEASE_ROUNDS; round++)
    {
        data_value_t first;
        data_value_t second;
        zassert_equal(stow_get(STOW_ID_TEST_NESTED_STRUCT_ITEM, &first), 0);
        zassert_equal(stow_get(STOW_ID_TEST_NESTED_STRUCT_ITEM, &second), 0);
        inner.int_field = round;
        zassert_equal(stow_set(STOW_ID_TEST_NESTED_STRUCT_ITEM, next), 0);

        k_tid_t tid = k_thread_create(
            &writer_a_data, writer_a_stack, WRITER_STACK_SIZE, releaser_thread, &second, NULL, NULL, WRITER_PRIORITY, 0,
            K_NO_WAIT);
        PASS_OWNERSHIP(second);
        k_sem_give(&releaser_start);
        stow_release(STOW_ID_TEST_NESTED_STRUCT_ITEM, &first);
        k_thread_join(tid, K_FOREVER);
    }
    zassert_equal(blocks_in_use(), blocks, "nested blocks leaked");
}
```

## src/test_stow_custom.c
```c
/*
 * Copyright (c) 2026 Demizo
 *
 * SPDX-License-Identifier: Apache-2.0
 */

#include <gantry/error.h>

#include "test_common.h"

static int g_backing_value;
static int g_set_calls;
static int g_get_calls;
static int g_forced_set_error;
static const struct stow_item_const_metadata* g_last_set_item;
static const struct stow_item_const_metadata* g_last_get_item;
static int g_getter_only_calls;
static int g_setter_only_calls;
static int g_validate_calls;
static bool g_validator_rejects;

int test_custom_setter(const struct stow_item_const_metadata* item, data_value_t value)
{
    g_set_calls++;
    g_last_set_item = item;
    if (g_forced_set_error != SUCCESS)
    {
        return g_forced_set_error;
    }
    g_backing_value = value.data.int_value;
    return SUCCESS;
}

int test_custom_getter(const struct stow_item_const_metadata* item, data_value_t* out_value)
{
    g_get_calls++;
    g_last_get_item = item;
    out_value->type = STOW_ITEM_TYPE_INT;
    out_value->data.int_value = g_backing_value;
    return SUCCESS;
}

/*
 * Getter-only callback: trips a flag, then delegates to the default
 * interface so the value read comes from item storage.
 */
int test_getter_only(const struct stow_item_const_metadata* item, data_value_t* out_value)
{
    g_getter_only_calls++;
    return item->interface->get(item->value_ptr, out_value);
}

/*
 * Setter-only callback: trips a flag, then delegates to the default
 * interface so the written value lands in item storage and a subsequent
 * default get retrieves it.
 */
int test_setter_only(const struct stow_item_const_metadata* item, data_value_t value)
{
    g_setter_only_calls++;
    return item->interface->set(item->value_ptr, value);
}

/*
 * Custom validator: rejects odd values, or unconditionally rejects when g_validator_rejects is set.
 */
bool test_custom_validator(const struct stow_item_const_metadata* item, data_value_t value)
{
    (void)item;
    g_validate_calls++;
    if (g_validator_rejects)
    {
        return false;
    }
    return (value.data.int_value % 2) == 0;
}

static void reset_custom(void* fixture)
{
    (void)fixture;
    g_backing_value = 0;
    g_set_calls = 0;
    g_get_calls = 0;
    g_forced_set_error = SUCCESS;
    g_last_set_item = NULL;
    g_last_get_item = NULL;
    g_getter_only_calls = 0;
    g_setter_only_calls = 0;
    g_validate_calls = 0;
    g_validator_rejects = false;
    stow_init();
}

ZTEST_SUITE(stow_custom, NULL, NULL, reset_custom, NULL, NULL);

ZTEST(stow_custom, test_custom_set_invokes_callback)
{
    data_value_t value = { .type = STOW_ITEM_TYPE_INT, .data.int_value = 42 };
    int ret = stow_set(STOW_ID_TEST_CUSTOM_INT, value);
    zassert_equal(ret, SUCCESS);
    zassert_equal(g_set_calls, 1);
    zassert_equal(g_backing_value, 42);
    zassert_not_null(g_last_set_item);
    zassert_equal(g_last_set_item->id, STOW_ID_TEST_CUSTOM_INT);
}

ZTEST(stow_custom, test_custom_get_invokes_callback)
{
    g_backing_value = 17;
    data_value_t got;
    int ret = stow_get(STOW_ID_TEST_CUSTOM_INT, &got);
    zassert_equal(ret, SUCCESS);
    zassert_equal(g_get_calls, 1);
    zassert_equal(got.type, STOW_ITEM_TYPE_INT);
    zassert_equal(got.data.int_value, 17);
    zassert_not_null(g_last_get_item);
    zassert_equal(g_last_get_item->id, STOW_ID_TEST_CUSTOM_INT);
    stow_release(STOW_ID_TEST_CUSTOM_INT, &got);
}

ZTEST(stow_custom, test_custom_set_skipped_on_validation_failure)
{
    data_value_t value = { .type = STOW_ITEM_TYPE_INT, .data.int_value = 999 };
    int ret = stow_set(STOW_ID_TEST_CUSTOM_INT, value);
    zassert_equal(ret, -EINVAL);
    zassert_equal(g_set_calls, 0);
    zassert_equal(g_backing_value, 0);
}

ZTEST(stow_custom, test_custom_set_skipped_on_permission_failure)
{
    data_value_t value = { .type = STOW_ITEM_TYPE_INT, .data.int_value = 10 };
    int ret = stow_set_external(STOW_ROLE_ANY, STOW_ID_TEST_CUSTOM_READ_ONLY, value);
    zassert_equal(ret, -EACCES);
    zassert_equal(g_set_calls, 0);
}

ZTEST(stow_custom, test_custom_set_propagates_error)
{
    g_forced_set_error = -EIO;
    data_value_t value = { .type = STOW_ITEM_TYPE_INT, .data.int_value = 5 };
    int ret = stow_set(STOW_ID_TEST_CUSTOM_INT, value);
    zassert_equal(ret, -EIO);
    zassert_equal(g_set_calls, 1);
    zassert_equal(g_backing_value, 0);
}

ZTEST(stow_custom, test_getter_only_set_uses_interface_storage)
{
    data_value_t value = { .type = STOW_ITEM_TYPE_INT, .data.int_value = 33 };
    int ret = stow_set(STOW_ID_TEST_CUSTOM_GETTER_ONLY, value);
    zassert_equal(ret, SUCCESS);
    zassert_equal(g_getter_only_calls, 0);
    zassert_equal(g_set_calls, 0);

    data_value_t got;
    ret = stow_get(STOW_ID_TEST_CUSTOM_GETTER_ONLY, &got);
    zassert_equal(ret, SUCCESS);
    zassert_equal(g_getter_only_calls, 1);
    zassert_equal(got.type, STOW_ITEM_TYPE_INT);
    zassert_equal(got.data.int_value, 33);
    stow_release(STOW_ID_TEST_CUSTOM_GETTER_ONLY, &got);
}

ZTEST(stow_custom, test_setter_only_uses_interface_storage)
{
    data_value_t value = { .type = STOW_ITEM_TYPE_INT, .data.int_value = 77 };
    int ret = stow_set(STOW_ID_TEST_CUSTOM_SETTER_ONLY, value);
    zassert_equal(ret, SUCCESS);
    zassert_equal(g_setter_only_calls, 1);

    data_value_t got;
    ret = stow_get(STOW_ID_TEST_CUSTOM_SETTER_ONLY, &got);
    zassert_equal(ret, SUCCESS);
    zassert_equal(g_get_calls, 0);
    zassert_equal(got.type, STOW_ITEM_TYPE_INT);
    zassert_equal(got.data.int_value, 77);
    stow_release(STOW_ID_TEST_CUSTOM_SETTER_ONLY, &got);
}

ZTEST(stow_custom, test_setter_only_validation_still_runs)
{
    /* Out-of-range value must be rejected by validation before custom_set fires. */
    data_value_t value = { .type = STOW_ITEM_TYPE_INT, .data.int_value = 500 };
    int ret = stow_set(STOW_ID_TEST_CUSTOM_SETTER_ONLY, value);
    zassert_equal(ret, -EINVAL);
    zassert_equal(g_setter_only_calls, 0);
}

ZTEST(stow_custom, test_custom_validate_accepts_valid)
{
    /* 10 is in range and even -> passes both regular and custom validation. */
    data_value_t value = { .type = STOW_ITEM_TYPE_INT, .data.int_value = 10 };
    int ret = stow_set(STOW_ID_TEST_CUSTOM_VALIDATED, value);
    zassert_equal(ret, SUCCESS);
    zassert_equal(g_validate_calls, 1);

    data_value_t got;
    ret = stow_get(STOW_ID_TEST_CUSTOM_VALIDATED, &got);
    zassert_equal(ret, SUCCESS);
    zassert_equal(got.data.int_value, 10);
    stow_release(STOW_ID_TEST_CUSTOM_VALIDATED, &got);
}

ZTEST(stow_custom, test_custom_validate_rejects)
{
    /* 9 is in range but odd -> regular validation passes, custom rejects. */
    data_value_t value = { .type = STOW_ITEM_TYPE_INT, .data.int_value = 9 };
    int ret = stow_set(STOW_ID_TEST_CUSTOM_VALIDATED, value);
    zassert_equal(ret, -EINVAL);
    zassert_equal(g_validate_calls, 1);

    /* Value should be unchanged from default (0). */
    data_value_t got;
    ret = stow_get(STOW_ID_TEST_CUSTOM_VALIDATED, &got);
    zassert_equal(ret, SUCCESS);
    zassert_equal(got.data.int_value, 0);
    stow_release(STOW_ID_TEST_CUSTOM_VALIDATED, &got);
}

ZTEST(stow_custom, test_custom_validate_skipped_when_regular_validation_fails)
{
    /* 999 fails the regular range check -> custom validator must not run. */
    data_value_t value = { .type = STOW_ITEM_TYPE_INT, .data.int_value = 999 };
    int ret = stow_set(STOW_ID_TEST_CUSTOM_VALIDATED, value);
    zassert_equal(ret, -EINVAL);
    zassert_equal(g_validate_calls, 0);
}

ZTEST(stow_custom, test_custom_validate_forced_reject)
{
    /* Force the custom validator to reject a value that would otherwise pass. */
    g_validator_rejects = true;
    data_value_t value = { .type = STOW_ITEM_TYPE_INT, .data.int_value = 2 };
    int ret = stow_set(STOW_ID_TEST_CUSTOM_VALIDATED, value);
    zassert_equal(ret, -EINVAL);
    zassert_equal(g_validate_calls, 1);
}
```

## src/test_stow_describe.c
```c
/*
 * Copyright (c) 2026 Demizo
 *
 * SPDX-License-Identifier: Apache-2.0
 */

#include "test_common.h"

ZTEST_SUITE(stow_describe, NULL, NULL, reset_stow, NULL, NULL);

ZTEST(stow_describe, test_full_describe_succeeds)
{
    uint8_t buf[4096];
    zcbor_state_t enc[4];
    zcbor_new_encode_state(enc, ARRAY_SIZE(enc), buf, sizeof(buf), STOW_ID_COUNT);

    uint32_t next_id = 0;
    int ret = stow_describe(0, NULL, enc, &next_id);
    zassert_equal(ret, 0);
    zassert_equal(next_id, STOW_ID_COUNT);
}

ZTEST(stow_describe, test_tiny_buffer_returns_e2big)
{
    uint8_t buf[1];
    zcbor_state_t enc[4];
    zcbor_new_encode_state(enc, ARRAY_SIZE(enc), buf, sizeof(buf), STOW_ID_COUNT);

    uint32_t next_id = STOW_ID_COUNT;
    int ret = stow_describe(0, NULL, enc, &next_id);
    zassert_equal(ret, -E2BIG);
    zassert_equal(next_id, 0);
    zassert_equal_ptr(enc[0].payload, buf);
}

ZTEST(stow_describe, test_filter_describes_only_selected_items)
{
    ATOMIC_DEFINE(filter, STOW_ID_COUNT) = { 0 };
    atomic_set_bit(filter, STOW_ID_TEST_INT);

    uint8_t buf[512];
    zcbor_state_t enc[4];
    zcbor_new_encode_state(enc, ARRAY_SIZE(enc), buf, sizeof(buf), STOW_ID_COUNT);

    uint32_t next_id = 0;
    zassert_equal(stow_describe(0, filter, enc, &next_id), 0);
    zassert_equal(next_id, STOW_ID_COUNT);

    ZCBOR_STATE_D(dec, 3, buf, enc[0].payload - buf, 1, 0);
    zassert_true(zcbor_map_start_decode(dec));
    struct zcbor_string key;
    uint32_t id;
    zassert_true(zcbor_tstr_decode(dec, &key));
    zassert_true(zcbor_uint32_decode(dec, &id));
    zassert_equal(id, STOW_ID_TEST_INT);
    for (int i = 0; i < 8 * 2; i++)
    {
        zassert_true(zcbor_any_skip(dec, NULL));
    }
    zassert_true(zcbor_map_end_decode(dec));
    zassert_equal_ptr(dec->payload, enc[0].payload);
}

ZTEST(stow_describe, test_empty_filter_describes_nothing)
{
    ATOMIC_DEFINE(filter, STOW_ID_COUNT) = { 0 };

    uint8_t buf[8];
    zcbor_state_t enc[4];
    zcbor_new_encode_state(enc, ARRAY_SIZE(enc), buf, sizeof(buf), STOW_ID_COUNT);

    uint32_t next_id = 0;
    zassert_equal(stow_describe(0, filter, enc, &next_id), 0);
    zassert_equal(next_id, STOW_ID_COUNT);

    zassert_equal_ptr(enc[0].payload, buf);
}

ZTEST(stow_describe, test_rollback_leaves_no_partial_data)
{
    uint8_t buf[8];
    zcbor_state_t enc[4];
    zcbor_new_encode_state(enc, ARRAY_SIZE(enc), buf, sizeof(buf), STOW_ID_COUNT);

    const uint8_t* payload_before = enc[0].payload;

    uint32_t next_id = 0;
    stow_describe(0, NULL, enc, &next_id);

    zassert_equal_ptr(enc[0].payload, payload_before);
}

ZTEST(stow_describe, test_chunked_describe_covers_all_items)
{
    uint32_t next_id = 0;
    uint32_t items_encoded = 0;

    while (next_id < STOW_ID_COUNT)
    {
        uint8_t buf[1024];
        zcbor_state_t enc[4];
        zcbor_new_encode_state(enc, ARRAY_SIZE(enc), buf, sizeof(buf), STOW_ID_COUNT);

        uint32_t id_before = next_id;
        int ret = stow_describe(next_id, NULL, enc, &next_id);

        if (ret == 0)
        {
            items_encoded += STOW_ID_COUNT - id_before;
            break;
        }
        else if (ret == -ENOMEM)
        {
            uint32_t newly_encoded_count = next_id - id_before;
            zassert_true(newly_encoded_count > 0);
            items_encoded += newly_encoded_count;
        }
        else
        {
            zassert_unreachable("Unexpected return value from stow_describe");
        }
    }

    zassert_equal(items_encoded, STOW_ID_COUNT);
}

#define EXPECT_KEY(dec_state, expected_str)                                                                          \
    do                                                                                                               \
    {                                                                                                                \
        struct zcbor_string key;                                                                                     \
        zassert_true(zcbor_tstr_decode(dec_state, &key), "Failed to decode key");                                    \
        zassert_equal(key.len, strlen(expected_str), "Key length mismatch for %s", expected_str);                    \
        zassert_mem_equal(key.value, expected_str, strlen(expected_str), "Key mismatch, expected %s", expected_str); \
    } while (0)

ZTEST(stow_describe, test_describe_encoding)
{
    uint8_t buf[256];
    zcbor_state_t enc[4];
    zcbor_new_encode_state(enc, ARRAY_SIZE(enc), buf, sizeof(buf), STOW_ID_COUNT);

    uint32_t next_id = 0;
    int ret = stow_describe(0, NULL, enc, &next_id);
    zassert_equal(ret, -ENOMEM);
    zassert_true(next_id > 0);

    ZCBOR_STATE_D(dec, 2, buf, enc->payload - buf, 1, 0);
    uint32_t val_u32;
    struct zcbor_string val_tstr;

    // Start map decode
    zassert_true(zcbor_map_start_decode(dec), "Failed to start map decode");

    // id
    EXPECT_KEY(dec, "id");
    zassert_true(zcbor_uint32_decode(dec, &val_u32), "Failed to decode id");

    // name
    EXPECT_KEY(dec, "name");
    zassert_true(zcbor_tstr_decode(dec, &val_tstr), "Failed to decode name");

    // categories (Skip the value)
    EXPECT_KEY(dec, "categories");
    zassert_true(zcbor_any_skip(dec, NULL), "Failed to skip 'categories' value");

    // storage
    EXPECT_KEY(dec, "storage");
    zassert_true(zcbor_tstr_decode(dec, &val_tstr), "Failed to decode storage");

    // read_perm
    EXPECT_KEY(dec, "read_perm");
    zassert_true(zcbor_any_skip(dec, NULL), "Failed to skip 'read_perm' value");

    // write_perm
    EXPECT_KEY(dec, "write_perm");
    zassert_true(zcbor_any_skip(dec, NULL), "Failed to skip 'write_perm' value");

    // type
    EXPECT_KEY(dec, "type");
    zassert_true(zcbor_tstr_decode(dec, &val_tstr), "Failed to decode type");

    // default (Skip the value)
    EXPECT_KEY(dec, "default");
    zassert_true(zcbor_any_skip(dec, NULL), "Failed to skip 'default' value");

    // constraints (Skip the value)
    EXPECT_KEY(dec, "constraints");
    zassert_true(zcbor_any_skip(dec, NULL), "Failed to skip 'constraints' value");

    // End map decode
    zassert_true(zcbor_map_end_decode(dec), "Failed to end map decode");
}
```

## src/test_stow_enum.c
```c
/*
 * Copyright (c) 2026 Demizo
 *
 * SPDX-License-Identifier: Apache-2.0
 */

#include "test_common.h"

ZTEST_SUITE(stow_enum, NULL, NULL, reset_stow, NULL, NULL);

ZTEST(stow_enum, test_get_default)
{
    data_value_t value;
    int ret = stow_get(STOW_ID_TEST_ENUM, &value);
    zassert_equal(ret, 0);
    zassert_equal(value.type, STOW_ITEM_TYPE_ENUM);
    zassert_equal(value.data.int_value, Color_RED);
    stow_release(STOW_ID_TEST_ENUM, &value);
}

ZTEST(stow_enum, test_set_valid)
{
    data_value_t val = { .type = STOW_ITEM_TYPE_ENUM, .data.int_value = Color_BLUE };
    int ret = stow_set(STOW_ID_TEST_ENUM, val);
    zassert_equal(ret, 0);

    data_value_t got;
    ret = stow_get(STOW_ID_TEST_ENUM, &got);
    zassert_equal(ret, 0);
    zassert_equal(got.data.int_value, Color_BLUE);
    stow_release(STOW_ID_TEST_ENUM, &got);
}

ZTEST(stow_enum, test_set_invalid)
{
    data_value_t val = { .type = STOW_ITEM_TYPE_ENUM, .data.int_value = 99 };
    int ret = stow_set(STOW_ID_TEST_ENUM, val);
    zassert_equal(ret, -EINVAL);
}

ZTEST(stow_enum, test_name_from_value)
{
    const struct stow_item_const_metadata* item = &g_stow_const_metadata[STOW_ID_TEST_ENUM];
    char* name = NULL;
    int ret = enum_get_name_from_value(&item->constraints, Color_GREEN, &name);
    zassert_equal(ret, 0);
    zassert_str_equal(name, "GREEN");
}

ZTEST(stow_enum, test_value_from_name)
{
    const struct stow_item_const_metadata* item = &g_stow_const_metadata[STOW_ID_TEST_ENUM];
    int value = -1;
    int ret = enum_get_value_from_name(&item->constraints, "BLUE", &value);
    zassert_equal(ret, 0);
    zassert_equal(value, Color_BLUE);
}

ZTEST(stow_enum, test_encode_decode)
{
    uint8_t buf[32];
    zcbor_state_t enc[2];
    zcbor_new_encode_state(enc, ARRAY_SIZE(enc), buf, sizeof(buf), 1);

    data_value_t val = { .type = STOW_ITEM_TYPE_ENUM, .data.int_value = Color_GREEN };
    int ret = stow_encode(enc, STOW_ID_TEST_ENUM, val);
    zassert_equal(ret, 0);

    size_t encoded_len = enc[0].payload - buf;
    zcbor_state_t dec[2];
    zcbor_new_decode_state(dec, ARRAY_SIZE(dec), buf, encoded_len, 1, NULL, 0);

    data_value_t decoded;
    ret = stow_decode(dec, STOW_ID_TEST_ENUM, &decoded);
    zassert_equal(ret, 0);
    zassert_equal(decoded.data.int_value, Color_GREEN);
    stow_release(STOW_ID_TEST_ENUM, &decoded);
}
```

## src/test_stow_float.c
```c
/*
 * Copyright (c) 2026 Demizo
 *
 * SPDX-License-Identifier: Apache-2.0
 */

#include "test_common.h"

ZTEST_SUITE(stow_float, NULL, NULL, reset_stow, NULL, NULL);

ZTEST(stow_float, test_get_default)
{
    data_value_t value;
    int ret = stow_get(STOW_ID_TEST_FLOAT, &value);
    zassert_equal(ret, 0);
    zassert_equal(value.type, STOW_ITEM_TYPE_FLOAT);
    zassert_within(value.data.float_value, 1.0f, 0.001f);
    stow_release(STOW_ID_TEST_FLOAT, &value);
}

ZTEST(stow_float, test_set_and_get)
{
    data_value_t set_value = { .type = STOW_ITEM_TYPE_FLOAT, .data.float_value = 5.5f };
    int ret = stow_set(STOW_ID_TEST_FLOAT, set_value);
    zassert_equal(ret, 0);

    data_value_t got;
    ret = stow_get(STOW_ID_TEST_FLOAT, &got);
    zassert_equal(ret, 0);
    zassert_within(got.data.float_value, 5.5f, 0.001f);
    stow_release(STOW_ID_TEST_FLOAT, &got);
}

ZTEST(stow_float, test_set_out_of_range)
{
    data_value_t value = { .type = STOW_ITEM_TYPE_FLOAT, .data.float_value = 11.0f };
    int ret = stow_set(STOW_ID_TEST_FLOAT, value);
    zassert_equal(ret, -EINVAL);
}

ZTEST(stow_float, test_encode_decode)
{
    uint8_t buf[32];
    zcbor_state_t enc[2];
    zcbor_new_encode_state(enc, ARRAY_SIZE(enc), buf, sizeof(buf), 1);

    data_value_t val = { .type = STOW_ITEM_TYPE_FLOAT, .data.float_value = 3.14f };
    int ret = stow_encode(enc, STOW_ID_TEST_FLOAT, val);
    zassert_equal(ret, 0);

    size_t encoded_len = enc[0].payload - buf;
    zcbor_state_t dec[2];
    zcbor_new_decode_state(dec, ARRAY_SIZE(dec), buf, encoded_len, 1, NULL, 0);

    data_value_t decoded;
    ret = stow_decode(dec, STOW_ID_TEST_FLOAT, &decoded);
    zassert_equal(ret, 0);
    zassert_within(decoded.data.float_value, 3.14f, 0.001f);
    stow_release(STOW_ID_TEST_FLOAT, &decoded);
}
```

## src/test_stow_int.c
```c
/*
 * Copyright (c) 2026 Demizo
 *
 * SPDX-License-Identifier: Apache-2.0
 */

#include "test_common.h"

ZTEST_SUITE(stow_int, NULL, NULL, reset_stow, NULL, NULL);

ZTEST(stow_int, test_get_default)
{
    data_value_t value;
    int ret = stow_get(STOW_ID_TEST_INT, &value);
    zassert_equal(ret, 0);
    zassert_equal(value.type, STOW_ITEM_TYPE_INT);
    zassert_equal(value.data.int_value, 0);
    stow_release(STOW_ID_TEST_INT, &value);
}

ZTEST(stow_int, test_set_and_get)
{
    data_value_t set_value = { .type = STOW_ITEM_TYPE_INT, .data.int_value = 25 };
    int ret = stow_set(STOW_ID_TEST_INT, set_value);
    zassert_equal(ret, 0);

    data_value_t got;
    ret = stow_get(STOW_ID_TEST_INT, &got);
    zassert_equal(ret, 0);
    zassert_equal(got.data.int_value, 25);
    stow_release(STOW_ID_TEST_INT, &got);
}

ZTEST(stow_int, test_set_out_of_range_max)
{
    data_value_t value = { .type = STOW_ITEM_TYPE_INT, .data.int_value = 51 };
    int ret = stow_set(STOW_ID_TEST_INT, value);
    zassert_equal(ret, -EINVAL);
}

ZTEST(stow_int, test_set_out_of_range_min)
{
    data_value_t value = { .type = STOW_ITEM_TYPE_INT, .data.int_value = -51 };
    int ret = stow_set(STOW_ID_TEST_INT, value);
    zassert_equal(ret, -EINVAL);
}

ZTEST(stow_int, test_encode_decode)
{
    uint8_t buf[32];
    zcbor_state_t enc[2];
    zcbor_new_encode_state(enc, ARRAY_SIZE(enc), buf, sizeof(buf), 1);

    data_value_t val = { .type = STOW_ITEM_TYPE_INT, .data.int_value = -10 };
    int ret = stow_encode(enc, STOW_ID_TEST_INT, val);
    zassert_equal(ret, 0);

    size_t encoded_len = enc[0].payload - buf;
    zcbor_state_t dec[2];
    zcbor_new_decode_state(dec, ARRAY_SIZE(dec), buf, encoded_len, 1, NULL, 0);

    data_value_t decoded;
    ret = stow_decode(dec, STOW_ID_TEST_INT, &decoded);
    zassert_equal(ret, 0);
    zassert_equal(decoded.type, STOW_ITEM_TYPE_INT);
    zassert_equal(decoded.data.int_value, -10);
    stow_release(STOW_ID_TEST_INT, &decoded);
}
```

## CMakeLists.txt
```
cmake_minimum_required(VERSION 3.20.0)

find_package(Zephyr REQUIRED HINTS $ENV{ZEPHYR_BASE})
project(stow_storage_test)

set(GANTRY_ROOT ${CMAKE_CURRENT_SOURCE_DIR}/../..)
set(GANTRY_LIB ${GANTRY_ROOT}/lib)
set(GANTRY_INC ${GANTRY_ROOT}/include)

gantry_stow_generate(YAML stow.yaml)

target_sources(app PRIVATE
    src/test_stow_storage.c
    ${GANTRY_LIB}/memory.c
    ${GANTRY_LIB}/event.c
    ${GANTRY_LIB}/stow/stow.c
    ${GANTRY_LIB}/stow/stow_event.c
    ${GANTRY_LIB}/stow/stow_storage.c
    ${GANTRY_LIB}/stow/types/stow_type_enum.c
    ${GANTRY_LIB}/stow/types/stow_type_int.c
    ${GANTRY_LIB}/stow/types/stow_type_float.c
    ${GANTRY_LIB}/stow/types/stow_type_string.c
    ${GANTRY_LIB}/stow/types/stow_type_byte_array.c
    ${GANTRY_LIB}/stow/types/stow_type_buffer.c
)

target_include_directories(app PRIVATE
    ${GANTRY_INC}
)
```

## prj.conf
```kconfig
CONFIG_MEM_POOL_COUNT=3
CONFIG_MEM_POOL1_BLOCK_SIZE=64
CONFIG_MEM_POOL1_BLOCK_COUNT=16
CONFIG_MEM_POOL2_BLOCK_SIZE=256
CONFIG_MEM_POOL2_BLOCK_COUNT=8
CONFIG_MEM_POOL3_BLOCK_SIZE=1024
CONFIG_MEM_POOL3_BLOCK_COUNT=4

CONFIG_GANTRY_EVENTS=y
CONFIG_GANTRY_STOW=y
CONFIG_ZCBOR=y

CONFIG_FLASH=y
CONFIG_FLASH_MAP=y
CONFIG_NVS=y
CONFIG_SETTINGS_NVS=y

# The test reloads within one run, so the flash needs no file, which some build directories can't map
CONFIG_NATIVE_EXTRA_CMDLINE_ARGS="--flash_in_ram"
```

## src/test_stow_storage.c
```c
/*
 * Copyright (c) 2026 Demizo
 *
 * SPDX-License-Identifier: Apache-2.0
 */

#include <gantry/stow/stow.h>
#include <generated_stow_items.h>
#include <zephyr/settings/settings.h>
#include <zephyr/ztest.h>

#include "generated_struct_Level.h"
#include "generated_struct_Setting.h"

static void* setup(void)
{
    /* At boot the Stow loads before native_sim's flash is ready */
    stow_init();
    return NULL;
}

ZTEST_SUITE(stow_storage, NULL, setup, NULL, NULL, NULL);

ZTEST(stow_storage, test_a_persisted_nested_struct_loads_again)
{
    Level_t level = { .value = 42 };
    Setting_t setting = { .level = &level, .flag = 1 };
    data_value_t value = { .type = STOW_ITEM_TYPE_STRUCT, .data.raw_value = &setting };
    zassert_ok(stow_set(STOW_ID_TEST_NESTED_SETTING, value));
    zassert_ok(stow_flush());

    stow_init();

    data_value_t loaded = { 0 };
    zassert_ok(stow_get(STOW_ID_TEST_NESTED_SETTING, &loaded));
    const Setting_t* got = loaded.data.raw_value;
    zassert_equal(got->level->value, 42, "the stored value did not load");
    zassert_equal(got->flag, 1);
    stow_release(STOW_ID_TEST_NESTED_SETTING, &loaded);
}

static ssize_t read_nothing(void* cb_arg, void* data, size_t len)
{
    ARG_UNUSED(cb_arg);
    ARG_UNUSED(data);
    ARG_UNUSED(len);
    return 0;
}

ZTEST(stow_storage, test_a_stored_value_that_reads_short_fails_its_load)
{
    struct settings_handler_static* handler = settings_parse_and_lookup("stow", NULL);
    zassert_not_null(handler);

    const char* name = g_stow_const_metadata[STOW_ID_TEST_NESTED_SETTING].name;
    size_t stored_len = 1;
    zassert_equal(handler->h_set(name, stored_len, read_nothing, NULL), -EIO);
}
```

## CMakeLists.txt
```
cmake_minimum_required(VERSION 3.20.0)

find_package(Zephyr REQUIRED HINTS $ENV{ZEPHYR_BASE})
project(stow_client_test)

set(GANTRY_ROOT ${CMAKE_CURRENT_SOURCE_DIR}/../..)
set(GANTRY_LIB ${GANTRY_ROOT}/lib)
set(GANTRY_INC ${GANTRY_ROOT}/include)

gantry_stow_generate(YAML stow.yaml)
gantry_stow_client_generate(PREFIX peer YAML stow.yaml)
gantry_stow_client_generate(PREFIX variant YAML variant/stow.yaml)

target_sources(app PRIVATE
    src/test_common.c
    src/test_stow_client_loopback.c
    src/test_stow_client_compat.c
    src/test_stow_client_faults.c
    src/test_stow_client_mux.c
    ${GANTRY_ROOT}/tests/common/stow_storage_stub.c
    ${GANTRY_LIB}/memory.c
    ${GANTRY_LIB}/event.c
    ${GANTRY_LIB}/stow/stow.c
    ${GANTRY_LIB}/stow/stow_event.c
    ${GANTRY_LIB}/stow/stow_msg.c
    ${GANTRY_LIB}/stow/stow_mux.c
    ${GANTRY_LIB}/stow/stow_cobs_transport.c
    ${GANTRY_LIB}/cobs_framer.c
    ${GANTRY_LIB}/stow/stow_protocol.c
    ${GANTRY_LIB}/stow/stow_runtime.c
    ${GANTRY_LIB}/stow/stow_client.c
    ${GANTRY_LIB}/stow/stow_client_slots.c
    ${GANTRY_LIB}/stow/stow_client_verify.c
    ${GANTRY_LIB}/stow/types/stow_type_enum.c
    ${GANTRY_LIB}/stow/types/stow_type_int.c
    ${GANTRY_LIB}/stow/types/stow_type_float.c
    ${GANTRY_LIB}/stow/types/stow_type_string.c
    ${GANTRY_LIB}/stow/types/stow_type_byte_array.c
    ${GANTRY_LIB}/stow/types/stow_type_buffer.c
)

target_include_directories(app PRIVATE
    ${GANTRY_INC}
    ${GANTRY_ROOT}/tests/common
)
```

## prj.conf
```kconfig
CONFIG_GANTRY_MEMORY=y
CONFIG_MEM_POOL_COUNT=3
CONFIG_MEM_POOL1_BLOCK_SIZE=64
CONFIG_MEM_POOL1_BLOCK_COUNT=32
CONFIG_MEM_POOL2_BLOCK_SIZE=256
CONFIG_MEM_POOL2_BLOCK_COUNT=16
CONFIG_MEM_POOL3_BLOCK_SIZE=1024
CONFIG_MEM_POOL3_BLOCK_COUNT=4

CONFIG_GANTRY_EVENTS=y
CONFIG_GANTRY_STOW=y
CONFIG_STOW_PROTOCOL=y
CONFIG_STOW_PROTOCOL_MAX_SESSIONS=4
CONFIG_STOW_PROTOCOL_QUEUE_SIZE=16
CONFIG_STOW_PROTOCOL_RESPONSE_CHECK=n
CONFIG_STOW_CLIENT=y
CONFIG_STOW_CLIENT_MAX_PEERS=3
CONFIG_STOW_CLIENT_MAX_PENDING=4
CONFIG_STOW_CLIENT_TIMEOUT_MS=200
CONFIG_STOW_CLIENT_THREAD_STACK_SIZE=4096

CONFIG_ZCBOR=y
CONFIG_NET_BUF=y
```

## src/test_common.c
```c
/*
 * Copyright (c) 2026 Demizo
 *
 * SPDX-License-Identifier: Apache-2.0
 */

#include "test_common.h"

#include <gantry/error.h>
#include <gantry/ownership.h>
#include <string.h>

NET_BUF_POOL_DEFINE(test_link_pool, 48, TEST_BUF_SIZE, 0, NULL);

struct held_message
{
    struct test_link* link;
    struct net_buf* buf;
};

K_MSGQ_DEFINE(test_held, sizeof(struct held_message), 16, sizeof(void*));
K_MSGQ_DEFINE(test_hooks, sizeof(struct test_hook_event), 32, sizeof(void*));
K_MSGQ_DEFINE(test_updates, sizeof(event_t*), 8, sizeof(void*));

STOW_CLIENT_ENDPOINT_DEFINE(test_peer_client, &peer_stow_client_schema, 0);
STOW_CLIENT_ENDPOINT_DEFINE(test_variant_client, &variant_stow_client_schema, 0);
static atomic_t block_disconnected;
K_SEM_DEFINE(disconnected_entered, 0, 1);
K_SEM_DEFINE(disconnected_gate, 0, 1);
size_t test_server_headroom;
size_t test_client_headroom;
static uint32_t next_session_id = 100;

static void record_hook(struct stow_client_peer* peer, enum test_hook hook, int err)
{
    struct test_hook_event event = { .peer = peer, .hook = hook, .err = err };
    zassert_equal(k_msgq_put(&test_hooks, &event, K_NO_WAIT), 0, "hook log full");
}

static void on_connected(struct stow_client_peer* peer, int err)
{
    struct stow_client_peer* held = stow_client_peer_ref(peer);
    record_hook(held, TEST_HOOK_CONNECTED, err);
    PASS_OWNERSHIP(held);
}

static void purge_hooks(void)
{
    struct test_hook_event event;
    while (k_msgq_get(&test_hooks, &event, K_NO_WAIT) == 0)
    {
        struct stow_client_peer* peer = event.peer;
        if (event.hook == TEST_HOOK_CONNECTED)
        {
            stow_client_peer_unref(&peer);
        }
    }
}

static void on_disconnected(struct stow_client_peer* peer)
{
    record_hook(peer, TEST_HOOK_DISCONNECTED, 0);
    if (atomic_cas(&block_disconnected, 1, 0))
    {
        k_sem_give(&disconnected_entered);
        (void)k_sem_take(&disconnected_gate, K_FOREVER);
    }
}

void test_block_disconnected(void)
{
    k_sem_reset(&disconnected_entered);
    k_sem_reset(&disconnected_gate);
    atomic_set(&block_disconnected, 1);
}

void test_await_blocked_disconnected(void)
{
    zassert_equal(k_sem_take(&disconnected_entered, TEST_WAIT), 0, "disconnected hook did not run");
}

void test_unblock_disconnected(void) { k_sem_give(&disconnected_gate); }

static void on_update(event_t* event)
{
    event_ref(event);
    if (k_msgq_put(&test_updates, &event, K_NO_WAIT) != 0)
    {
        event_unref(&event);
        zassert_unreachable("update log full");
    }
    PASS_OWNERSHIP(event);
}

static void purge_updates(void)
{
    event_t* event = NULL;
    while (k_msgq_get(&test_updates, &event, K_NO_WAIT) == 0)
    {
        event_unref(&event);
    }
}

STOW_CLIENT_CB_DEFINE(test_hooks_cb) = {
    .connected = on_connected,
    .disconnected = on_disconnected,
    .update = on_update,
};

static bool take_one(atomic_t* counter)
{
    atomic_val_t value = atomic_get(counter);
    while (value > 0)
    {
        if (atomic_cas(counter, value, value - 1))
        {
            return true;
        }
        value = atomic_get(counter);
    }
    return false;
}

static int send_to_server(struct stow_transport* transport, uint32_t session_id, struct net_buf* buf)
{
    struct test_link* link = CONTAINER_OF(transport, struct test_link, to_server);
    if (take_one(&link->refuse_requests))
    {
        return -ENOBUFS;
    }
    if (!take_one(&link->drop_requests))
    {
        stow_protocol_endpoint.receive(&stow_protocol_endpoint, session_id, buf);
    }
    net_buf_unref(buf);
    return SUCCESS;
}

static int send_to_client(struct stow_transport* transport, uint32_t session_id, struct net_buf* buf)
{
    struct test_link* link = CONTAINER_OF(transport, struct test_link, to_client);
    if (take_one(&link->drop_responses))
    {
        net_buf_unref(buf);
        return SUCCESS;
    }
    if (take_one(&link->hold_responses))
    {
        struct held_message held = { .link = link, .buf = buf };
        return (k_msgq_put(&test_held, &held, K_NO_WAIT) == 0) ? SUCCESS : -ENOBUFS;
    }

    link->client->endpoint.receive(&link->client->endpoint, session_id, buf);
    if (take_one(&link->duplicate_responses))
    {
        struct net_buf* copy_buf = net_buf_ref(buf);
        struct held_message copy = { .link = link, .buf = copy_buf };
        zassert_equal(k_msgq_put(&test_held, &copy, K_NO_WAIT), 0);
        PASS_OWNERSHIP(copy_buf);
    }
    net_buf_unref(buf);
    return SUCCESS;
}

void test_reset(void)
{
    stow_init();
    test_release_held();
    purge_hooks();
    purge_updates();
    test_server_headroom = 0;
    test_client_headroom = 0;
}

struct stow_client_peer* test_connect(
    struct test_link* link, const struct stow_client_endpoint* client, stow_role_t roles)
{
    test_link_init(link, client);
    zassert_equal(
        stow_protocol_endpoint.session_opened(&stow_protocol_endpoint, link->session_id, roles, &link->to_client), 0);
    zassert_equal(test_open_client(link), 0);

    struct test_hook_event event = test_next_hook(TEST_WAIT);
    zassert_equal(event.hook, TEST_HOOK_CONNECTED);
    zassert_equal(event.err, 0, "peer was not verified (%d)", event.err);
    zassert_equal(stow_client_peer_session_id(event.peer), link->session_id);
    zassert_equal_ptr(stow_client_peer_endpoint(event.peer), client);
    struct stow_client_peer* peer = event.peer;
    PASS_OWNERSHIP(peer);
    return peer;
}

int test_open_client(struct test_link* link)
{
    return link->client->endpoint.session_opened(&link->client->endpoint, link->session_id, 0, &link->to_server);
}

void test_link_init(struct test_link* link, const struct stow_client_endpoint* client)
{
    memset(link, 0, sizeof(*link));
    link->client = client;
    link->session_id = next_session_id++;
    link->to_server = (struct stow_transport){
        .send = send_to_server,
        .pool = &test_link_pool,
        .headroom = test_client_headroom,
    };
    link->to_client = (struct stow_transport){
        .send = send_to_client,
        .pool = &test_link_pool,
        .headroom = test_server_headroom,
    };
}

void test_close_client(struct test_link* link)
{
    link->client->endpoint.session_closed(&link->client->endpoint, link->session_id);
}

void test_disconnect(struct test_link* link, struct stow_client_peer** peer)
{
    stow_protocol_endpoint.session_closed(&stow_protocol_endpoint, link->session_id);
    test_close_client(link);
    test_release_held();
    test_settle();
    stow_client_peer_unref(peer);
    purge_hooks();
}

void test_release_held(void)
{
    struct held_message held;
    while (k_msgq_get(&test_held, &held, K_NO_WAIT) == 0)
    {
        struct net_buf* buf = held.buf;
        held.link->client->endpoint.receive(&held.link->client->endpoint, held.link->session_id, buf);
        net_buf_unref(buf);
    }
}

void test_await_held(uint32_t count)
{
    for (int i = 0; i < 200 && k_msgq_num_used_get(&test_held) < count; i++)
    {
        k_msleep(1);
    }
    zassert_equal(k_msgq_num_used_get(&test_held), count, "responses were not held");
}

int test_next_update(k_timeout_t timeout, event_t** event_out) { return k_msgq_get(&test_updates, event_out, timeout); }

struct test_hook_event test_next_hook(k_timeout_t timeout)
{
    struct test_hook_event event = { 0 };
    if (k_msgq_get(&test_hooks, &event, timeout) != 0)
    {
        return (struct test_hook_event){ .hook = TEST_HOOK_NONE };
    }
    return event;
}

void test_async_init(struct test_async* async)
{
    memset(async, 0, sizeof(*async));
    k_sem_init(&async->done, 0, 1);
}

void test_capture_cb(event_t* event, void* user_data)
{
    struct test_async* async = user_data;
    const struct stow_client_result_payload* result = (const struct stow_client_result_payload*)event->data.buf;
    async->err = result->err;
    async->index = result->index;
    async->count = result->count;
    if (result->count > 0U)
    {
        event_ref(event);
        async->event = event;
        PASS_OWNERSHIP(event);
    }
    k_sem_give(&async->done);
}

const struct stow_client_value* test_async_values(const struct test_async* async)
{
    return ((const struct stow_client_result_payload*)async->event->data.buf)->values;
}

void test_async_release(struct test_async* async)
{
    event_t* event = async->event;
    async->event = NULL;
    event_unref(&event);
}

uint32_t test_blocks_in_use(void)
{
    uint32_t total_used = 0;
    for (uint8_t pool = 0; pool < CONFIG_MEM_POOL_COUNT; pool++)
    {
        uint32_t used = 0;
        uint32_t total = 0;
        (void)mem_get_pool_usage(pool, &used, &total);
        total_used += used;
    }
    return total_used;
}
```

## src/test_common.h
```c
/*
 * Copyright (c) 2026 Demizo
 *
 * SPDX-License-Identifier: Apache-2.0
 */

#pragma once

#include <gantry/memory.h>
#include <gantry/stow/stow.h>
#include <gantry/stow/stow_client.h>
#include <gantry/stow/stow_protocol.h>
#include <gantry/stow/stow_transport.h>
#include <generated_peer_stow_client.h>
#include <generated_stow_enums.h>
#include <generated_stow_items.h>
#include <generated_variant_stow_client.h>
#include <stdint.h>
#include <zephyr/kernel.h>
#include <zephyr/net_buf.h>
#include <zephyr/sys/atomic.h>
#include <zephyr/ztest.h>

#include "test_settle.h"

/**
 * @brief Size of each buffer the links carry
 */
#define TEST_BUF_SIZE 256

/**
 * @brief How long tests wait for something the client should do promptly
 */
#define TEST_WAIT K_SECONDS(2)

/**
 * @brief Lifecycle hooks the tests record
 */
enum test_hook
{
    TEST_HOOK_NONE,
    TEST_HOOK_CONNECTED,
    TEST_HOOK_DISCONNECTED,
};

/**
 * @brief One recorded lifecycle hook
 */
struct test_hook_event
{
    struct stow_client_peer* peer;
    enum test_hook hook;
    int err;
};

/**
 * @brief A loopback link between the client and the server, with fault injection
 *
 * @details Each counter applies to that many of the next messages in its direction. A duplicated response is
 * delivered at once and its copy is held.
 */
struct test_link
{
    const struct stow_client_endpoint* client;
    struct stow_transport to_server;
    struct stow_transport to_client;
    uint32_t session_id;
    atomic_t drop_requests;
    atomic_t refuse_requests;
    atomic_t drop_responses;
    atomic_t duplicate_responses;
    atomic_t hold_responses;
};

/**
 * @brief The outcome of an asynchronous request, captured by @ref test_capture_cb
 */
struct test_async
{
    struct k_sem done;
    int err;
    uint16_t index;
    uint16_t count;
    event_t* event;
};

/**
 * @brief Start the Stow, the server and the client once, and clear test state
 */
void test_reset(void);

/**
 * @brief Client endpoint for peers bound with the test schema
 */
extern const struct stow_client_endpoint test_peer_client;

/**
 * @brief Client endpoint for peers bound with the variant schema
 */
extern const struct stow_client_endpoint test_variant_client;

/**
 * @brief Open a new link on a client endpoint and wait for its connected hook
 *
 * @param link Link to set up
 * @param client Client endpoint the session opens on
 * @param roles Roles the server grants the session
 *
 * @return A reference to the connected peer
 * @acquires stow_client_peer return
 */
struct stow_client_peer* test_connect(
    struct test_link* link, const struct stow_client_endpoint* client, stow_role_t roles);

/**
 * @brief Close both ends of a link and release the peer
 *
 * @param link The link
 * @param peer The reference to release
 * @releases stow_client_peer peer
 */
void test_disconnect(struct test_link* link, struct stow_client_peer** peer);

/**
 * @brief Close the link's session on the client side only
 *
 * @param link The link
 */
void test_close_client(struct test_link* link);

/**
 * @brief Deliver every held response
 */
void test_release_held(void);

/**
 * @brief Wait until a number of responses are held
 *
 * @param count Number of held responses to wait for
 */
void test_await_held(uint32_t count);

/**
 * @brief Make the next disconnected hook block the client thread until @ref test_unblock_disconnected
 */
void test_block_disconnected(void);

/**
 * @brief Wait until the client thread is blocked in the disconnected hook
 */
void test_await_blocked_disconnected(void);

/**
 * @brief Let the client thread leave the disconnected hook
 */
void test_unblock_disconnected(void);

/**
 * @brief Prepare a link without connecting it
 *
 * @param link Link to set up
 * @param client Client endpoint the link's sessions open on
 */
void test_link_init(struct test_link* link, const struct stow_client_endpoint* client);

/**
 * @brief Open the client end of a link
 *
 * @param link The link
 *
 * @return The endpoint's result
 */
int test_open_client(struct test_link* link);

/**
 * @brief Headroom the server's side of new links reserves, which shrinks the largest message the server reports
 */
extern size_t test_server_headroom;

/**
 * @brief Headroom the client's side of new links reserves, which shrinks the requests the client can build
 */
extern size_t test_client_headroom;

/**
 * @brief Wait for the next Update event the hooks kept
 *
 * @param timeout How long to wait
 * @param[out] event_out The event, for the caller to release
 *
 * @return 0 when an Update arrived, otherwise a negative errno
 * @acquires memory event_out on-success
 */
int test_next_update(k_timeout_t timeout, event_t** event_out);

/**
 * @brief Wait for the next recorded lifecycle hook
 *
 * @details A connected hook's event holds a reference to its peer, which the caller releases.
 *
 * @param timeout How long to wait
 *
 * @return The hook, or one with @ref TEST_HOOK_NONE on timeout
 */
struct test_hook_event test_next_hook(k_timeout_t timeout);

/**
 * @brief Callback that records an asynchronous outcome into a @ref test_async, keeping the event when it has values
 */
void test_capture_cb(event_t* event, void* user_data);

/**
 * @brief Prepare a @ref test_async for a request
 *
 * @param async The capture
 */
void test_async_init(struct test_async* async);

/**
 * @brief The values of a captured Get
 *
 * @param async The capture
 *
 * @return The values, valid until @ref test_async_release
 */
const struct stow_client_value* test_async_values(const struct test_async* async);

/**
 * @brief Release the result event a @ref test_async kept
 *
 * @param async The capture
 */
void test_async_release(struct test_async* async);

/**
 * @brief Blocks in use across every memory pool
 *
 * @return Number of blocks allocated
 */
uint32_t test_blocks_in_use(void);
```

## src/test_stow_client_compat.c
```c
/*
 * Copyright (c) 2026 Demizo
 *
 * SPDX-License-Identifier: Apache-2.0
 */

#include "test_common.h"

static struct test_link link;
static struct stow_client_peer* peer;

static void before_each(void* fixture)
{
    ARG_UNUSED(fixture);
    test_reset();
    peer = test_connect(&link, &test_variant_client, STOW_ROLE_GUEST);
}

static void after_each(void* fixture)
{
    ARG_UNUSED(fixture);
    test_disconnect(&link, &peer);
}

ZTEST_SUITE(stow_client_compat, NULL, NULL, before_each, after_each, NULL);

ZTEST(stow_client_compat, test_items_are_matched_by_name_type_and_constraints)
{
    zassert_equal(stow_client_availability(peer, VARIANT_ID_GONE), STOW_CLIENT_MISSING);
    zassert_equal(stow_client_availability(peer, VARIANT_ID_RATIO), STOW_CLIENT_INCOMPATIBLE, "type changed");
    zassert_equal(stow_client_availability(peer, VARIANT_ID_LABEL), STOW_CLIENT_INCOMPATIBLE, "constraints changed");
    zassert_equal(stow_client_availability(peer, VARIANT_ID_POSITION), STOW_CLIENT_INCOMPATIBLE, "struct changed");
    zassert_equal(stow_client_availability(peer, VARIANT_ID_ONCE), STOW_CLIENT_AVAILABLE);
    zassert_equal(stow_client_availability(peer, VARIANT_ID_MODE), STOW_CLIENT_AVAILABLE);
    zassert_equal(stow_client_availability(peer, VARIANT_ID_COUNTER), STOW_CLIENT_AVAILABLE);
}

ZTEST(stow_client_compat, test_unavailable_items_are_not_supported)
{
    uint32_t blocks = test_blocks_in_use();
    const uint16_t unavailable[] = { VARIANT_ID_GONE, VARIANT_ID_RATIO, VARIANT_ID_LABEL, VARIANT_ID_POSITION };
    for (size_t i = 0; i < ARRAY_SIZE(unavailable); i++)
    {
        struct stow_client_value value;
        zassert_equal(stow_client_get(peer, &unavailable[i], 1, &value), -ENOTSUP, "item %u", unavailable[i]);
    }

    const uint16_t mixed[] = { VARIANT_ID_COUNTER, VARIANT_ID_GONE };
    struct stow_client_value values[2];
    zassert_equal(stow_client_get(peer, mixed, 2, values), -ENOTSUP);
    zassert_equal(test_blocks_in_use(), blocks);
}

ZTEST(stow_client_compat, test_a_peer_with_small_messages_is_verified_in_several_describes)
{
    test_disconnect(&link, &peer);
    test_server_headroom = TEST_BUF_SIZE - 128;
    test_client_headroom = TEST_BUF_SIZE - 40;
    peer = test_connect(&link, &test_variant_client, STOW_ROLE_GUEST);

    struct stow_client_peer_info info;
    zassert_equal(stow_client_peer_info(peer, &info), 0);
    zassert_equal(info.max_message, 128);
    zassert_equal(stow_client_availability(peer, VARIANT_ID_GONE), STOW_CLIENT_MISSING);
    zassert_equal(stow_client_availability(peer, VARIANT_ID_ONCE), STOW_CLIENT_AVAILABLE);
    zassert_equal(stow_client_availability(peer, VARIANT_ID_MODE), STOW_CLIENT_AVAILABLE);
    zassert_equal(stow_client_availability(peer, VARIANT_ID_LABEL), STOW_CLIENT_INCOMPATIBLE);
    zassert_equal(stow_client_availability(peer, VARIANT_ID_COUNTER), STOW_CLIENT_AVAILABLE);
}

ZTEST(stow_client_compat, test_remapped_items_keep_working)
{
    const uint16_t ids[] = { VARIANT_ID_COUNTER, VARIANT_ID_MODE };
    const data_value_t values[] = {
        { .type = STOW_ITEM_TYPE_INT, .data.int_value = -9 },
        { .type = STOW_ITEM_TYPE_ENUM, .data.int_value = variant_Mode_AUTO },
    };
    zassert_equal(stow_client_set(peer, ids, values, 2), 0);

    data_value_t local;
    zassert_equal(stow_get(STOW_ID_COUNTER, &local), 0);
    zassert_equal(local.data.int_value, -9);
    zassert_equal(stow_get(STOW_ID_MODE, &local), 0);
    zassert_equal(local.data.int_value, Mode_AUTO);

    struct stow_client_value got[2];
    zassert_equal(stow_client_get(peer, ids, 2, got), 0);
    zassert_equal(got[0].id, VARIANT_ID_COUNTER);
    zassert_equal(got[0].value.data.int_value, -9);
    zassert_equal(got[1].value.data.int_value, variant_Mode_AUTO);
}
```

## src/test_stow_client_faults.c
```c
/*
 * Copyright (c) 2026 Demizo
 *
 * SPDX-License-Identifier: Apache-2.0
 */

#include <gantry/ownership.h>
#include <gantry/stow/stow_msg.h>

#include "test_common.h"

static struct test_link link;
static struct stow_client_peer* peer;

static void before_each(void* fixture)
{
    ARG_UNUSED(fixture);
    test_reset();
    peer = test_connect(&link, &test_peer_client, STOW_ROLE_GUEST);
}

static void after_each(void* fixture)
{
    ARG_UNUSED(fixture);
    test_disconnect(&link, &peer);
}

ZTEST_SUITE(stow_client_faults, NULL, NULL, before_each, after_each, NULL);

static const uint16_t counter_id = PEER_ID_COUNTER;
static const uint16_t mode_id = PEER_ID_MODE;

static void set_counter(int value)
{
    zassert_equal(stow_set(STOW_ID_COUNTER, (data_value_t){ .type = STOW_ITEM_TYPE_INT, .data.int_value = value }), 0);
}

static int get_counter(void)
{
    struct stow_client_value value = { 0 };
    zassert_equal(stow_client_get(peer, &counter_id, 1, &value), 0);
    int counter = value.value.data.int_value;
    stow_client_release(&test_peer_client, &value);
    return counter;
}

ZTEST(stow_client_faults, test_a_timeout_fails_only_its_request)
{
    struct test_async dropped;
    struct test_async answered;
    test_async_init(&dropped);
    test_async_init(&answered);

    atomic_set(&link.drop_requests, 1);
    zassert_equal(stow_client_get_async(peer, &counter_id, 1, test_capture_cb, &dropped), 0);
    zassert_equal(stow_client_get_async(peer, &mode_id, 1, test_capture_cb, &answered), 0);

    zassert_equal(k_sem_take(&answered.done, K_MSEC(100)), 0);
    zassert_equal(answered.err, 0);
    test_async_release(&answered);
    zassert_equal(k_sem_take(&dropped.done, TEST_WAIT), 0);
    zassert_equal(dropped.err, -ETIMEDOUT);
}

ZTEST(stow_client_faults, test_a_duplicate_response_never_completes_a_live_request)
{
    set_counter(7);
    zassert_equal(stow_set(STOW_ID_MODE, (data_value_t){ .type = STOW_ITEM_TYPE_ENUM, .data.int_value = Mode_ON }), 0);
    atomic_set(&link.duplicate_responses, 1);
    zassert_equal(get_counter(), 7);

    struct test_async live;
    test_async_init(&live);
    atomic_set(&link.hold_responses, 1);
    zassert_equal(stow_client_get_async(peer, &mode_id, 1, test_capture_cb, &live), 0);
    test_await_held(2);
    test_release_held();

    zassert_equal(k_sem_take(&live.done, TEST_WAIT), 0);
    zassert_equal(live.err, 0);
    zassert_equal(test_async_values(&live)[0].id, PEER_ID_MODE, "answered with the duplicated Counter response");
    zassert_equal(test_async_values(&live)[0].value.data.int_value, peer_Mode_ON);
    test_async_release(&live);
    zassert_equal(get_counter(), 7);
}

ZTEST(stow_client_faults, test_a_refused_send_fails_at_once)
{
    atomic_set(&link.refuse_requests, 1);
    struct stow_client_value value;
    int64_t start = k_uptime_get();
    zassert_equal(stow_client_get(peer, &counter_id, 1, &value), -EBUSY);
    zassert_true(k_uptime_get() - start < CONFIG_STOW_CLIENT_TIMEOUT_MS / 2, "waited for a timeout");

    set_counter(4);
    zassert_equal(get_counter(), 4);

    struct test_link refused;
    test_link_init(&refused, &test_peer_client);
    atomic_set(&refused.refuse_requests, 1);
    zassert_equal(test_open_client(&refused), 0);
    struct test_hook_event event = test_next_hook(TEST_WAIT);
    zassert_equal(event.hook, TEST_HOOK_CONNECTED);
    zassert_equal(event.err, -EBUSY, "a refused Hello did not fail verification");
    struct stow_client_peer* failed = event.peer;
    PASS_OWNERSHIP(failed);
    test_close_client(&refused);
    test_settle();
    stow_client_peer_unref(&failed);
}

ZTEST(stow_client_faults, test_closing_fails_every_pending_request_before_the_hook)
{
    struct test_async pending[3];
    atomic_set(&link.hold_responses, ARRAY_SIZE(pending));
    for (size_t i = 0; i < ARRAY_SIZE(pending); i++)
    {
        test_async_init(&pending[i]);
        zassert_equal(stow_client_get_async(peer, &counter_id, 1, test_capture_cb, &pending[i]), 0);
    }
    test_await_held(ARRAY_SIZE(pending));

    test_close_client(&link);
    struct test_hook_event event = test_next_hook(TEST_WAIT);
    zassert_equal(event.hook, TEST_HOOK_DISCONNECTED);
    for (size_t i = 0; i < ARRAY_SIZE(pending); i++)
    {
        zassert_equal(k_sem_take(&pending[i].done, K_NO_WAIT), 0, "request %zu still pending at the hook", i);
        zassert_equal(pending[i].err, -ENOTCONN);
    }
}

ZTEST(stow_client_faults, test_a_late_response_never_completes_a_newer_request)
{
    struct test_async late;
    test_async_init(&late);
    atomic_set(&link.hold_responses, 1);
    zassert_equal(stow_client_get_async(peer, &counter_id, 1, test_capture_cb, &late), 0);
    zassert_equal(k_sem_take(&late.done, TEST_WAIT), 0);
    zassert_equal(late.err, -ETIMEDOUT);

    for (uint32_t i = 0; i < STOW_TAG_MAX; i++)
    {
        (void)get_counter();
    }

    struct test_async newer;
    test_async_init(&newer);
    atomic_set(&link.hold_responses, 1);
    zassert_equal(stow_client_get_async(peer, &mode_id, 1, test_capture_cb, &newer), 0);
    test_await_held(2);
    test_release_held();

    zassert_equal(k_sem_take(&newer.done, TEST_WAIT), 0);
    zassert_equal(newer.err, 0);
    zassert_equal(test_async_values(&newer)[0].id, PEER_ID_MODE, "completed by the late response");
    test_async_release(&newer);
}

static void fill_table(struct test_async* pending, size_t count)
{
    atomic_set(&link.hold_responses, count);
    for (size_t i = 0; i < count; i++)
    {
        test_async_init(&pending[i]);
        zassert_equal(stow_client_get_async(peer, &counter_id, 1, test_capture_cb, &pending[i]), 0);
    }
}

ZTEST(stow_client_faults, test_a_full_table_makes_async_calls_try_again)
{
    struct test_async pending[CONFIG_STOW_CLIENT_MAX_PENDING];
    fill_table(pending, ARRAY_SIZE(pending));

    struct test_async extra;
    test_async_init(&extra);
    zassert_equal(stow_client_get_async(peer, &counter_id, 1, test_capture_cb, &extra), -EAGAIN);
    for (size_t i = 0; i < ARRAY_SIZE(pending); i++)
    {
        zassert_equal(k_sem_take(&pending[i].done, TEST_WAIT), 0);
        zassert_equal(pending[i].err, -ETIMEDOUT);
    }
}

ZTEST(stow_client_faults, test_a_full_table_makes_sync_calls_wait)
{
    struct test_async pending[CONFIG_STOW_CLIENT_MAX_PENDING];
    fill_table(pending, ARRAY_SIZE(pending));

    set_counter(6);
    zassert_equal(get_counter(), 6, "sync call did not wait for a free slot");
    for (size_t i = 0; i < ARRAY_SIZE(pending); i++)
    {
        zassert_equal(k_sem_take(&pending[i].done, K_NO_WAIT), 0);
        zassert_equal(pending[i].err, -ETIMEDOUT);
    }
}

ZTEST(stow_client_faults, test_a_message_queued_before_a_reopen_is_dropped)
{
    struct test_async pending;
    test_async_init(&pending);
    atomic_set(&link.hold_responses, 1);
    zassert_equal(stow_client_get_async(peer, &counter_id, 1, test_capture_cb, &pending), 0);
    test_await_held(1);

    const uint8_t stale_hello[] = { 0x84, STOW_MSG_HELLO_RESPONSE, 0x00, 0x18, 0x63, 0xA0 };
    struct net_buf* stale = net_buf_alloc(link.to_client.pool, K_NO_WAIT);
    zassert_not_null(stale);
    net_buf_add_mem(stale, stale_hello, sizeof(stale_hello));
    test_peer_client.endpoint.receive(&test_peer_client.endpoint, link.session_id, stale);
    net_buf_unref(stale);

    test_block_disconnected();
    test_close_client(&link);
    test_await_blocked_disconnected();
    zassert_equal(test_open_client(&link), 0);
    test_unblock_disconnected();

    zassert_equal(test_next_hook(TEST_WAIT).hook, TEST_HOOK_DISCONNECTED);
    struct test_hook_event event = test_next_hook(TEST_WAIT);
    zassert_equal(event.hook, TEST_HOOK_CONNECTED);
    zassert_equal(event.err, 0, "verified with the earlier session's message (%d)", event.err);
    struct stow_client_peer* reopened = event.peer;
    stow_client_peer_unref(&reopened);
    zassert_equal(pending.err, -ENOTCONN);
}

ZTEST(stow_client_faults, test_a_session_can_reopen_before_its_close_is_handled)
{
    test_close_client(&link);
    zassert_equal(test_open_client(&link), 0, "the closing session blocked the reopen");

    zassert_equal(test_next_hook(TEST_WAIT).hook, TEST_HOOK_DISCONNECTED);
    struct test_hook_event event = test_next_hook(TEST_WAIT);
    zassert_equal(event.hook, TEST_HOOK_CONNECTED);
    zassert_equal(event.err, 0);
    struct stow_client_peer* reopened = event.peer;
    stow_client_peer_unref(&reopened);
}

ZTEST(stow_client_faults, test_a_late_response_after_a_reopen_never_completes_a_request)
{
    struct test_async old_get;
    test_async_init(&old_get);
    atomic_set(&link.hold_responses, 1);
    zassert_equal(stow_client_get_async(peer, &counter_id, 1, test_capture_cb, &old_get), 0);
    test_await_held(1);

    test_close_client(&link);
    zassert_equal(k_sem_take(&old_get.done, TEST_WAIT), 0);
    zassert_equal(old_get.err, -ENOTCONN);
    zassert_equal(test_next_hook(TEST_WAIT).hook, TEST_HOOK_DISCONNECTED);

    zassert_equal(test_open_client(&link), 0);
    struct test_hook_event event = test_next_hook(TEST_WAIT);
    zassert_equal(event.hook, TEST_HOOK_CONNECTED);
    zassert_equal(event.err, 0);
    struct stow_client_peer* reopened = event.peer;
    PASS_OWNERSHIP(reopened);

    struct test_async new_get;
    test_async_init(&new_get);
    atomic_set(&link.drop_requests, 1);
    zassert_equal(stow_client_get_async(reopened, &mode_id, 1, test_capture_cb, &new_get), 0);
    test_settle();
    test_release_held();

    zassert_equal(k_sem_take(&new_get.done, TEST_WAIT), 0);
    zassert_equal(new_get.err, -ETIMEDOUT, "the late response completed a new request (%d)", new_get.err);

    stow_client_peer_unref(&peer);
    peer = reopened;
}

ZTEST(stow_client_faults, test_a_peer_that_cannot_be_verified_is_reported)
{
    struct test_link silent;
    test_link_init(&silent, &test_peer_client);
    atomic_set(&silent.drop_responses, 1);
    zassert_equal(
        stow_protocol_endpoint.session_opened(
            &stow_protocol_endpoint, silent.session_id, STOW_ROLE_GUEST, &silent.to_client),
        0);
    zassert_equal(test_open_client(&silent), 0);
    zassert_equal(test_open_client(&silent), -EALREADY);

    struct test_hook_event event = test_next_hook(TEST_WAIT);
    zassert_equal(event.hook, TEST_HOOK_CONNECTED);
    zassert_equal(event.err, -ETIMEDOUT);
    struct stow_client_peer* unverified = event.peer;

    struct stow_client_value value;
    zassert_equal(stow_client_get(unverified, &counter_id, 1, &value), -ENOTCONN);
    test_close_client(&silent);
    zassert_equal(test_next_hook(K_MSEC(50)).hook, TEST_HOOK_NONE, "a failed peer reported a disconnect");
    test_disconnect(&silent, &unverified);
    zassert_is_null(unverified);
}
```

## src/test_stow_client_loopback.c
```c
/*
 * Copyright (c) 2026 Demizo
 *
 * SPDX-License-Identifier: Apache-2.0
 */

#include <string.h>

#include "test_common.h"

static struct test_link link;
static struct stow_client_peer* peer;

static void before_each(void* fixture)
{
    ARG_UNUSED(fixture);
    test_reset();
    peer = test_connect(&link, &test_peer_client, STOW_ROLE_GUEST);
}

static void after_each(void* fixture)
{
    ARG_UNUSED(fixture);
    test_disconnect(&link, &peer);
}

ZTEST_SUITE(stow_client_loopback, NULL, NULL, before_each, after_each, NULL);

ZTEST(stow_client_loopback, test_a_connected_peer_reports_its_items_and_limits)
{
    for (uint16_t id = 0; id < PEER_ID_COUNT; id++)
    {
        enum stow_client_availability expected =
            (id == PEER_ID_FIRMWARE_VERSION) ? STOW_CLIENT_MISSING : STOW_CLIENT_AVAILABLE;
        zassert_equal(stow_client_availability(peer, id), expected, "item %u", id);
    }

    struct stow_client_peer_info info;
    zassert_equal(stow_client_peer_info(peer, &info), 0);
    zassert_equal(info.max_message, TEST_BUF_SIZE);
    zassert_equal(info.roles, PEER_ROLE_GUEST);
}

ZTEST(stow_client_loopback, test_int_float_and_enum_round_trip)
{
    zassert_equal(
        stow_client_set_one(peer, PEER_ID_COUNTER, (data_value_t){ .type = STOW_ITEM_TYPE_INT, .data.int_value = -42 }),
        0);
    zassert_equal(
        stow_client_set_one(
            peer, PEER_ID_RATIO, (data_value_t){ .type = STOW_ITEM_TYPE_FLOAT, .data.float_value = 2.25f }),
        0);
    zassert_equal(
        stow_client_set_one(
            peer, PEER_ID_MODE, (data_value_t){ .type = STOW_ITEM_TYPE_ENUM, .data.int_value = peer_Mode_AUTO }),
        0);

    struct stow_client_value value;
    zassert_equal(stow_client_get_one(peer, PEER_ID_COUNTER, &value), 0);
    zassert_equal(value.value.data.int_value, -42);
    stow_client_release(&test_peer_client, &value);
    zassert_equal(stow_client_get_one(peer, PEER_ID_RATIO, &value), 0);
    zassert_equal(value.value.data.float_value, 2.25f);
    stow_client_release(&test_peer_client, &value);
    zassert_equal(stow_client_get_one(peer, PEER_ID_MODE, &value), 0);
    zassert_equal(value.value.data.int_value, peer_Mode_AUTO);
    stow_client_release(&test_peer_client, &value);

    data_value_t local;
    zassert_equal(stow_get(STOW_ID_COUNTER, &local), 0);
    zassert_equal(local.data.int_value, -42);
}

ZTEST(stow_client_loopback, test_string_bytes_and_buffer_round_trip)
{
    uint32_t blocks = test_blocks_in_use();

    zassert_equal(
        stow_client_set_one(
            peer, PEER_ID_LABEL, (data_value_t){ .type = STOW_ITEM_TYPE_STRING, .data.string_value = "remote" }),
        0);

    buffer_t* code = NULL;
    zassert_equal(mem_alloc(sizeof(buffer_t) + 4, (void**)&code), 0);
    code->len = 4;
    memcpy(code->buf, "\x0A\x0B\x0C\x0D", 4);
    zassert_equal(
        stow_client_set_one(
            peer, PEER_ID_CODE, (data_value_t){ .type = STOW_ITEM_TYPE_BYTE_ARRAY, .data.buffer_value = code }),
        0);
    zassert_equal(
        stow_client_set_one(
            peer, PEER_ID_BLOB, (data_value_t){ .type = STOW_ITEM_TYPE_BUFFER, .data.buffer_value = code }),
        0);
    void* block = code;
    mem_unref(&block);

    struct stow_client_value value;
    zassert_equal(stow_client_get_one(peer, PEER_ID_LABEL, &value), 0);
    zassert_equal(value.id, PEER_ID_LABEL);
    zassert_str_equal(value.value.data.string_value, "remote");
    stow_client_release(&test_peer_client, &value);

    zassert_equal(stow_client_get_one(peer, PEER_ID_CODE, &value), 0);
    zassert_equal(value.value.data.buffer_value->len, 4);
    zassert_mem_equal(value.value.data.buffer_value->buf, "\x0A\x0B\x0C\x0D", 4);
    stow_client_release(&test_peer_client, &value);

    zassert_equal(stow_client_get_one(peer, PEER_ID_BLOB, &value), 0);
    zassert_equal(value.value.data.buffer_value->len, 4);
    stow_client_release(&test_peer_client, &value);

    zassert_equal(test_blocks_in_use(), blocks, "values leaked");
}

ZTEST(stow_client_loopback, test_struct_round_trip)
{
    uint32_t blocks = test_blocks_in_use();
    peer_Point_t point = { .x = 3, .y = -4, .label = "here" };
    zassert_equal(
        stow_client_set_one(
            peer, PEER_ID_POSITION, (data_value_t){ .type = STOW_ITEM_TYPE_STRUCT, .data.raw_value = &point }),
        0);

    struct stow_client_value value;
    zassert_equal(stow_client_get_one(peer, PEER_ID_POSITION, &value), 0);
    const peer_Point_t* got = value.value.data.raw_value;
    zassert_equal(got->x, 3);
    zassert_equal(got->y, -4);
    zassert_str_equal(got->label, "here");
    stow_client_release(&test_peer_client, &value);

    data_value_t local;
    zassert_equal(stow_get(STOW_ID_POSITION, &local), 0);
    zassert_equal(((const Point_t*)local.data.raw_value)->y, -4);
    stow_release(STOW_ID_POSITION, &local);

    zassert_equal(test_blocks_in_use(), blocks, "values leaked");
}

ZTEST(stow_client_loopback, test_a_local_struct_value_is_set_on_the_peer_as_is)
{
    Point_t local = { .x = 9, .y = 8, .label = "same" };
    peer_Point_t* shared = &local;
    zassert_equal(
        stow_client_set_one(
            peer, PEER_ID_POSITION, (data_value_t){ .type = STOW_ITEM_TYPE_STRUCT, .data.raw_value = shared }),
        0);

    data_value_t value;
    zassert_equal(stow_get(STOW_ID_POSITION, &value), 0);
    const Point_t* stored = value.data.raw_value;
    zassert_equal(stored->x, 9);
    zassert_str_equal(stored->label, "same");
    stow_release(STOW_ID_POSITION, &value);
}

ZTEST(stow_client_loopback, test_an_item_too_large_to_describe_is_incompatible)
{
    test_disconnect(&link, &peer);
    test_server_headroom = TEST_BUF_SIZE - 128;
    peer = test_connect(&link, &test_peer_client, STOW_ROLE_GUEST);

    zassert_equal(stow_client_availability(peer, PEER_ID_SHADE), STOW_CLIENT_INCOMPATIBLE);
    zassert_equal(stow_client_availability(peer, PEER_ID_POSITION), STOW_CLIENT_AVAILABLE);
    zassert_equal(stow_client_availability(peer, PEER_ID_COUNTER), STOW_CLIENT_AVAILABLE);

    struct stow_client_value value;
    zassert_equal(stow_client_get_one(peer, PEER_ID_COUNTER, &value), 0);
    stow_client_release(&test_peer_client, &value);
}

ZTEST(stow_client_loopback, test_several_items_in_one_request)
{
    const uint16_t ids[] = { PEER_ID_COUNTER, PEER_ID_MODE, PEER_ID_LOCKED };
    const data_value_t values[] = {
        { .type = STOW_ITEM_TYPE_INT, .data.int_value = 7 },
        { .type = STOW_ITEM_TYPE_ENUM, .data.int_value = peer_Mode_ON },
    };
    zassert_equal(stow_client_set(peer, ids, values, 2), 0);

    struct stow_client_value got[3];
    zassert_equal(stow_client_get(peer, ids, 3, got), 0);
    zassert_equal(got[0].value.data.int_value, 7);
    zassert_equal(got[1].id, PEER_ID_MODE);
    zassert_equal(got[1].value.data.int_value, peer_Mode_ON);
    zassert_equal(got[2].value.data.int_value, 3);
    for (size_t i = 0; i < ARRAY_SIZE(got); i++)
    {
        struct stow_client_value* entry = &got[i];
        stow_client_release(&test_peer_client, entry);
    }
}

ZTEST(stow_client_loopback, test_values_are_checked_before_sending)
{
    zassert_equal(
        stow_client_set_one(peer, PEER_ID_COUNTER, (data_value_t){ .type = STOW_ITEM_TYPE_INT, .data.int_value = 101 }),
        -EINVAL);
    zassert_equal(
        stow_client_set_one(
            peer, PEER_ID_COUNTER, (data_value_t){ .type = STOW_ITEM_TYPE_FLOAT, .data.float_value = 1.0f }),
        -EINVAL);
    zassert_equal(stow_client_set_one(peer, PEER_ID_COUNT, (data_value_t){ .type = STOW_ITEM_TYPE_INT }), -EINVAL);
    zassert_equal(stow_client_get(peer, NULL, 0, NULL), -EINVAL);
}

ZTEST(stow_client_loopback, test_peer_errors_are_passed_through)
{
    zassert_equal(
        stow_client_set_one(peer, PEER_ID_LOCKED, (data_value_t){ .type = STOW_ITEM_TYPE_INT, .data.int_value = 1 }),
        -EACCES);

    zassert_equal(
        stow_client_set_one(
            peer, PEER_ID_ONCE, (data_value_t){ .type = STOW_ITEM_TYPE_STRING, .data.string_value = "a" }),
        0);
    zassert_equal(
        stow_client_set_one(
            peer, PEER_ID_ONCE, (data_value_t){ .type = STOW_ITEM_TYPE_STRING, .data.string_value = "b" }),
        -EALREADY);

    const uint16_t ids[] = { PEER_ID_COUNTER, PEER_ID_LOCKED };
    const data_value_t values[] = {
        { .type = STOW_ITEM_TYPE_INT, .data.int_value = 9 },
        { .type = STOW_ITEM_TYPE_INT, .data.int_value = 1 },
    };
    struct test_async async;
    test_async_init(&async);
    zassert_equal(stow_client_set_async(peer, ids, values, 2, test_capture_cb, &async), 0);
    zassert_equal(k_sem_take(&async.done, TEST_WAIT), 0);
    zassert_equal(async.err, -EACCES);
    zassert_equal(async.index, 1, "the first entry was applied");

    struct stow_client_value value;
    zassert_equal(stow_client_get_one(peer, PEER_ID_COUNTER, &value), 0);
    zassert_equal(value.value.data.int_value, 9);
    stow_client_release(&test_peer_client, &value);
}

ZTEST(stow_client_loopback, test_requests_beyond_the_peer_limits_fail)
{
    buffer_t* blob = NULL;
    zassert_equal(mem_alloc(sizeof(buffer_t) + TEST_BUF_SIZE / 2, (void**)&blob), 0);
    blob->len = TEST_BUF_SIZE / 2;
    memset(blob->buf, 0x5A, blob->len);

    const uint16_t ids[] = { PEER_ID_BLOB, PEER_ID_BLOB };
    const data_value_t values[] = {
        { .type = STOW_ITEM_TYPE_BUFFER, .data.buffer_value = blob },
        { .type = STOW_ITEM_TYPE_BUFFER, .data.buffer_value = blob },
    };
    zassert_equal(stow_client_set(peer, ids, values, 2), -EMSGSIZE);
    zassert_equal(stow_client_set(peer, ids, values, 1), 0);
    void* block = blob;
    mem_unref(&block);

    struct stow_client_value got[2];
    zassert_equal(stow_client_get(peer, ids, 2, got), -E2BIG);
}

ZTEST(stow_client_loopback, test_subscribed_updates_arrive_as_events_until_unsubscribed)
{
    uint32_t blocks = test_blocks_in_use();
    const uint16_t ids[] = { PEER_ID_COUNTER, PEER_ID_POSITION };
    zassert_equal(stow_client_subscribe(peer, ids, 2), 0);

    event_t* event = NULL;
    zassert_equal(stow_set(STOW_ID_COUNTER, (data_value_t){ .type = STOW_ITEM_TYPE_INT, .data.int_value = 55 }), 0);
    zassert_equal(test_next_update(TEST_WAIT, &event), 0);
    const struct stow_client_update_payload* update = (const struct stow_client_update_payload*)event->data.buf;
    zassert_equal_ptr(update->peer, peer);
    zassert_equal(update->value.id, PEER_ID_COUNTER);
    zassert_equal(update->value.value.data.int_value, 55);
    event_unref(&event);

    Point_t point = { .x = 1, .y = 2, .label = "kept" };
    zassert_equal(
        stow_set(STOW_ID_POSITION, (data_value_t){ .type = STOW_ITEM_TYPE_STRUCT, .data.raw_value = &point }), 0);
    zassert_equal(test_next_update(TEST_WAIT, &event), 0);
    test_settle();
    update = (const struct stow_client_update_payload*)event->data.buf;
    zassert_equal(update->value.id, PEER_ID_POSITION);
    zassert_str_equal(((const peer_Point_t*)update->value.value.data.raw_value)->label, "kept");
    event_unref(&event);

    zassert_equal(stow_client_unsubscribe(peer, ids, 2), 0);
    zassert_equal(stow_set(STOW_ID_COUNTER, (data_value_t){ .type = STOW_ITEM_TYPE_INT, .data.int_value = 56 }), 0);
    zassert_not_equal(test_next_update(K_MSEC(100), &event), 0, "Update after unsubscribing");
    zassert_equal(test_blocks_in_use(), blocks, "event or value leaked");
}

ZTEST(stow_client_loopback, test_a_value_kept_with_a_reference_outlives_its_event)
{
    uint32_t blocks = test_blocks_in_use();
    zassert_equal(stow_client_subscribe_one(peer, PEER_ID_POSITION), 0);
    Point_t point = { .x = 3, .y = 4, .label = "ref" };
    zassert_equal(
        stow_set(STOW_ID_POSITION, (data_value_t){ .type = STOW_ITEM_TYPE_STRUCT, .data.raw_value = &point }), 0);

    event_t* event = NULL;
    zassert_equal(test_next_update(TEST_WAIT, &event), 0);
    struct stow_client_value kept = ((const struct stow_client_update_payload*)event->data.buf)->value;
    stow_client_ref(&test_peer_client, &kept);
    event_unref(&event);

    zassert_str_equal(((const peer_Point_t*)kept.value.data.raw_value)->label, "ref");
    stow_client_release(&test_peer_client, &kept);
    zassert_equal(stow_client_unsubscribe_one(peer, PEER_ID_POSITION), 0);
    zassert_equal(test_blocks_in_use(), blocks, "event or value leaked");
}

ZTEST(stow_client_loopback, test_an_async_get_delivers_its_values_in_a_result_event)
{
    uint32_t blocks = test_blocks_in_use();
    zassert_equal(stow_set(STOW_ID_COUNTER, (data_value_t){ .type = STOW_ITEM_TYPE_INT, .data.int_value = 12 }), 0);
    Point_t point = { .x = 5, .y = 6, .label = "async" };
    zassert_equal(
        stow_set(STOW_ID_POSITION, (data_value_t){ .type = STOW_ITEM_TYPE_STRUCT, .data.raw_value = &point }), 0);

    const uint16_t ids[] = { PEER_ID_COUNTER, PEER_ID_POSITION };
    struct test_async async;
    test_async_init(&async);
    zassert_equal(stow_client_get_async(peer, ids, 2, test_capture_cb, &async), 0);
    zassert_equal(k_sem_take(&async.done, TEST_WAIT), 0);
    test_settle();
    zassert_equal(async.err, 0);
    zassert_equal(async.count, 2);
    zassert_equal(test_async_values(&async)[0].value.data.int_value, 12);
    zassert_str_equal(((const peer_Point_t*)test_async_values(&async)[1].value.data.raw_value)->label, "async");
    test_async_release(&async);

    zassert_equal(test_blocks_in_use(), blocks, "event or value leaked");
}

ZTEST(stow_client_loopback, test_an_event_kept_after_its_peer_closes_is_released_through_that_peer)
{
    uint32_t blocks = test_blocks_in_use();
    struct test_link other_link;
    struct stow_client_peer* other = test_connect(&other_link, &test_peer_client, STOW_ROLE_GUEST);
    zassert_equal(stow_client_subscribe_one(other, PEER_ID_POSITION), 0);
    Point_t point = { .x = 7, .y = 8, .label = "closed" };
    zassert_equal(
        stow_set(STOW_ID_POSITION, (data_value_t){ .type = STOW_ITEM_TYPE_STRUCT, .data.raw_value = &point }), 0);

    event_t* event = NULL;
    zassert_equal(test_next_update(TEST_WAIT, &event), 0);
    test_disconnect(&other_link, &other);

    const struct stow_client_update_payload* update = (const struct stow_client_update_payload*)event->data.buf;
    zassert_equal(stow_client_peer_session_id(update->peer), other_link.session_id);
    zassert_str_equal(((const peer_Point_t*)update->value.value.data.raw_value)->label, "closed");
    event_unref(&event);

    zassert_equal(test_blocks_in_use(), blocks, "event, value or peer leaked");
}

ZTEST(stow_client_loopback, test_disconnected_peer_refuses_requests)
{
    test_close_client(&link);
    struct test_hook_event event = test_next_hook(TEST_WAIT);
    zassert_equal(event.hook, TEST_HOOK_DISCONNECTED);

    struct stow_client_value value;
    zassert_equal(stow_client_get_one(peer, PEER_ID_COUNTER, &value), -ENOTCONN);
    zassert_equal(stow_client_availability(peer, PEER_ID_COUNTER), STOW_CLIENT_MISSING);
    struct stow_client_peer_info info;
    zassert_equal(stow_client_peer_info(peer, &info), -ENOTCONN);
}

ZTEST(stow_client_loopback, test_several_peers_at_once)
{
    struct test_link second_link;
    struct stow_client_peer* second = test_connect(&second_link, &test_peer_client, STOW_ROLE_DEV);

    uint16_t id = PEER_ID_LOCKED;
    data_value_t value = { .type = STOW_ITEM_TYPE_INT, .data.int_value = 8 };
    zassert_equal(stow_client_set(peer, &id, &value, 1), -EACCES);
    zassert_equal(stow_client_set(second, &id, &value, 1), 0);
    struct stow_client_value got;
    zassert_equal(stow_client_get_one(peer, PEER_ID_LOCKED, &got), 0);
    zassert_equal(got.value.data.int_value, 8);
    stow_client_release(&test_peer_client, &got);

    test_disconnect(&second_link, &second);
}

ZTEST(stow_client_loopback, test_a_peer_slot_is_reused_only_once_released)
{
    struct test_link links[CONFIG_STOW_CLIENT_MAX_PEERS - 1];
    struct stow_client_peer* others[ARRAY_SIZE(links)];
    for (size_t i = 0; i < ARRAY_SIZE(links); i++)
    {
        others[i] = test_connect(&links[i], &test_peer_client, STOW_ROLE_GUEST);
    }
    struct test_link extra;
    test_link_init(&extra, &test_peer_client);
    zassert_equal(test_open_client(&extra), -ENOMEM);

    stow_protocol_endpoint.session_closed(&stow_protocol_endpoint, links[0].session_id);
    test_close_client(&links[0]);
    zassert_equal(test_next_hook(TEST_WAIT).hook, TEST_HOOK_DISCONNECTED);
    test_settle();
    zassert_equal(test_open_client(&extra), -ENOMEM, "slot reused while referenced");
    struct stow_client_peer_info info;
    zassert_equal(stow_client_peer_info(others[0], &info), -ENOTCONN);

    struct stow_client_peer* closed = others[0];
    stow_client_peer_unref(&closed);
    zassert_is_null(closed);
    zassert_equal(test_open_client(&extra), 0);
    test_close_client(&extra);
    test_settle();

    for (size_t i = 1; i < ARRAY_SIZE(links); i++)
    {
        test_disconnect(&links[i], &others[i]);
    }
}
```

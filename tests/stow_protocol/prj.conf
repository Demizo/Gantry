## CMakeLists.txt
```
cmake_minimum_required(VERSION 3.20.0)

find_package(Zephyr REQUIRED HINTS $ENV{ZEPHYR_BASE})
project(stow_protocol_test)

set(GANTRY_ROOT ${CMAKE_CURRENT_SOURCE_DIR}/../..)
set(GANTRY_LIB ${GANTRY_ROOT}/lib)
set(GANTRY_INC ${GANTRY_ROOT}/include)

gantry_stow_generate(YAML ${GANTRY_ROOT}/protocols/stow/stow.yaml APP_DIR ${GANTRY_ROOT}/protocols/stow)

target_sources(app PRIVATE
    src/test_common.c
    src/test_stow_protocol_describe.c
    src/test_stow_protocol_subscribe.c
    src/test_stow_protocol_sessions.c
    src/test_stow_protocol_netbuf.c
    src/test_stow_protocol_transport.c
    src/test_stow_cobs_transport.c
    src/test_stow_protocol_errors.c
    src/test_stow_protocol_vectors.c
    ${GANTRY_ROOT}/tests/common/stow_storage_stub.c
    ${GANTRY_LIB}/memory.c
    ${GANTRY_LIB}/event.c
    ${GANTRY_LIB}/cobs_framer.c
    ${GANTRY_LIB}/stow/stow.c
    ${GANTRY_LIB}/stow/stow_event.c
    ${GANTRY_LIB}/stow/stow_msg.c
    ${GANTRY_LIB}/stow/stow_protocol.c
    ${GANTRY_LIB}/stow/stow_runtime.c
    ${GANTRY_LIB}/stow/stow_cobs_transport.c
    ${GANTRY_LIB}/stow/types/stow_type_enum.c
    ${GANTRY_LIB}/stow/types/stow_type_int.c
    ${GANTRY_LIB}/stow/types/stow_type_float.c
    ${GANTRY_LIB}/stow/types/stow_type_string.c
    ${GANTRY_LIB}/stow/types/stow_type_byte_array.c
    ${GANTRY_LIB}/stow/types/stow_type_buffer.c
)

target_include_directories(app PRIVATE
    ${GANTRY_INC}
    ${GANTRY_ROOT}/tests/common
)

_gantry_protocol_vectors(app ${GANTRY_ROOT}/protocols/stow stow)
```

## prj.conf
```kconfig
CONFIG_GANTRY_MEMORY=y
CONFIG_MEM_POOL_COUNT=3
CONFIG_MEM_POOL1_BLOCK_SIZE=64
CONFIG_MEM_POOL1_BLOCK_COUNT=32
CONFIG_MEM_POOL2_BLOCK_SIZE=256
CONFIG_MEM_POOL2_BLOCK_COUNT=16
CONFIG_MEM_POOL3_BLOCK_SIZE=1024
CONFIG_MEM_POOL3_BLOCK_COUNT=4

CONFIG_GANTRY_EVENTS=y
CONFIG_GANTRY_STOW=y
CONFIG_STOW_PROTOCOL=y
CONFIG_STOW_PROTOCOL_MAX_SESSIONS=4
CONFIG_STOW_PROTOCOL_QUEUE_SIZE=16
CONFIG_STOW_PROTOCOL_DESCRIBE_CHUNK_SIZE=256
CONFIG_STOW_COBS_TRANSPORT=y

CONFIG_ZCBOR=y
CONFIG_NET_BUF=y
```

## src/test_common.c
```c
/*
 * Copyright (c) 2026 Demizo
 *
 * SPDX-License-Identifier: Apache-2.0
 */

#include "test_common.h"

#include <gantry/error.h>
#include <gantry/event.h>
#include <zephyr/logging/log.h>

LOG_MODULE_REGISTER(test_common, 3);

//**********************************************************
//* Pools
//**********************************************************

#define TEST_BUF_USER_DATA 0

#define TEST_SYNC_SESSION 0xDEADBEEFu

NET_BUF_POOL_DEFINE(test_tx_pool, TEST_TX_BUF_COUNT, TEST_BUF_DATA_SIZE, TEST_BUF_USER_DATA, NULL);
NET_BUF_POOL_DEFINE(test_rx_pool, 16, TEST_BUF_DATA_SIZE, TEST_BUF_USER_DATA, NULL);

K_MSGQ_DEFINE(test_capture_msgq, sizeof(struct test_capture), TEST_MAX_PENDING_TX, sizeof(void*));
K_MSGQ_DEFINE(test_sync_msgq, sizeof(struct net_buf*), 1, sizeof(void*));

static bool g_sync_session_open;

static atomic_t g_refuse_sends;
static atomic_t g_block_sends;

K_SEM_DEFINE(test_send_gate, 0, 1);
K_SEM_DEFINE(test_send_blocked, 0, 1);

//**********************************************************
//* Fake Transport
//**********************************************************

static int test_send(struct stow_transport* transport, uint32_t session_id, struct net_buf* buf)
{
    ARG_UNUSED(transport);

    if (session_id == TEST_SYNC_SESSION)
    {
        return k_msgq_put(&test_sync_msgq, &buf, K_NO_WAIT) == 0 ? 0 : -EIO;
    }

    if (atomic_get(&g_block_sends) != 0)
    {
        k_sem_give(&test_send_blocked);
        k_sem_take(&test_send_gate, K_FOREVER);
    }

    if (atomic_get(&g_refuse_sends) != 0)
    {
        return -ENOBUFS;
    }

    struct test_capture cap = { .session_id = session_id, .buf = buf };
    if (k_msgq_put(&test_capture_msgq, &cap, K_NO_WAIT) != 0)
    {
        LOG_WRN("Test capture queue full, refusing TX for session %u", session_id);
        return -ENOBUFS;
    }
    return 0;
}

struct stow_transport test_transport = {
    .send = test_send,
    .pool = &test_tx_pool,
    .headroom = TEST_TX_HEADROOM,
    .tailroom = TEST_TX_TAILROOM,
};

void test_refuse_sends(bool refuse) { atomic_set(&g_refuse_sends, refuse ? 1 : 0); }

void test_block_sends(bool block)
{
    k_sem_reset(&test_send_blocked);
    atomic_set(&g_block_sends, block ? 1 : 0);
    if (!block)
    {
        k_sem_give(&test_send_gate);
    }
}

void test_await_blocked_send(void)
{
    zassert_equal(k_sem_take(&test_send_blocked, K_SECONDS(1)), 0, "send did not block");
}

//**********************************************************
//* Lifecycle
//**********************************************************

static void ensure_sync_session_open(void)
{
    if (g_sync_session_open)
    {
        return;
    }
    stow_init();
    int ret = test_endpoint_open(TEST_SYNC_SESSION, STOW_ROLE_GUEST, &test_transport);
    zassert_equal(ret, 0, "sync session open failed: %d", ret);
    g_sync_session_open = true;
}

void test_drain_captures(void)
{
    struct test_capture cap;
    while (k_msgq_get(&test_capture_msgq, &cap, K_NO_WAIT) == 0)
    {
        if (cap.buf != NULL)
        {
            net_buf_unref(cap.buf);
        }
    }
}

void test_sync(void)
{
    uint8_t buf[8];
    int len = test_build_simple(buf, sizeof(buf), STOW_MSG_HELLO, TEST_TAG);
    zassert_true(len > 0);

    k_tid_t self = k_current_get();
    int priority = k_thread_priority_get(self);
    k_thread_priority_set(self, CONFIG_STOW_PROTOCOL_THREAD_PRIORITY + 1);

    int ret = test_submit_rx(TEST_SYNC_SESSION, buf, (size_t)len);
    struct net_buf* response = NULL;
    int got = k_msgq_get(&test_sync_msgq, &response, K_SECONDS(1));
    k_thread_priority_set(self, priority);

    zassert_equal(ret, 0);
    zassert_equal(got, 0, "sync response missing");
    net_buf_unref(response);
}

void test_reset(void)
{
    ensure_sync_session_open();
    test_refuse_sends(false);
    test_drain_captures();
}

int test_endpoint_open(uint32_t session_id, stow_role_t roles, struct stow_transport* transport)
{
    return stow_protocol_endpoint.session_opened(&stow_protocol_endpoint, session_id, roles, transport);
}

void test_endpoint_close(uint32_t session_id)
{
    stow_protocol_endpoint.session_closed(&stow_protocol_endpoint, session_id);
}

void test_open_session(uint32_t session_id, stow_role_t roles)
{
    int ret = test_endpoint_open(session_id, roles, &test_transport);
    zassert_equal(ret, 0, "session_open(%u) failed: %d", session_id, ret);
}

//**********************************************************
//* RX Helpers
//**********************************************************

struct net_buf* test_alloc_rx(void) { return net_buf_alloc(&test_rx_pool, K_NO_WAIT); }

int test_submit_rx(uint32_t session_id, const uint8_t* data, size_t len)
{
    struct net_buf* buf = test_alloc_rx();
    if (buf == NULL)
    {
        return -ENOMEM;
    }
    void* dest = net_buf_add(buf, len);
    memcpy(dest, data, len);

    stow_protocol_endpoint.receive(&stow_protocol_endpoint, session_id, buf);
    net_buf_unref(buf);
    return SUCCESS;
}

//**********************************************************
//* TX Helpers
//**********************************************************

struct test_capture test_await_tx(k_timeout_t timeout)
{
    struct test_capture cap = { 0 };
    if (k_msgq_get(&test_capture_msgq, &cap, timeout) != 0)
    {
        return (struct test_capture){ 0 };
    }
    return cap;
}

bool test_decode_response_header(
    struct net_buf* buf, uint32_t* out_cmd, uint32_t* out_tag, zcbor_state_t* dec, size_t dec_states)
{
    zcbor_new_decode_state(dec, dec_states, buf->data, buf->len, 1, NULL, 0);
    if (!zcbor_list_start_decode(dec))
    {
        return false;
    }
    if (!zcbor_uint32_decode(dec, out_cmd))
    {
        return false;
    }
    uint32_t tag = STOW_TAG_NONE;
    if (!zcbor_uint32_decode(dec, &tag) && !zcbor_nil_expect(dec, NULL))
    {
        return false;
    }
    if (out_tag != NULL)
    {
        *out_tag = tag;
    }
    return true;
}

bool test_decode_error(struct net_buf* buf, struct test_error* out_error)
{
    zcbor_state_t dec[4];
    uint32_t cmd = 0;
    uint32_t tag = STOW_TAG_NONE;
    if (!test_decode_response_header(buf, &cmd, &tag, dec, ARRAY_SIZE(dec)) || cmd != STOW_MSG_ERROR)
    {
        return false;
    }
    out_error->tag = (uint8_t)tag;

    uint32_t code = 0;
    if (!zcbor_uint32_decode(dec, &code))
    {
        return false;
    }
    out_error->code = (enum stow_error_code)code;
    out_error->item = STOW_MSG_ABSENT;
    out_error->index = STOW_MSG_ABSENT;

    if (!zcbor_array_at_end(dec) && !zcbor_uint32_decode(dec, &out_error->item) && !zcbor_nil_expect(dec, NULL))
    {
        return false;
    }
    if (!zcbor_array_at_end(dec) && !zcbor_uint32_decode(dec, &out_error->index))
    {
        return false;
    }
    return zcbor_list_end_decode(dec);
}

//**********************************************************
//* Request Builders
//**********************************************************

int test_build_simple(uint8_t* out_buf, size_t out_buf_size, uint32_t cmd, uint32_t tag)
{
    zcbor_state_t enc[4];
    zcbor_new_encode_state(enc, ARRAY_SIZE(enc), out_buf, out_buf_size, 1);
    if (!zcbor_list_start_encode(enc, 2) || !zcbor_uint32_put(enc, cmd) || !zcbor_uint32_put(enc, tag) ||
        !zcbor_list_end_encode(enc, 2))
    {
        return -ENOMEM;
    }
    return (int)(enc[0].payload - out_buf);
}

int test_build_with_id(uint8_t* out_buf, size_t out_buf_size, uint32_t cmd, uint32_t tag, uint32_t item_id)
{
    zcbor_state_t enc[4];
    zcbor_new_encode_state(enc, ARRAY_SIZE(enc), out_buf, out_buf_size, 1);
    if (!zcbor_list_start_encode(enc, 3) || !zcbor_uint32_put(enc, cmd) || !zcbor_uint32_put(enc, tag) ||
        !zcbor_uint32_put(enc, item_id) || !zcbor_list_end_encode(enc, 3))
    {
        return -ENOMEM;
    }
    return (int)(enc[0].payload - out_buf);
}
```

## src/test_common.h
```c
/*
 * Copyright (c) 2026 Demizo
 *
 * SPDX-License-Identifier: Apache-2.0
 */

#pragma once

#include <gantry/memory.h>
#include <gantry/stow/stow.h>
#include <gantry/stow/stow_msg.h>
#include <gantry/stow/stow_protocol.h>
#include <gantry/stow/stow_transport.h>
#include <generated_stow_items.h>
#include <stdint.h>
#include <string.h>
#include <zcbor_decode.h>
#include <zcbor_encode.h>
#include <zephyr/kernel.h>
#include <zephyr/net_buf.h>
#include <zephyr/ztest.h>
#include <zephyr/ztest_assert.h>

#include "test_settle.h"

/**
 * @brief Sessions available to tests; one slot is reserved for @ref test_sync
 */
#define TEST_FREE_SESSIONS (CONFIG_STOW_PROTOCOL_MAX_SESSIONS - 1)

/**
 * @brief Size of each buffer in the shared test pools
 */
#define TEST_BUF_DATA_SIZE 320

/**
 * @brief Tag used by requests that do not exercise tagging
 */
#define TEST_TAG 17U

/**
 * @brief Maximum number of TX responses buffered during a single test
 */
#define TEST_MAX_PENDING_TX 32

/**
 * @brief Number of buffers in the fake transport's pool
 */
#define TEST_TX_BUF_COUNT 32

/**
 * @brief Reserved headroom for the test TX pool (verifies app head usage)
 */
#define TEST_TX_HEADROOM 8

/**
 * @brief Reserved tailroom for the test TX pool (verifies app tail usage)
 */
#define TEST_TX_TAILROOM 4

/**
 * @brief A captured TX response (paired session_id and net_buf)
 */
struct test_capture
{
    uint32_t session_id;
    struct net_buf* buf;
};

/**
 * @brief A captured Error response
 */
struct test_error
{
    enum stow_error_code code; /**< Error code */
    uint8_t tag;               /**< Tag, or @ref STOW_TAG_NONE */
    uint32_t item;             /**< Item, or @ref STOW_MSG_ABSENT */
    uint32_t index;            /**< Index, or @ref STOW_MSG_ABSENT */
};

/**
 * @brief Fake transport that captures every response
 */
extern struct stow_transport test_transport;

/**
 * @brief Make the fake transport refuse sends
 *
 * @param refuse Whether sends are refused
 */
void test_refuse_sends(bool refuse);

/**
 * @brief Open a session through the protocol endpoint
 *
 * @param session_id Session to open
 * @param roles Roles granted to the session
 * @param transport Transport that carries the session's messages
 *
 * @return The endpoint's result
 */
int test_endpoint_open(uint32_t session_id, stow_role_t roles, struct stow_transport* transport);

/**
 * @brief Close a session through the protocol endpoint
 *
 * @param session_id Session to close
 */
void test_endpoint_close(uint32_t session_id);

/**
 * @brief Make the fake transport block inside send until unblocked
 *
 * @param block Whether sends block
 */
void test_block_sends(bool block);

/**
 * @brief Wait until the protocol thread is blocked inside send
 */
void test_await_blocked_send(void);

/**
 * @brief Open a session on the fake transport
 *
 * @param session_id Session to open
 * @param roles Roles granted to the session
 */
void test_open_session(uint32_t session_id, stow_role_t roles);

/**
 * @brief Allocate an RX net_buf from the shared test pool
 *
 * @details The caller writes CBOR bytes into the buf using net_buf_add and
 * passes it to the protocol endpoint. The protocol takes its own
 * reference; the caller should net_buf_unref after submitting.
 */
struct net_buf* test_alloc_rx(void);

/**
 * @brief Submit a hand-crafted CBOR request to the protocol
 *
 * @param session_id The session that owns the request
 * @param data Encoded CBOR bytes
 * @param len Length of the encoded payload
 *
 * @return 0 when the request was handed to the endpoint, -ENOMEM when no RX buffer was free
 */
int test_submit_rx(uint32_t session_id, const uint8_t* data, size_t len);

/**
 * @brief Wait for and return the next captured TX response
 *
 * @return Captured response, or {0, NULL} on timeout
 */
struct test_capture test_await_tx(k_timeout_t timeout);

/**
 * @brief Drain any pending captures, releasing their buffers
 */
void test_drain_captures(void);

/**
 * @brief Force the protocol thread to flush pending events
 *
 * @details Sends a Hello request on a dedicated session and waits for its
 * response below the protocol thread's priority, so the thread is idle on return.
 */
void test_sync(void);

/**
 * @brief Decode the outer array header, message code and request tag of a captured response
 *
 * @param buf Captured response net_buf
 * @param[out] out_cmd Populated with the decoded message code
 * @param[out] out_tag Populated with the echoed tag, or @ref STOW_MSG_ABSENT for null; may be NULL
 * @param[out] dec Initialized decoder, positioned after the header.
 *                 Caller is responsible for finishing the list decode.
 * @param dec_states Number of states in @p dec
 *
 * @return true on success
 */
bool test_decode_response_header(
    struct net_buf* buf, uint32_t* out_cmd, uint32_t* out_tag, zcbor_state_t* dec, size_t dec_states);

/**
 * @brief Decode a captured Error response
 *
 * @param buf Captured response net_buf
 * @param[out] out_error Populated with the decoded error
 *
 * @return true when @p buf holds a well-formed Error
 */
bool test_decode_error(struct net_buf* buf, struct test_error* out_error);

/**
 * @brief Encode a request with no arguments [cmd, tag] into out_buf
 *
 * @return Encoded length on success, negative errno on failure
 */
int test_build_simple(uint8_t* out_buf, size_t out_buf_size, uint32_t cmd, uint32_t tag);

/**
 * @brief Encode a request with one item [cmd, tag, id]
 */
int test_build_with_id(uint8_t* out_buf, size_t out_buf_size, uint32_t cmd, uint32_t tag, uint32_t item_id);

/**
 * @brief Reset shared test state between tests
 */
void test_reset(void);
```

## src/test_stow_cobs_transport.c
```c
/*
 * Copyright (c) 2026 Demizo
 *
 * SPDX-License-Identifier: Apache-2.0
 */

#include <gantry/stow/stow_cobs_transport.h>

#include "test_common.h"

#define LINK_SESSION 71
#define LINK_MESSAGE_SIZE 240

NET_BUF_POOL_DEFINE(link_message_pool, 8, LINK_MESSAGE_SIZE, 0, NULL);
NET_BUF_POOL_DEFINE(link_frame_pool, 4, COBS_ENCODE_MAX_SIZE(LINK_MESSAGE_SIZE), 0, NULL);

K_MSGQ_DEFINE(link_frame_msgq, sizeof(struct net_buf*), 4, sizeof(void*));

static atomic_t g_refuse_writes;

static struct stow_cobs_transport link;

static const uint8_t request_frame[] = { 0x04, 0x83, 0x08, 0x07, 0x01, 0x00 };
static const uint8_t response_frame[] = { 0x04, 0x82, 0x0A, 0x07, 0x00 };

static int write_frame(struct net_buf* frame, void* user_data)
{
    ARG_UNUSED(user_data);
    if (atomic_get(&g_refuse_writes) != 0)
    {
        return -ENOBUFS;
    }
    return k_msgq_put(&link_frame_msgq, &frame, K_NO_WAIT) == 0 ? 0 : -ENOBUFS;
}

static void* setup(void)
{
    test_reset();
    struct stow_cobs_transport_config config = {
        .server = &stow_protocol_endpoint,
        .session_id = LINK_SESSION,
        .roles = STOW_ROLE_GUEST,
        .message_pool = &link_message_pool,
        .frame_pool = &link_frame_pool,
        .write = write_frame,
        .user_data = NULL,
    };
    zassert_equal(stow_cobs_transport_init(&link, &config), 0);
    return NULL;
}

static void before_each(void* fixture)
{
    (void)fixture;
    test_reset();
    atomic_clear(&g_refuse_writes);
}

static void after_each(void* fixture)
{
    (void)fixture;
    atomic_clear(&g_refuse_writes);
    stow_cobs_transport_close(&link);
    test_sync();

    struct net_buf* frame = NULL;
    while (k_msgq_get(&link_frame_msgq, &frame, K_NO_WAIT) == 0)
    {
        net_buf_unref(frame);
    }
}

ZTEST_SUITE(stow_cobs_transport, NULL, setup, before_each, after_each, NULL);

static void expect_frame(const uint8_t* expected, size_t len)
{
    struct net_buf* frame = NULL;
    zassert_equal(k_msgq_get(&link_frame_msgq, &frame, K_SECONDS(1)), 0, "no frame written");
    zassert_equal(frame->len, len, "frame length %u", frame->len);
    zassert_mem_equal(frame->data, expected, len);
    net_buf_unref(frame);
}

ZTEST(stow_cobs_transport, test_a_link_without_the_client_needs_a_server)
{
    struct stow_cobs_transport unused;
    struct stow_cobs_transport_config config = {
        .server = NULL,
        .session_id = LINK_SESSION,
        .message_pool = &link_message_pool,
        .frame_pool = &link_frame_pool,
        .write = write_frame,
    };
    zassert_equal(stow_cobs_transport_init(&unused, &config), -EINVAL);
}

ZTEST(stow_cobs_transport, test_frame_round_trip)
{
    zassert_equal(stow_cobs_transport_open(&link), 0);
    zassert_equal(stow_cobs_transport_feed(&link, request_frame, sizeof(request_frame)), 0);
    expect_frame(response_frame, sizeof(response_frame));
}

ZTEST(stow_cobs_transport, test_frame_split_across_feeds)
{
    zassert_equal(stow_cobs_transport_open(&link), 0);
    for (size_t i = 0; i < sizeof(request_frame); i++)
    {
        zassert_equal(stow_cobs_transport_feed(&link, &request_frame[i], 1), 0);
    }
    expect_frame(response_frame, sizeof(response_frame));
}

static void expect_no_frame(const char* why)
{
    test_sync();
    struct net_buf* frame = NULL;
    zassert_not_equal(k_msgq_get(&link_frame_msgq, &frame, K_MSEC(50)), 0, "%s", why);
}

ZTEST(stow_cobs_transport, test_refused_write_drops_the_response)
{
    zassert_equal(stow_cobs_transport_open(&link), 0);
    atomic_set(&g_refuse_writes, 1);

    zassert_equal(stow_cobs_transport_feed(&link, request_frame, sizeof(request_frame)), 0);
    expect_no_frame("refused frame was written");

    atomic_clear(&g_refuse_writes);
    expect_no_frame("refused frame was written later");

    zassert_equal(stow_cobs_transport_feed(&link, request_frame, sizeof(request_frame)), 0);
    expect_frame(response_frame, sizeof(response_frame));
}

ZTEST(stow_cobs_transport, test_full_frame_pool_drops_the_response)
{
    zassert_equal(stow_cobs_transport_open(&link), 0);

    struct net_buf* hoard[4];
    size_t hoarded = 0;
    while (hoarded < ARRAY_SIZE(hoard) && (hoard[hoarded] = net_buf_alloc(&link_frame_pool, K_NO_WAIT)) != NULL)
    {
        hoarded++;
    }

    zassert_equal(stow_cobs_transport_feed(&link, request_frame, sizeof(request_frame)), 0);
    expect_no_frame("frame written without a frame buffer");

    for (size_t i = 0; i < hoarded; i++)
    {
        net_buf_unref(hoard[i]);
    }

    zassert_equal(stow_cobs_transport_feed(&link, request_frame, sizeof(request_frame)), 0);
    expect_frame(response_frame, sizeof(response_frame));
}

ZTEST(stow_cobs_transport, test_reopen_discards_partial_frame)
{
    zassert_equal(stow_cobs_transport_open(&link), 0);
    zassert_equal(stow_cobs_transport_feed(&link, request_frame, 2), 0);
    stow_cobs_transport_close(&link);
    test_sync();

    zassert_equal(stow_cobs_transport_open(&link), 0);
    zassert_equal(stow_cobs_transport_feed(&link, request_frame, sizeof(request_frame)), 0);
    expect_frame(response_frame, sizeof(response_frame));
}

ZTEST(stow_cobs_transport, test_closed_link_writes_nothing)
{
    zassert_equal(stow_cobs_transport_open(&link), 0);
    stow_cobs_transport_close(&link);
    test_sync();

    zassert_equal(stow_cobs_transport_feed(&link, request_frame, sizeof(request_frame)), 0);
    test_sync();
    struct net_buf* frame = NULL;
    zassert_not_equal(k_msgq_get(&link_frame_msgq, &frame, K_MSEC(50)), 0, "closed link wrote a frame");
}

static size_t build_oversized_frame(uint8_t* out)
{
    const size_t message_len = LINK_MESSAGE_SIZE + 1U;
    size_t len = 0;
    out[len++] = (uint8_t)(message_len + 1U);
    memset(&out[len], 0x01, message_len);
    len += message_len;
    out[len++] = 0x00;
    return len;
}

ZTEST(stow_cobs_transport, test_oversized_frame_is_dropped_and_the_next_frame_decodes)
{
    uint8_t stream[2U * sizeof(request_frame) + LINK_MESSAGE_SIZE + 3U];
    size_t len = 0;
    memcpy(&stream[len], request_frame, sizeof(request_frame));
    len += sizeof(request_frame);
    len += build_oversized_frame(&stream[len]);
    memcpy(&stream[len], request_frame, sizeof(request_frame));
    len += sizeof(request_frame);

    zassert_equal(stow_cobs_transport_open(&link), 0);
    zassert_equal(stow_cobs_transport_feed(&link, stream, len), 0);
    expect_frame(response_frame, sizeof(response_frame));
    expect_frame(response_frame, sizeof(response_frame));
    test_sync();
    struct net_buf* frame = NULL;
    zassert_not_equal(k_msgq_get(&link_frame_msgq, &frame, K_MSEC(50)), 0, "the oversized frame was answered");
}

ZTEST(stow_cobs_transport, test_oversized_frame_split_across_feeds_resyncs)
{
    uint8_t frame[LINK_MESSAGE_SIZE + 3U];
    size_t len = build_oversized_frame(frame);

    zassert_equal(stow_cobs_transport_open(&link), 0);
    zassert_equal(stow_cobs_transport_feed(&link, frame, len - 1U), 0);
    zassert_equal(stow_cobs_transport_feed(&link, &frame[len - 1U], 1U), 0);
    zassert_equal(stow_cobs_transport_feed(&link, request_frame, sizeof(request_frame)), 0);
    expect_frame(response_frame, sizeof(response_frame));
}
```

## src/test_stow_protocol_basic.c
```c
/*
 * Copyright (c) 2026 Demizo
 *
 * SPDX-License-Identifier: Apache-2.0
 */

#include "test_common.h"

#define SESSION_ID 11

static void before_each(void* fixture)
{
    (void)fixture;
    test_reset();
}

static void after_each(void* fixture)
{
    (void)fixture;
    test_endpoint_close(SESSION_ID);
    test_sync();
    test_drain_captures();
}

ZTEST_SUITE(stow_protocol_basic, NULL, NULL, before_each, after_each, NULL);

static void open_session(stow_role_t roles) { test_open_session(SESSION_ID, roles); }

/**
 * @brief Submit a request and return the decoded outer cmd of the response
 */
static uint32_t submit_and_get_cmd(const uint8_t* data, size_t len)
{
    int ret = test_submit_rx(SESSION_ID, data, len);
    zassert_equal(ret, 0);

    struct test_capture cap = test_await_tx(K_SECONDS(1));
    zassert_not_null(cap.buf, "no TX captured");
    zassert_equal(cap.session_id, SESSION_ID);

    uint32_t cmd;
    zcbor_state_t dec[4];
    zassert_true(test_decode_response_header(cap.buf, &cmd, NULL, dec, ARRAY_SIZE(dec)));
    net_buf_unref(cap.buf);
    return cmd;
}

//**********************************************************
//* Hello
//**********************************************************

ZTEST(stow_protocol_basic, test_hello_reports_the_version)
{
    open_session(STOW_ROLE_GUEST);

    uint8_t buf[8];
    int len = test_build_simple(buf, sizeof(buf), STOW_MSG_HELLO, TEST_TAG);
    int ret = test_submit_rx(SESSION_ID, buf, len);
    zassert_equal(ret, 0);

    struct test_capture cap = test_await_tx(K_SECONDS(1));
    zassert_not_null(cap.buf);
    zassert_equal(cap.session_id, SESSION_ID);

    uint32_t cmd;
    zcbor_state_t dec[4];
    zassert_true(test_decode_response_header(cap.buf, &cmd, NULL, dec, ARRAY_SIZE(dec)));
    zassert_equal(cmd, STOW_MSG_HELLO_RESPONSE);
    uint32_t version;
    zassert_true(zcbor_uint32_decode(dec, &version));
    zassert_equal(version, STOW_PROTOCOL_VERSION);
    net_buf_unref(cap.buf);
}

//**********************************************************
//* Get
//**********************************************************

ZTEST(stow_protocol_basic, test_get_int_returns_current_value)
{
    open_session(STOW_ROLE_GUEST);

    // Seed the value so we know what to expect.
    data_value_t v = { .type = STOW_ITEM_TYPE_INT, .data.int_value = 27 };
    zassert_equal(stow_set(STOW_ID_TEST_INT, v), 0);
    test_sync();  // ensure any update events fan out before our Get

    test_drain_captures();

    uint8_t req[16];
    int len = test_build_with_id(req, sizeof(req), STOW_MSG_GET, TEST_TAG, STOW_ID_TEST_INT);
    int ret = test_submit_rx(SESSION_ID, req, len);
    zassert_equal(ret, 0);

    struct test_capture cap = test_await_tx(K_SECONDS(1));
    zassert_not_null(cap.buf);

    uint32_t cmd;
    zcbor_state_t dec[4];
    zassert_true(test_decode_response_header(cap.buf, &cmd, NULL, dec, ARRAY_SIZE(dec)));
    zassert_equal(cmd, STOW_MSG_GET_RESPONSE, "expected Get Response (got %u)", cmd);
    uint32_t id;
    zassert_true(zcbor_uint32_decode(dec, &id));
    zassert_equal(id, STOW_ID_TEST_INT);
    int32_t value;
    zassert_true(zcbor_int32_decode(dec, &value));
    zassert_equal(value, 27);
    net_buf_unref(cap.buf);
}

ZTEST(stow_protocol_basic, test_get_permission_denied)
{
    open_session(STOW_ROLE_GUEST);

    uint8_t req[16];
    int len = test_build_with_id(req, sizeof(req), STOW_MSG_GET, TEST_TAG, STOW_ID_TEST_SESSION_INT);
    uint32_t cmd = submit_and_get_cmd(req, len);
    zassert_equal(cmd, STOW_MSG_ERROR, "expected Error (got %u)", cmd);
}

//**********************************************************
//* Set
//**********************************************************

ZTEST(stow_protocol_basic, test_set_int_changes_value)
{
    open_session(STOW_ROLE_GUEST);

    uint8_t req[16];
    int len = test_build_set_int(req, sizeof(req), TEST_TAG, STOW_ID_TEST_INT, -42);
    uint32_t cmd = submit_and_get_cmd(req, len);
    zassert_equal(cmd, STOW_MSG_OK, "expected OK (got %u)", cmd);

    data_value_t v = { 0 };
    zassert_equal(stow_get(STOW_ID_TEST_INT, &v), 0);
    zassert_equal(v.data.int_value, -42);
    stow_release(STOW_ID_TEST_INT, &v);
}

ZTEST(stow_protocol_basic, test_set_string_changes_value)
{
    open_session(STOW_ROLE_SESSION);

    uint8_t req[64];
    int len = test_build_set_string(req, sizeof(req), TEST_TAG, STOW_ID_TEST_STRING, "newval");
    uint32_t cmd = submit_and_get_cmd(req, len);
    zassert_equal(cmd, STOW_MSG_OK);

    data_value_t v = { 0 };
    zassert_equal(stow_get(STOW_ID_TEST_STRING, &v), 0);
    zassert_str_equal(v.data.string_value, "newval");
    stow_release(STOW_ID_TEST_STRING, &v);
}

ZTEST(stow_protocol_basic, test_set_permission_denied)
{
    open_session(STOW_ROLE_GUEST);

    // TestString requires SESSION write; STOW_ROLE_GUEST should be rejected.
    uint8_t req[64];
    int len = test_build_set_string(req, sizeof(req), TEST_TAG, STOW_ID_TEST_STRING, "denied");
    uint32_t cmd = submit_and_get_cmd(req, len);
    zassert_equal(cmd, STOW_MSG_ERROR, "expected Error (got %u)", cmd);
}

ZTEST(stow_protocol_basic, test_set_invalid_value_returns_error)
{
    open_session(STOW_ROLE_GUEST);

    // TestInt constraints: min=-100, max=100. 500 is out of range.
    uint8_t req[16];
    int len = test_build_set_int(req, sizeof(req), TEST_TAG, STOW_ID_TEST_INT, 500);
    uint32_t cmd = submit_and_get_cmd(req, len);
    zassert_equal(cmd, STOW_MSG_ERROR);
}

ZTEST(stow_protocol_basic, test_set_allocation_failure_returns_out_of_memory)
{
    open_session(STOW_ROLE_GUEST);

    uint8_t req[16];
    zcbor_state_t enc[4];
    zcbor_new_encode_state(enc, ARRAY_SIZE(enc), req, sizeof(req), 1);
    const uint8_t payload[] = { 0x01, 0x02, 0x03 };
    struct zcbor_string bstr = { .value = payload, .len = sizeof(payload) };
    zassert_true(
        zcbor_list_start_encode(enc, 4) && zcbor_uint32_put(enc, STOW_MSG_SET) && zcbor_uint32_put(enc, TEST_TAG) &&
        zcbor_uint32_put(enc, STOW_ID_TEST_BUFFER) && zcbor_bstr_encode(enc, &bstr) && zcbor_list_end_encode(enc, 4));
    size_t len = enc[0].payload - req;

    void* blocks[256] = { 0 };
    size_t block_count = 0;
    while (block_count < ARRAY_SIZE(blocks) && mem_alloc(1, &blocks[block_count]) == 0)
    {
        block_count++;
    }
    zassert_true(block_count < ARRAY_SIZE(blocks), "memory pools were not exhausted");
    zassert_true(block_count >= 2);
    mem_unref(&blocks[--block_count]);
    mem_unref(&blocks[--block_count]);

    zassert_equal(test_submit_rx(SESSION_ID, req, len), 0);
    struct test_capture cap = test_await_tx(K_SECONDS(1));

    for (size_t i = 0; i < block_count; i++)
    {
        mem_unref(&blocks[i]);
    }

    zassert_not_null(cap.buf);
    uint32_t cmd;
    zcbor_state_t dec[4];
    zassert_true(test_decode_response_header(cap.buf, &cmd, NULL, dec, ARRAY_SIZE(dec)));
    zassert_equal(cmd, STOW_MSG_ERROR, "expected Error (got %u)", cmd);
    uint32_t code;
    zassert_true(zcbor_uint32_decode(dec, &code));
    zassert_equal(code, STOW_ERR_OUT_OF_MEMORY);
    net_buf_unref(cap.buf);
}

//**********************************************************
//* Error paths
//**********************************************************

ZTEST(stow_protocol_basic, test_unknown_command_returns_error)
{
    open_session(STOW_ROLE_GUEST);

    uint8_t req[8];
    int len = test_build_simple(req, sizeof(req), 250, TEST_TAG);
    uint32_t cmd = submit_and_get_cmd(req, len);
    zassert_equal(cmd, STOW_MSG_ERROR);
}

ZTEST(stow_protocol_basic, test_malformed_request_returns_error)
{
    open_session(STOW_ROLE_GUEST);

    uint8_t bogus[] = { 0xFF, 0xFE, 0xFD };
    uint32_t cmd = submit_and_get_cmd(bogus, sizeof(bogus));
    zassert_equal(cmd, STOW_MSG_ERROR);
}

//**********************************************************
//* Session admission
//**********************************************************

ZTEST(stow_protocol_basic, test_session_open_duplicate_returns_ealready)
{
    open_session(STOW_ROLE_GUEST);
    int ret = test_endpoint_open(SESSION_ID, STOW_ROLE_GUEST, &test_transport);
    zassert_equal(ret, -EALREADY);
}

//**********************************************************
//* OK
//**********************************************************

ZTEST(stow_protocol_basic, test_ok_response)
{
    open_session(STOW_ROLE_GUEST);

    uint8_t req[16];
    int len = test_build_set_int(req, sizeof(req), TEST_TAG, STOW_ID_TEST_INT, 5);
    zassert_equal(test_submit_rx(SESSION_ID, req, len), 0);

    struct test_capture cap = test_await_tx(K_SECONDS(1));
    zassert_not_null(cap.buf);

    uint32_t cmd;
    zcbor_state_t dec[4];
    zassert_true(test_decode_response_header(cap.buf, &cmd, NULL, dec, ARRAY_SIZE(dec)));
    zassert_equal(cmd, STOW_MSG_OK);
    zassert_true(zcbor_list_end_decode(dec));
    net_buf_unref(cap.buf);
}

//**********************************************************
//* Error
//**********************************************************

ZTEST(stow_protocol_basic, test_error_contains_code)
{
    open_session(STOW_ROLE_GUEST);

    uint8_t req[16];
    int len = test_build_with_id(req, sizeof(req), STOW_MSG_GET, TEST_TAG, STOW_ID_TEST_SESSION_INT);
    zassert_equal(test_submit_rx(SESSION_ID, req, len), 0);

    struct test_capture cap = test_await_tx(K_SECONDS(1));
    zassert_not_null(cap.buf);

    uint32_t cmd;
    zcbor_state_t dec[4];
    zassert_true(test_decode_response_header(cap.buf, &cmd, NULL, dec, ARRAY_SIZE(dec)));
    zassert_equal(cmd, STOW_MSG_ERROR);
    uint32_t code;
    zassert_true(zcbor_uint32_decode(dec, &code));
    zassert_equal(code, STOW_ERR_PERMISSION_DENIED);
    net_buf_unref(cap.buf);
}

//**********************************************************
//* Get several items
//**********************************************************

ZTEST(stow_protocol_basic, test_get_returns_every_value)
{
    open_session(STOW_ROLE_GUEST);

    data_value_t v = { .type = STOW_ITEM_TYPE_INT, .data.int_value = 55 };
    zassert_equal(stow_set(STOW_ID_TEST_INT, v), 0);
    test_sync();
    test_drain_captures();

    uint8_t req[32];
    uint32_t ids[] = { STOW_ID_TEST_INT, STOW_ID_TEST_INT };
    int len = test_build_list(req, sizeof(req), STOW_MSG_GET, TEST_TAG, ids, 2);
    zassert_true(len > 0);
    zassert_equal(test_submit_rx(SESSION_ID, req, len), 0);

    struct test_capture cap = test_await_tx(K_SECONDS(1));
    zassert_not_null(cap.buf);

    uint32_t cmd;
    zcbor_state_t dec[4];
    zassert_true(test_decode_response_header(cap.buf, &cmd, NULL, dec, ARRAY_SIZE(dec)));
    zassert_equal(cmd, STOW_MSG_GET_RESPONSE, "expected Get Response (got %u)", cmd);

    uint32_t id0;
    zassert_true(zcbor_uint32_decode(dec, &id0));
    zassert_equal(id0, STOW_ID_TEST_INT);
    int32_t val0;
    zassert_true(zcbor_int32_decode(dec, &val0));
    zassert_equal(val0, 55);

    uint32_t id1;
    zassert_true(zcbor_uint32_decode(dec, &id1));
    zassert_equal(id1, STOW_ID_TEST_INT);
    int32_t val1;
    zassert_true(zcbor_int32_decode(dec, &val1));
    zassert_equal(val1, 55);

    net_buf_unref(cap.buf);
}

ZTEST(stow_protocol_basic, test_get_permission_denied_returns_error)
{
    open_session(STOW_ROLE_GUEST);

    uint8_t req[32];
    uint32_t ids[] = { STOW_ID_TEST_SESSION_INT };
    int len = test_build_list(req, sizeof(req), STOW_MSG_GET, TEST_TAG, ids, 1);
    uint32_t cmd = submit_and_get_cmd(req, len);
    zassert_equal(cmd, STOW_MSG_ERROR, "expected Error (got %u)", cmd);
}

//**********************************************************
//* Set several items
//**********************************************************

ZTEST(stow_protocol_basic, test_set_changes_both_values)
{
    open_session(STOW_ROLE_GUEST);

    uint8_t req[32];
    int len = test_build_set_ints(req, sizeof(req), TEST_TAG, STOW_ID_TEST_INT, 10, STOW_ID_TEST_INT, 20);
    zassert_true(len > 0);
    zassert_equal(test_submit_rx(SESSION_ID, req, len), 0);

    // Expect a single OK response
    struct test_capture cap = test_await_tx(K_SECONDS(1));
    zassert_not_null(cap.buf);
    uint32_t cmd;
    zcbor_state_t dec[4];
    zassert_true(test_decode_response_header(cap.buf, &cmd, NULL, dec, ARRAY_SIZE(dec)));
    zassert_equal(cmd, STOW_MSG_OK, "expected OK (got %u)", cmd);
    net_buf_unref(cap.buf);

    // Final value should be 20 (last write wins)
    data_value_t v = { 0 };
    zassert_equal(stow_get(STOW_ID_TEST_INT, &v), 0);
    zassert_equal(v.data.int_value, 20);
    stow_release(STOW_ID_TEST_INT, &v);
}

ZTEST(stow_protocol_basic, test_set_first_error_stops)
{
    open_session(STOW_ROLE_GUEST);

    // First item: invalid value (out of range). Second item: valid but not reached.
    uint8_t req[32];
    int len = test_build_set_ints(req, sizeof(req), TEST_TAG, STOW_ID_TEST_INT, 500, STOW_ID_TEST_INT, 30);
    zassert_true(len > 0);
    zassert_equal(test_submit_rx(SESSION_ID, req, len), 0);

    // Expect a single Error response
    struct test_capture cap = test_await_tx(K_SECONDS(1));
    zassert_not_null(cap.buf);
    uint32_t cmd;
    zcbor_state_t dec[4];
    zassert_true(test_decode_response_header(cap.buf, &cmd, NULL, dec, ARRAY_SIZE(dec)));
    zassert_equal(cmd, STOW_MSG_ERROR, "expected Error (got %u)", cmd);
    net_buf_unref(cap.buf);

    // No second response should arrive
    struct test_capture extra = test_await_tx(K_MSEC(100));
    zassert_is_null(extra.buf, "unexpected second response after a Set error");
}

ZTEST(stow_protocol_basic, test_trailing_bytes_are_malformed)
{
    open_session(STOW_ROLE_GUEST);

    uint8_t combined[32];
    int l1 = test_build_simple(combined, sizeof(combined), STOW_MSG_HELLO, 1);
    int l2 = test_build_simple(combined + l1, sizeof(combined) - l1, STOW_MSG_HELLO, 2);
    zassert_true(l1 > 0 && l2 > 0);
    zassert_equal(test_submit_rx(SESSION_ID, combined, (size_t)(l1 + l2)), 0);

    struct test_capture cap = test_await_tx(K_SECONDS(1));
    zassert_not_null(cap.buf);
    struct test_error error;
    zassert_true(test_decode_error(cap.buf, &error));
    zassert_equal(error.code, STOW_ERR_MALFORMED_MSG);
    zassert_equal(error.tag, 1);
    net_buf_unref(cap.buf);

    zassert_is_null(test_await_tx(K_MSEC(50)).buf, "the trailing message was answered");
}
```

## src/test_stow_protocol_describe.c
```c
/*
 * Copyright (c) 2026 Demizo
 *
 * SPDX-License-Identifier: Apache-2.0
 */

#include <zephyr/fatal.h>

#include "test_common.h"

#define SESSION_A 21
#define SESSION_B 22
#define SESSION_SMALL 23

#define SMALL_BUF_SIZE 48
#define NARROW_BUF_SIZE 160

NET_BUF_POOL_DEFINE(small_pool, 2, SMALL_BUF_SIZE, 0, NULL);
NET_BUF_POOL_DEFINE(narrow_pool, 4, NARROW_BUF_SIZE, 0, NULL);

static struct stow_transport small_transport = {
    .send = NULL,
    .pool = &small_pool,
    .headroom = 0U,
    .tailroom = 0U,
};

static struct stow_transport narrow_transport = {
    .send = NULL,
    .pool = &narrow_pool,
    .headroom = 0U,
    .tailroom = 0U,
};

static atomic_t g_expect_assert;
static atomic_t g_asserts;

void k_sys_fatal_error_handler(unsigned int reason, const struct arch_esf* esf)
{
    ARG_UNUSED(esf);
    if (atomic_get(&g_expect_assert) == 0)
    {
        k_fatal_halt(reason);
    }
    atomic_inc(&g_asserts);
}

static void before_each(void* fixture)
{
    (void)fixture;
    test_reset();
    small_transport.send = test_transport.send;
}

static void after_each(void* fixture)
{
    (void)fixture;
    test_endpoint_close(SESSION_A);
    test_endpoint_close(SESSION_B);
    test_endpoint_close(SESSION_SMALL);
    test_sync();
    test_drain_captures();
}

ZTEST_SUITE(stow_protocol_describe, NULL, NULL, before_each, after_each, NULL);

/**
 * @brief Encode a Describe request, filtered by item names when @p names is not NULL
 *
 * @return Encoded length
 */
static int build_describe(
    uint8_t* out_buf, size_t out_buf_size, uint32_t start_id, const char* const* names, size_t name_count)
{
    zcbor_state_t enc[4];
    zcbor_new_encode_state(enc, ARRAY_SIZE(enc), out_buf, out_buf_size, 1);
    zassert_true(zcbor_list_start_encode(enc, 4));
    zassert_true(zcbor_uint32_put(enc, STOW_MSG_DESCRIBE));
    zassert_true(zcbor_uint32_put(enc, TEST_TAG));
    zassert_true(zcbor_uint32_put(enc, start_id));
    if (names != NULL)
    {
        zassert_true(zcbor_list_start_encode(enc, name_count));
        for (size_t i = 0; i < name_count; i++)
        {
            struct zcbor_string name = { .value = names[i], .len = strlen(names[i]) };
            zassert_true(zcbor_tstr_encode(enc, &name));
        }
        zassert_true(zcbor_list_end_encode(enc, name_count));
    }
    zassert_true(zcbor_list_end_encode(enc, 4));
    return (int)(enc[0].payload - out_buf);
}

/**
 * @brief Submit a Describe request, optionally filtered by item names, and decode the response.
 *
 * @param[in]  session_id         Session to send the request on
 * @param[in]  start_id           Item ID to start describing from
 * @param[in]  names              Item names to describe, or NULL for every item
 * @param[in]  name_count         Number of entries in @p names
 * @param[out] out_chunk          Buffer to copy the chunk bytes into
 * @param[in]  out_chunk_size     Size of out_chunk
 * @param[out] out_next_id        Populated with next_item_id from the response, or the item count when it is null
 * @param[out] out_more_remaining Populated with whether next_item_id is present
 *
 * @return Chunk length on success, -1 on failure or unexpected response code
 */
static int request_filtered_chunk(
    uint32_t session_id, uint32_t start_id, const char* const* names, size_t name_count, uint8_t* out_chunk,
    size_t out_chunk_size, uint32_t* out_next_id, bool* out_more_remaining)
{
    uint8_t req[128];
    int len = build_describe(req, sizeof(req), start_id, names, name_count);
    zassert_equal(test_submit_rx(session_id, req, len), 0);

    struct test_capture cap = test_await_tx(K_SECONDS(1));
    zassert_not_null(cap.buf);
    zassert_equal(cap.session_id, session_id);

    uint32_t resp_cmd;
    zcbor_state_t dec[4];
    zassert_true(test_decode_response_header(cap.buf, &resp_cmd, NULL, dec, ARRAY_SIZE(dec)));
    if (resp_cmd != STOW_MSG_DESCRIBE_RESPONSE)
    {
        net_buf_unref(cap.buf);
        return -1;
    }

    uint32_t next_id = STOW_ID_COUNT;
    bool more_remaining = zcbor_uint32_decode(dec, &next_id);
    if (!more_remaining)
    {
        zassert_true(zcbor_nil_expect(dec, NULL));
    }

    struct zcbor_string chunk;
    zassert_true(zcbor_bstr_decode(dec, &chunk));
    zassert_true(chunk.len <= out_chunk_size);
    memcpy(out_chunk, chunk.value, chunk.len);
    int chunk_len = (int)chunk.len;

    net_buf_unref(cap.buf);

    *out_next_id = next_id;
    *out_more_remaining = more_remaining;
    return chunk_len;
}

/**
 * @brief Submit an unfiltered Describe request and decode the response.
 */
static int request_describe_chunk(
    uint32_t session_id, uint32_t start_id, uint8_t* out_chunk, size_t out_chunk_size, uint32_t* out_next_id,
    bool* out_more_remaining)
{
    return request_filtered_chunk(
        session_id, start_id, NULL, 0, out_chunk, out_chunk_size, out_next_id, out_more_remaining);
}

/**
 * @brief Count the whole item descriptions in one chunk, which must parse on its own
 *
 * @param chunk Chunk bytes
 * @param len Chunk length
 * @param[out] ids Populated with the described item IDs
 *
 * @return Number of item descriptions in the chunk
 */
static size_t parse_chunk(const uint8_t* chunk, size_t len, uint32_t* ids)
{
    const uint8_t* start = chunk;
    size_t body_len = len;

    zcbor_state_t dec[4];
    zcbor_new_decode_state(dec, ARRAY_SIZE(dec), start, body_len, STOW_ID_COUNT, NULL, 0);

    size_t count = 0;
    while (dec[0].payload < start + body_len)
    {
        zassert_true(zcbor_map_start_decode(dec), "chunk holds a partial item");
        uint32_t key;
        zassert_true(zcbor_uint32_decode(dec, &key));
        zassert_equal(key, STOW_DESCRIBE_ID);
        zassert_true(zcbor_uint32_decode(dec, &ids[count]));
        for (int i = 0; i < 8 * 2; i++)
        {
            zassert_true(zcbor_any_skip(dec, NULL));
        }
        zassert_true(zcbor_map_end_decode(dec));
        count++;
    }
    return count;
}

ZTEST(stow_protocol_describe, test_describe_two_sessions_independent)
{
    test_open_session(SESSION_A, STOW_ROLE_GUEST);
    test_open_session(SESSION_B, STOW_ROLE_GUEST);

    uint8_t chunk_a[TEST_BUF_DATA_SIZE];
    uint8_t chunk_b[TEST_BUF_DATA_SIZE];
    uint32_t next_a = 0, next_b = 0;
    bool more_a = false, more_b = false;

    // Both sessions request the first chunk from start_id=0.
    int len_a = request_describe_chunk(SESSION_A, 0, chunk_a, sizeof(chunk_a), &next_a, &more_a);
    int len_b = request_describe_chunk(SESSION_B, 0, chunk_b, sizeof(chunk_b), &next_b, &more_b);

    zassert_true(len_a > 0);
    zassert_true(len_b > 0);

    // Both responses must be identical since describe is stateless.
    zassert_equal(len_a, len_b);
    zassert_equal(next_a, next_b);
    zassert_equal(more_a, more_b);
    zassert_mem_equal(chunk_a, chunk_b, len_a);
}

ZTEST(stow_protocol_describe, test_filter_chunks_over_matching_items)
{
    narrow_transport.send = test_transport.send;
    zassert_equal(test_endpoint_open(SESSION_A, STOW_ROLE_GUEST, &narrow_transport), 0);

    const char* const names[] = { "StowHash", "TestSessionInt", "TestLongString" };
    uint8_t chunk[TEST_BUF_DATA_SIZE];
    uint32_t ids[STOW_ID_COUNT];
    uint32_t next_id = 0;
    bool more_remaining = true;
    size_t total = 0;
    uint32_t iterations = 0;

    while (more_remaining)
    {
        int len = request_filtered_chunk(
            SESSION_A, next_id, names, ARRAY_SIZE(names), chunk, sizeof(chunk), &next_id, &more_remaining);
        zassert_true(len > 0);
        total += parse_chunk(chunk, len, &ids[total]);
        zassert_true(
            !more_remaining || next_id == STOW_ID_TEST_SESSION_INT || next_id == STOW_ID_TEST_LONG_STRING,
            "next_item_id %u is not a matching item", next_id);
        zassert_true(++iterations < 8, "describe did not terminate");
    }

    zassert_true(iterations > 1, "filtered describe fit in one chunk");
    zassert_equal(total, 3);
    zassert_equal(ids[0], STOW_ID_STOW_HASH);
    zassert_equal(ids[1], STOW_ID_TEST_SESSION_INT);
    zassert_equal(ids[2], STOW_ID_TEST_LONG_STRING);
}

ZTEST(stow_protocol_describe, test_session_on_too_small_a_transport_asserts)
{
    atomic_clear(&g_asserts);
    atomic_set(&g_expect_assert, 1);
    int ret = test_endpoint_open(SESSION_SMALL, STOW_ROLE_GUEST, &small_transport);
    test_sync();
    atomic_clear(&g_expect_assert);

    zassert_equal(ret, 0);
    zassert_true(atomic_get(&g_asserts) > 0, "no description was found too large");
}

ZTEST(stow_protocol_describe, test_session_on_a_large_enough_transport_does_not_assert)
{
    atomic_clear(&g_asserts);
    atomic_set(&g_expect_assert, 1);
    int ret = test_endpoint_open(SESSION_A, STOW_ROLE_GUEST, &test_transport);
    test_sync();
    atomic_clear(&g_expect_assert);

    zassert_equal(ret, 0);
    zassert_equal(atomic_get(&g_asserts), 0);
}

ZTEST(stow_protocol_describe, test_item_too_large_for_an_empty_response_is_too_large)
{
    atomic_set(&g_expect_assert, 1);
    zassert_equal(test_endpoint_open(SESSION_SMALL, STOW_ROLE_GUEST, &small_transport), 0);
    test_sync();
    atomic_clear(&g_expect_assert);

    uint8_t req[16];
    int len = build_describe(req, sizeof(req), 0, NULL, 0);
    zassert_equal(test_submit_rx(SESSION_SMALL, req, len), 0);

    struct test_capture cap = test_await_tx(K_SECONDS(1));
    zassert_not_null(cap.buf);
    struct test_error error;
    zassert_true(test_decode_error(cap.buf, &error));
    zassert_equal(error.code, STOW_ERR_TOO_LARGE);
    zassert_equal(error.tag, TEST_TAG);
    zassert_equal(error.item, 0);
    net_buf_unref(cap.buf);
}
```

## src/test_stow_protocol_errors.c
```c
/*
 * Copyright (c) 2026 Demizo
 *
 * SPDX-License-Identifier: Apache-2.0
 */

#include "test_common.h"

#define SESSION_ID 81

static void before_each(void* fixture)
{
    (void)fixture;
    test_reset();
    test_open_session(SESSION_ID, STOW_ROLE_GUEST);
}

static void after_each(void* fixture)
{
    (void)fixture;
    test_endpoint_close(SESSION_ID);
    test_sync();
    test_drain_captures();
    stow_init();
}

ZTEST_SUITE(stow_protocol_errors, NULL, NULL, before_each, after_each, NULL);

static struct test_error exchange_error(const uint8_t* request, size_t len)
{
    zassert_equal(test_submit_rx(SESSION_ID, request, len), 0);
    struct test_capture cap = test_await_tx(K_SECONDS(1));
    zassert_not_null(cap.buf, "no response");
    zassert_equal(cap.session_id, SESSION_ID);
    struct test_error error;
    zassert_true(test_decode_error(cap.buf, &error), "response is not an Error");
    net_buf_unref(cap.buf);
    return error;
}

ZTEST(stow_protocol_errors, test_oversized_response_is_too_large)
{
    char long_value[351];
    memset(long_value, 'x', sizeof(long_value) - 1);
    long_value[sizeof(long_value) - 1] = '\0';
    data_value_t value = { .type = STOW_ITEM_TYPE_STRING, .data.string_value = long_value };
    zassert_equal(stow_set(STOW_ID_TEST_LONG_STRING, value), 0);

    uint8_t req[16];
    int len = test_build_with_id(req, sizeof(req), STOW_MSG_GET, TEST_TAG, STOW_ID_TEST_LONG_STRING);
    struct test_error error = exchange_error(req, len);
    zassert_equal(error.code, STOW_ERR_TOO_LARGE);
    zassert_equal(error.tag, TEST_TAG);
    zassert_equal(error.item, STOW_ID_TEST_LONG_STRING);
}

ZTEST(stow_protocol_errors, test_set_allocation_failure_returns_out_of_memory)
{
    uint8_t req[16];
    zcbor_state_t enc[4];
    zcbor_new_encode_state(enc, ARRAY_SIZE(enc), req, sizeof(req), 1);
    const uint8_t payload[] = { 0x01, 0x02, 0x03 };
    struct zcbor_string bstr = { .value = payload, .len = sizeof(payload) };
    zassert_true(
        zcbor_list_start_encode(enc, 4) && zcbor_uint32_put(enc, STOW_MSG_SET) && zcbor_uint32_put(enc, TEST_TAG) &&
        zcbor_uint32_put(enc, STOW_ID_TEST_BUFFER) && zcbor_bstr_encode(enc, &bstr) && zcbor_list_end_encode(enc, 4));
    size_t len = enc[0].payload - req;

    void* blocks[256] = { 0 };
    size_t block_count = 0;
    while (block_count < ARRAY_SIZE(blocks) && mem_alloc(1, &blocks[block_count]) == 0)
    {
        block_count++;
    }
    zassert_true(block_count < ARRAY_SIZE(blocks), "memory pools were not exhausted");
    zassert_true(block_count >= 1);
    mem_unref(&blocks[--block_count]);

    zassert_equal(test_submit_rx(SESSION_ID, req, len), 0);
    struct test_capture cap = test_await_tx(K_SECONDS(1));

    for (size_t i = 0; i < block_count; i++)
    {
        mem_unref(&blocks[i]);
    }

    zassert_not_null(cap.buf);
    uint32_t cmd;
    zcbor_state_t dec[4];
    zassert_true(test_decode_response_header(cap.buf, &cmd, NULL, dec, ARRAY_SIZE(dec)));
    zassert_equal(cmd, STOW_MSG_ERROR, "expected Error (got %u)", cmd);
    uint32_t code;
    zassert_true(zcbor_uint32_decode(dec, &code));
    zassert_equal(code, STOW_ERR_OUT_OF_MEMORY);
    net_buf_unref(cap.buf);
}
```

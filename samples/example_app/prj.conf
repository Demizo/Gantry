## CMakeLists.txt
```
cmake_minimum_required(VERSION 3.20.0)

find_package(Zephyr REQUIRED HINTS $ENV{ZEPHYR_BASE})
project(gantry_example_app)

zephyr_cc_option(-Wfatal-errors)

gantry_stow_add_fragment(${CMAKE_CURRENT_SOURCE_DIR}/ble.stow.yaml)

target_include_directories(app PRIVATE 
    inc
)

target_sources(app PRIVATE
    src/main.c
    src/session_manager.c
    src/msg_event.c
    src/uart_interface.c
    src/ble_manager.c
    src/ble_interface.c
)


target_compile_options(app PRIVATE -Wall -Wextra)
```

## Kconfig
```
source "Kconfig.zephyr"

menu "Example App"

rsource "config/Kconfig.main"

rsource "config/Kconfig.session"

rsource "config/Kconfig.uart"

rsource "config/Kconfig.ble"

endmenu
```

## sample.yaml
```
sample:
  name: Gantry example app
tests:
  example_app.build:
    build_only: true
    platform_allow:
      - nrf52840dk/nrf52840
```

## prj.conf
```kconfig
# Generic configuration
CONFIG_MAIN_STACK_SIZE=4096
CONFIG_GPIO=y

CONFIG_CBPRINTF_FP_SUPPORT=y

CONFIG_DEBUG=y
CONFIG_NO_OPTIMIZATIONS=n
CONFIG_SIZE_OPTIMIZATIONS=y

# Logging
CONFIG_LOG=y
CONFIG_LOG_BUFFER_SIZE=2048
CONFIG_LOG_BACKEND_RTT=y
CONFIG_USE_SEGGER_RTT=y
CONFIG_LOG_BACKEND_UART=n

# Enable the Gantry library
CONFIG_GANTRY=y

# Run Gantry's cppcheck configuration against the application source. Leave this off when using our own analysis configuration.
CONFIG_GANTRY_ANALYSIS_CPPCHECK=y

# Stow Dependencies
CONFIG_ZCBOR=y

# Enable the Stow
CONFIG_GANTRY_STOW=y

# Enable application modules
CONFIG_GANTRY_MODULE=y

# Enable the Stow Protocol
CONFIG_STOW_PROTOCOL=y

# UART
CONFIG_POLL=y
CONFIG_SERIAL=y
CONFIG_UART_INTERRUPT_DRIVEN=y
CONFIG_RING_BUFFER=y

# Bluetooth
CONFIG_BT=y
CONFIG_BT_PERIPHERAL=y
CONFIG_BT_DEVICE_NAME_DYNAMIC=y
CONFIG_BT_DEVICE_NAME_MAX=25
CONFIG_BT_DEVICE_NAME="Gantry"
CONFIG_BT_EXT_ADV=y
CONFIG_BT_CTLR_ADV_DATA_LEN_MAX=191
CONFIG_BT_BUF_ACL_RX_SIZE=251
CONFIG_BT_L2CAP_TX_MTU=247

# Raw COBS transport for the Stow Protocol
CONFIG_STOW_COBS_TRANSPORT=y

# Memory
CONFIG_GANTRY_MEMORY=y

# Optional memory debugging
CONFIG_MEM_TRACE=n
CONFIG_MEM_WATERMARK=n

# Memory Pools
CONFIG_MEM_POOL_COUNT=3
CONFIG_MEM_POOL1_BLOCK_SIZE=16
CONFIG_MEM_POOL1_BLOCK_COUNT=128
CONFIG_MEM_POOL2_BLOCK_SIZE=128
CONFIG_MEM_POOL2_BLOCK_COUNT=64
CONFIG_MEM_POOL3_BLOCK_SIZE=1024
CONFIG_MEM_POOL3_BLOCK_COUNT=16
```

## boards/nrf52840dk_nrf52840.conf
```kconfig
CONFIG_FLASH=y
CONFIG_FLASH_MAP=y
CONFIG_NVS=y
CONFIG_SETTINGS_NVS=y
CONFIG_MPU_ALLOW_FLASH_WRITE=y
```

## boards/nrf54lm20dk_nrf54lm20a_cpuapp.conf
```kconfig
CONFIG_FLASH=y
CONFIG_FLASH_MAP=y
CONFIG_ZMS=y
CONFIG_SETTINGS_ZMS=y
```

## src/main.c
```c
/*
 * Copyright (c) 2026 Demizo
 *
 * SPDX-License-Identifier: Apache-2.0
 */

/**
 * @file
 * @brief Entry point for the example app
 *
 * @author Demizo (demizodemazo@gmail.com)
 */

#include <zephyr/app_version.h>
#include <zephyr/kernel.h>
#include <zephyr/logging/log.h>

/**
 * @brief Logger for module
 */
LOG_MODULE_REGISTER(main, CONFIG_MAIN_LOG_LEVEL);

//**********************************************************
//* Local Definitions
//**********************************************************

//**********************************************************
//* Static Function Declarations
//**********************************************************

//**********************************************************
//* Static Variable Definitions
//**********************************************************

//**********************************************************
//* Static Function Definitions
//**********************************************************

//**********************************************************
//* Public Function Definitions
//**********************************************************

int main(void)
{
    LOG_INF("Starting Gantry example v%s", APP_VERSION_STRING);

    // Gantry modules are started automatically

    return 0;
}
```

## inc/ble_interface.h
```c
/*
 * Copyright (c) 2026 Demizo
 *
 * SPDX-License-Identifier: Apache-2.0
 */

/**
 * @file
 * @brief BLE Interface
 *
 * @details Handles sending and receiving messages over BLE.
 *
 * @author Demizo (demizodemazo@gmail.com)
 */

#pragma once

#include <zephyr/kernel.h>
#include <zephyr/types.h>

//**********************************************************
//* Definitions
//**********************************************************

#define BT_UUID_NUS_VAL BT_UUID_128_ENCODE(0x6e400001, 0xb5a3, 0xf393, 0xe0a9, 0xe50e24dcca9e)
#define BT_UUID_NUS_RX_VAL BT_UUID_128_ENCODE(0x6e400002, 0xb5a3, 0xf393, 0xe0a9, 0xe50e24dcca9e)
#define BT_UUID_NUS_TX_VAL BT_UUID_128_ENCODE(0x6e400003, 0xb5a3, 0xf393, 0xe0a9, 0xe50e24dcca9e)

#define BT_UUID_NUS BT_UUID_DECLARE_128(BT_UUID_NUS_VAL)
#define BT_UUID_NUS_RX BT_UUID_DECLARE_128(BT_UUID_NUS_RX_VAL)
#define BT_UUID_NUS_TX BT_UUID_DECLARE_128(BT_UUID_NUS_TX_VAL)

//**********************************************************
//* Typedefs, Enums, and Structs
//**********************************************************

/**
 * @brief Encoded frames waiting to be sent over BLE, as `struct net_buf*`
 */
extern struct k_msgq ble_tx_queue;

//**********************************************************
//* Functions
//**********************************************************
```

## inc/ble_manager.h
```c
/*
 * Copyright (c) 2026 Demizo
 *
 * SPDX-License-Identifier: Apache-2.0
 */

/**
 * @file
 * @brief BLE Manager
 *
 * @details Manages BLE connections.
 *
 * @author Demizo (demizodemazo@gmail.com)
 */

#pragma once

#include <zephyr/types.h>

//**********************************************************
//* Definitions
//**********************************************************

//**********************************************************
//* Typedefs, Enums, and Structs
//**********************************************************

//**********************************************************
//* Functions
//**********************************************************
```

## inc/msg_event.h
```c
/*
 * Copyright (c) 2026 Demizo
 *
 * SPDX-License-Identifier: Apache-2.0
 */

/**
 * @file
 * @brief Message event
 *
 * @details Event type for messages sent and received by the application
 *
 * @author Demizo (demizodemazo@gmail.com)
 *
 */

#pragma once

#include <gantry/event.h>
#include <zephyr/net_buf.h>

//**********************************************************
//* Definitions
//**********************************************************

#define EVENT_ID_MSG 0xffff0001

//**********************************************************
//* Typedefs, Enums, and Structs
//**********************************************************

struct msg_event_payload
{
    struct net_buf* buf;
};

DECLARE_EVENT_TYPE(msg_event);

//**********************************************************
//* Functions
//**********************************************************

/**
 * @brief Allocate a message event.
 *
 * @param[in] buf net_buf containing the message
 * @param[out] event_ptr Populated with the allocated event on success
 *
 * @return SUCCESS or a negative error code.
 * @acquires memory event_ptr on-success
 */
int msg_event_alloc(struct net_buf* buf, event_t** event_ptr);
```

## inc/session_manager.h
```c
/*
 * Copyright (c) 2026 Demizo
 *
 * SPDX-License-Identifier: Apache-2.0
 */

/**
 * @file
 * @brief Session Manager
 *
 * @author Demizo (demizodemazo@gmail.com)
 *
 */

#pragma once

#include <gantry/stow/stow_cobs_transport.h>
#include <stdint.h>
#include <zephyr/net_buf.h>

//**********************************************************
//* Definitions
//**********************************************************

#define UART_SESSION_ID 1U
#define UART_SESSION_ROLES STOW_ROLE_ANY

#define BLE_SESSION_ID 2U
#define BLE_SESSION_ROLES STOW_ROLE_SESSION

//**********************************************************
//* Typedefs, Enums, and Structs
//**********************************************************

/**
 * @brief Raw COBS transport for the UART link
 */
extern struct stow_cobs_transport uart_link;

/**
 * @brief Raw COBS transport for the BLE link
 */
extern struct stow_cobs_transport ble_link;

//**********************************************************
//* Functions
//**********************************************************
```

## inc/uart_interface.h
```c
/*
 * Copyright (c) 2026 Demizo
 *
 * SPDX-License-Identifier: Apache-2.0
 */

/**
 * @file
 * @brief UART Interface
 *
 * @details Handles sending and receiving messages over UART.
 *
 * @author Demizo (demizodemazo@gmail.com)
 */

#pragma once

#include <zephyr/kernel.h>
#include <zephyr/types.h>

//**********************************************************
//* Definitions
//**********************************************************

//**********************************************************
//* Typedefs, Enums, and Structs
//**********************************************************

/**
 * @brief Encoded frames waiting to be sent over UART, as `struct net_buf*`
 */
extern struct k_msgq uart_tx_queue;

//**********************************************************
//* Functions
//**********************************************************
```

## src/ble_interface.c
```c
/*
 * Copyright (c) 2026 Demizo
 *
 * SPDX-License-Identifier: Apache-2.0
 */

/**
 * @file
 * @brief BLE Interface
 *
 * @author Demizo (demizodemazo@gmail.com)
 *
 */

#include "ble_interface.h"

#include <gantry/error.h>
#include <gantry/module.h>
#include <gantry/ownership.h>
#include <gantry/stow/stow_cobs_transport.h>
#include <generated_stow_items.h>
#include <zephyr/bluetooth/bluetooth.h>
#include <zephyr/bluetooth/conn.h>
#include <zephyr/bluetooth/gatt.h>
#include <zephyr/bluetooth/uuid.h>
#include <zephyr/kernel.h>
#include <zephyr/logging/log.h>
#include <zephyr/net_buf.h>

#include "gantry/event.h"
#include "msg_event.h"
#include "session_manager.h"
#include "zephyr/sys/clock.h"

/**
 * @brief Logger for module
 */
LOG_MODULE_REGISTER(ble_interface, CONFIG_BLE_INTERFACE_LOG_LEVEL);

//**********************************************************
//* Local Definitions
//**********************************************************

//**********************************************************
//* Static Function Declarations
//**********************************************************

static void on_connected(struct bt_conn* conn, uint8_t err);
static void on_disconnected(struct bt_conn* conn, uint8_t reason);
static ssize_t nus_rx_write(
    struct bt_conn* conn, const struct bt_gatt_attr* attr, const void* data, uint16_t len, uint16_t offset,
    uint8_t flags);
static void nus_tx_ccc_changed(const struct bt_gatt_attr* attr, uint16_t value);
static int ble_interface_tx(const uint8_t* data, uint16_t len);
static int ble_notify(struct bt_conn* conn, const uint8_t* data, uint16_t len);
static void ble_interface_init(void);
static void ble_interface_thread(void* arg1, void* arg2, void* arg3);

//**********************************************************
//* Static Variable Definitions
//**********************************************************

K_MSGQ_DEFINE(ble_interface_queue, sizeof(event_t*), CONFIG_BLE_INTERFACE_QUEUE_DEPTH, sizeof(void*));
K_MSGQ_DEFINE(ble_tx_queue, sizeof(struct net_buf*), CONFIG_BLE_INTERFACE_QUEUE_DEPTH, sizeof(void*));

// Module registration
GANTRY_MODULE_DEFINE(
    ble_interface, ble_interface_init, ble_interface_thread, CONFIG_BLE_INTERFACE_STACK_SIZE,
    CONFIG_BLE_INTERFACE_THREAD_PRIORITY);

// Pool for received data
NET_BUF_POOL_DEFINE(ble_rx_pool, CONFIG_BLE_INTERFACE_RX_POOL_COUNT, CONFIG_BLE_INTERFACE_RX_POOL_BUF_SIZE, 0, NULL);

// The current BLE connection
static struct bt_conn* current_conn;

// Callbacks for tracking BLE connection state
BT_CONN_CB_DEFINE(ble_interface_conn_cb) = {
    .connected = on_connected,
    .disconnected = on_disconnected,
};

// Nordic UART service
BT_GATT_SERVICE_DEFINE(
    nus_svc, BT_GATT_PRIMARY_SERVICE(BT_UUID_NUS),
    BT_GATT_CHARACTERISTIC(BT_UUID_NUS_TX, BT_GATT_CHRC_NOTIFY, BT_GATT_PERM_NONE, NULL, NULL, NULL),
    BT_GATT_CCC(nus_tx_ccc_changed, BT_GATT_PERM_READ | BT_GATT_PERM_WRITE),
    BT_GATT_CHARACTERISTIC(
        BT_UUID_NUS_RX, BT_GATT_CHRC_WRITE | BT_GATT_CHRC_WRITE_WITHOUT_RESP, BT_GATT_PERM_WRITE, NULL, nus_rx_write,
        NULL));

//**********************************************************
//* Static Function Definitions
//**********************************************************

static void on_connected(struct bt_conn* conn, uint8_t err)
{
    if (err != 0)
    {
        return;
    }
    struct bt_conn* ref = bt_conn_ref(conn);
    uint32_t key = irq_lock();
    current_conn = ref;
    irq_unlock(key);
}

static void on_disconnected(struct bt_conn* conn, uint8_t reason)
{
    ARG_UNUSED(conn);
    ARG_UNUSED(reason);
    uint32_t key = irq_lock();
    struct bt_conn* old = current_conn;
    current_conn = NULL;
    irq_unlock(key);
    if (old != NULL)
    {
        bt_conn_unref(old);
    }

    event_t* event = NULL;
    while (k_msgq_get(&ble_interface_queue, (void*)&event, K_NO_WAIT) == 0)
    {
        EVENT_UNREF(&event);
    }

    struct net_buf* frame = NULL;
    while (k_msgq_get(&ble_tx_queue, (void*)&frame, K_NO_WAIT) == 0)
    {
        net_buf_unref(frame);
    }
}

static ssize_t nus_rx_write(
    struct bt_conn* conn, const struct bt_gatt_attr* attr, const void* data, uint16_t len, uint16_t offset,
    uint8_t flags)
{
    ARG_UNUSED(conn);
    ARG_UNUSED(attr);
    ARG_UNUSED(offset);
    ARG_UNUSED(flags);

    struct net_buf* buf = net_buf_alloc(&ble_rx_pool, K_NO_WAIT);
    if (buf == NULL)
    {
        LOG_WRN("BLE RX pool exhausted; dropping %u bytes", len);
        return len;
    }

    if (net_buf_tailroom(buf) < len)
    {
        LOG_WRN("BLE RX chunk (%u) exceeds buf size; dropping", len);
        net_buf_unref(buf);
        return len;
    }

    net_buf_add_mem(buf, data, len);

    event_t* event = NULL;
    int ret = msg_event_alloc(buf, &event);
    if (ret != SUCCESS)
    {
        LOG_WRN("Failed to allocate rx event: %d", ret);
        net_buf_unref(buf);
        return len;
    }
    PASS_OWNERSHIP(buf);

    if (k_msgq_put(&ble_interface_queue, (const void*)&event, K_NO_WAIT) != 0)
    {
        LOG_WRN("Failed to queue message event; dropping %u bytes", len);
        event_unref(&event);
    }

    PASS_OWNERSHIP(event);
    return len;
}

static void nus_tx_ccc_changed(const struct bt_gatt_attr* attr, uint16_t value)
{
    ARG_UNUSED(attr);
    LOG_DBG("NUS TX notifications %s", value == BT_GATT_CCC_NOTIFY ? "enabled" : "disabled");
}

static int ble_interface_tx(const uint8_t* data, uint16_t len)
{
    uint32_t key = irq_lock();
    struct bt_conn* conn = current_conn != NULL ? bt_conn_ref(current_conn) : NULL;
    irq_unlock(key);
    if (conn == NULL)
    {
        return -ENOTCONN;
    }
    int ret = ble_notify(conn, data, len);
    bt_conn_unref(conn);
    return ret;
}

static int ble_notify(struct bt_conn* conn, const uint8_t* data, uint16_t len)
{
    if (data == NULL || len == 0U)
    {
        return -EINVAL;
    }

    uint16_t mtu = bt_gatt_get_mtu(conn);
    if (mtu <= 3U)
    {
        return -EIO;
    }
    uint16_t chunk_size = mtu - 3U;  // ATT notify header

    const struct bt_gatt_attr* tx_attr = &nus_svc.attrs[1];

    uint16_t offset = 0U;
    while (offset < len)
    {
        uint16_t remaining = len - offset;
        uint16_t chunk = remaining < chunk_size ? remaining : chunk_size;

        int ret = bt_gatt_notify(conn, tx_attr, &data[offset], chunk);
        if (ret != 0)
        {
            LOG_WRN("bt_gatt_notify failed at offset %u: %d", offset, ret);
            return ret;
        }
        offset += chunk;
    }

    return SUCCESS;
}

static void ble_interface_init(void) { LOG_INF("BLE interface initialized"); }

static void ble_interface_thread(void* arg1, void* arg2, void* arg3)
{
    ARG_UNUSED(arg1);
    ARG_UNUSED(arg2);
    ARG_UNUSED(arg3);

    int ret;
    event_t* event = NULL;
    struct net_buf* frame = NULL;

    struct k_poll_event poll_events[2] = {
        K_POLL_EVENT_STATIC_INITIALIZER(
            K_POLL_TYPE_MSGQ_DATA_AVAILABLE, K_POLL_MODE_NOTIFY_ONLY, &ble_interface_queue, 0),
        K_POLL_EVENT_STATIC_INITIALIZER(K_POLL_TYPE_MSGQ_DATA_AVAILABLE, K_POLL_MODE_NOTIFY_ONLY, &ble_tx_queue, 0),
    };

    LOG_INF("BLE interface thread started");

    while (true)
    {
        k_poll(poll_events, ARRAY_SIZE(poll_events), K_FOREVER);

        while (k_msgq_get(&ble_interface_queue, (void*)&event, K_NO_WAIT) == 0)
        {
            ASSERT(event->type == &msg_event, "Unexpected event type");

            struct msg_event_payload* payload = (struct msg_event_payload*)event->data.buf;
            ret = stow_cobs_transport_feed(&ble_link, payload->buf->data, payload->buf->len);
            if (ret != SUCCESS)
            {
                LOG_WRN("Failed to receive BLE frame: %d", ret);
            }

            EVENT_UNREF(&event);
        }

        while (k_msgq_get(&ble_tx_queue, (void*)&frame, K_NO_WAIT) == 0)
        {
            ret = ble_interface_tx(frame->data, frame->len);
            if (ret != SUCCESS && ret != -ENOTCONN)
            {
                LOG_WRN("Failed to transmit over BLE: %d", ret);
            }
            net_buf_unref(frame);
        }

        poll_events[0].state = K_POLL_STATE_NOT_READY;
        poll_events[1].state = K_POLL_STATE_NOT_READY;
    }
}

//**********************************************************
//* Public Function Definitions
//**********************************************************
```

## src/ble_manager.c
```c
/*
 * Copyright (c) 2026 Demizo
 *
 * SPDX-License-Identifier: Apache-2.0
 */

/**
 * @file
 * @brief BLE Manager
 *
 * @author Demizo (demizodemazo@gmail.com)
 *
 */

#include "ble_manager.h"

#include <gantry/error.h>
#include <gantry/event.h>
#include <gantry/flags.h>
#include <gantry/module.h>
#include <gantry/stow/stow.h>
#include <gantry/stow/stow_cobs_transport.h>
#include <gantry/stow/stow_event.h>
#include <generated_stow_enums.h>
#include <generated_stow_items.h>
#include <zephyr/bluetooth/bluetooth.h>
#include <zephyr/bluetooth/conn.h>
#include <zephyr/bluetooth/uuid.h>
#include <zephyr/kernel.h>
#include <zephyr/logging/log.h>

#include "ble_interface.h"
#include "session_manager.h"
#include "zephyr/bluetooth/addr.h"
#include "zephyr/bluetooth/hci_types.h"

/**
 * @brief Logger for module
 */
LOG_MODULE_REGISTER(ble_manager, CONFIG_BLE_MANAGER_LOG_LEVEL);

//**********************************************************
//* Local Definitions
//**********************************************************

//**********************************************************
//* Static Function Declarations
//**********************************************************

static void on_connected(struct bt_conn* conn, uint8_t err);
static void on_disconnected(struct bt_conn* conn, uint8_t reason);
static void on_recycled(void);
static int update_advertising_data(void);
static int start_advertising(void);
static void adv_restart_work_handler(struct k_work* work);
static void apply_current_device_name(void);
static void handle_update(event_t* event);
static void ble_manager_init(void);
static void ble_manager_thread(void* arg1, void* arg2, void* arg3);

//**********************************************************
//* Static Variable Definitions
//**********************************************************

GANTRY_MODULE_DEFINE(
    ble_manager, ble_manager_init, ble_manager_thread, CONFIG_BLE_MANAGER_STACK_SIZE,
    CONFIG_BLE_MANAGER_THREAD_PRIORITY);

FLAGS_DEFINE(ble_manager_flags, (INITIALIZED, CONNECTED), { FLAG_REQUIRES(CONNECTED, INITIALIZED); });

K_MSGQ_DEFINE(ble_manager_queue, sizeof(event_t*), CONFIG_BLE_MANAGER_QUEUE_DEPTH, sizeof(void*));

// Stow subscriptions
STOW_CALLBACK_DEFINE(on_stow_update, ble_manager_queue);
STOW_SUBSCRIPTION_DEFINE(
    ble_manager_stow_sub, STOW_SUBSCRIPTION_HANDLE, on_stow_update, STOW_ID_DEVICE_NAME, STOW_ID_BLE_CONNECTION_STATE);

// Extended advertising set
static struct bt_le_ext_adv* adv_set = NULL;

// Work for restarting advertising
K_WORK_DEFINE(adv_restart_work, adv_restart_work_handler);

// Callbacks for tracking BLE connection state
BT_CONN_CB_DEFINE(ble_conn_cb) = {
    .connected = on_connected,
    .disconnected = on_disconnected,
    .recycled = on_recycled,
};

// The current BLE connection
static struct bt_conn* current_conn;

//**********************************************************
//* Static Function Definitions
//**********************************************************

static void on_connected(struct bt_conn* conn, uint8_t err)
{
    int ret;
    char address[BT_ADDR_LE_STR_LEN];

    if (err != 0)
    {
        LOG_WRN("Connection failed: %u", err);
        return;
    }

    // Update the connection state
    data_value_t value = {
        .type = STOW_ITEM_TYPE_ENUM,
        .data = { .int_value = BleConnectionState_CONNECTED },
    };
    (void)STOW_SET(STOW_ID_BLE_CONNECTION_STATE, value);

    // Open the Stow session
    ret = stow_cobs_transport_open(&ble_link);
    if (ret != SUCCESS)
    {
        LOG_ERR("Failed to open BLE session: %d", ret);
    }

    current_conn = bt_conn_ref(conn);

    bt_addr_le_to_str(bt_conn_get_dst(conn), address, sizeof(address));
    LOG_INF("Connected (%s)", address);

    SET_FLAG(ble_manager_flags, CONNECTED);
}

static void on_disconnected(struct bt_conn* conn, uint8_t reason)
{
    char address[BT_ADDR_LE_STR_LEN];

    // Update the connection state
    data_value_t value = {
        .type = STOW_ITEM_TYPE_ENUM,
        .data = { .int_value = BleConnectionState_DISCONNECTED },
    };
    (void)STOW_SET(STOW_ID_BLE_CONNECTION_STATE, value);

    // Close the Stow session
    stow_cobs_transport_close(&ble_link);

    if (current_conn != NULL)
    {
        bt_conn_unref(current_conn);
        current_conn = NULL;
    }

    bt_addr_le_to_str(bt_conn_get_dst(conn), address, sizeof(address));
    LOG_INF("Disconnected (%s), reason: %d", address, reason);

    CLEAR_FLAG(ble_manager_flags, CONNECTED);
}

static void on_recycled(void) { k_work_submit(&adv_restart_work); }

static int update_advertising_data(void)
{
    const char* name = bt_get_name();
    const struct bt_data advertising_data[] = {
        BT_DATA_BYTES(BT_DATA_FLAGS, (BT_LE_AD_GENERAL | BT_LE_AD_NO_BREDR)),
        BT_DATA_BYTES(BT_DATA_UUID128_ALL, BT_UUID_NUS_VAL),
        BT_DATA(BT_DATA_NAME_COMPLETE, name, strlen(name)),
    };

    return bt_le_ext_adv_set_data(adv_set, advertising_data, ARRAY_SIZE(advertising_data), NULL, 0);
}

static int start_advertising(void)
{
    int ret = update_advertising_data();
    if (ret != SUCCESS)
    {
        LOG_ERR("Failed to set advertising data: %d", ret);
        return ret;
    }

    ret = bt_le_ext_adv_start(adv_set, BT_LE_EXT_ADV_START_DEFAULT);
    if (ret != SUCCESS)
    {
        LOG_ERR("Failed to start advertising: %d", ret);
        return ret;
    }

    LOG_INF("Advertising as \"%s\"", bt_get_name());
    return SUCCESS;
}

static void adv_restart_work_handler(struct k_work* work)
{
    ARG_UNUSED(work);
    LOG_DBG("Restarting advertising");
    (void)start_advertising();
}

static void apply_current_device_name(void)
{
    data_value_t value;
    int ret = STOW_GET(STOW_ID_DEVICE_NAME, &value);
    if (ret == SUCCESS)
    {
        int set_ret = bt_set_name(value.data.string_value);
        if (set_ret != 0)
        {
            LOG_ERR("Failed to set device name: %d", set_ret);
        }
    }
    else
    {
        LOG_WRN("Failed to get current device name: %d", ret);
    }

    STOW_RELEASE(STOW_ID_DEVICE_NAME, &value);
}

static void handle_update(event_t* event)
{
    const struct stow_update_event_payload* payload = stow_update_payload(event);
    const enum stow_item_id id = (enum stow_item_id)payload->metadata->id;

    switch (id)
    {
        case STOW_ID_DEVICE_NAME:
        {
            apply_current_device_name();

            if (!CHECK_FLAG(ble_manager_flags, CONNECTED))
            {
                int ret = update_advertising_data();
                if (ret != SUCCESS)
                {
                    LOG_ERR("Failed to set advertising data: %d", ret);
                    break;
                }

                LOG_INF("Updated name \"%s\"", bt_get_name());
            }

            break;
        }
        case STOW_ID_BLE_CONNECTION_STATE:
        {
            if ((!CHECK_FLAG(ble_manager_flags, CONNECTED)) || (current_conn == NULL))
            {
                // Already disconnected, nothing to do
                break;
            }

            // Check if a disconnect was initiated
            data_value_t value;
            int ret = STOW_GET(STOW_ID_BLE_CONNECTION_STATE, &value);
            if (ret == SUCCESS)
            {
                if (value.data.int_value == BleConnectionState_DISCONNECTED)
                {
                    // Trigger a disconnect
                    bt_conn_disconnect(current_conn, BT_HCI_ERR_REMOTE_USER_TERM_CONN);
                }
            }

            STOW_RELEASE(STOW_ID_BLE_CONNECTION_STATE, &value);
            break;
        }
        default:
        {
            LOG_WRN("Unexpected item (%d)", id);
            break;
        }
    }
}

static void ble_manager_init(void)
{
    int ret;

    ret = bt_enable(NULL);
    if (ret != 0)
    {
        LOG_ERR("Failed to enable BLE: %d", ret);
        return;
    }

    // Set the device name
    apply_current_device_name();

    // Create the advertising settings
    struct bt_le_adv_param adv_param = {
        .options = (BT_LE_ADV_OPT_EXT_ADV | BT_LE_ADV_OPT_CONN),
        .interval_min = BT_GAP_ADV_FAST_INT_MIN_2,
        .interval_max = BT_GAP_ADV_FAST_INT_MAX_2,
        .peer = NULL,
    };
    ret = bt_le_ext_adv_create(&adv_param, NULL, &adv_set);
    if (ret != 0)
    {
        LOG_ERR("Failed to create advertising set: %d", ret);
        return;
    }

    SET_FLAG(ble_manager_flags, INITIALIZED);

    LOG_INF("BLE manager initialized");
}

static void ble_manager_thread(void* arg1, void* arg2, void* arg3)
{
    ARG_UNUSED(arg1);
    ARG_UNUSED(arg2);
    ARG_UNUSED(arg3);

    k_timepoint_t timeout_timepoint = sys_timepoint_calc(K_FOREVER);
    event_t* event = NULL;

    LOG_INF("BLE manager thread started");

    // Begin advertising
    (void)start_advertising();

    while (true)
    {
        if (k_msgq_get(&ble_manager_queue, (void*)&event, sys_timepoint_timeout(timeout_timepoint)) == 0)
        {
            switch (event->type->id)
            {
                case EVENT_ID_STOW_UPDATE:
                {
                    handle_update(event);
                    break;
                }
                default:
                {
                    LOG_WRN("Unexpected event id %u", event->type->id);
                    break;
                }
            }

            EVENT_UNREF(&event);
        }
        else
        {
            // Timed out, nothing to do
        }
    }
}

//**********************************************************
//* Public Function Definitions
//**********************************************************
```

## src/msg_event.c
```c
/*
 * Copyright (c) 2026 Demizo
 *
 * SPDX-License-Identifier: Apache-2.0
 */

/**
 * @file
 * @brief Message event
 *
 * @author Demizo (demizodemazo@gmail.com)
 */

#include "msg_event.h"

#include <gantry/error.h>
#include <gantry/event.h>
#include <gantry/memory.h>

//**********************************************************
//* Local Definitions
//**********************************************************

//**********************************************************
//* Static Function Declarations
//**********************************************************

static void on_free(event_t* event);

//**********************************************************
//* Static Variable Definitions
//**********************************************************

DEFINE_EVENT_TYPE(EVENT_ID_MSG, msg_event, on_free);

//**********************************************************
//* Static Function Definitions
//**********************************************************

static void on_free(event_t* event)
{
    struct msg_event_payload* payload = (struct msg_event_payload*)event->data.buf;
    if (payload->buf != NULL)
    {
        struct net_buf* buf = payload->buf;
        net_buf_unref(buf);
        payload->buf = NULL;
    }
}

//**********************************************************
//* Public Function Definitions
//**********************************************************

int msg_event_alloc(struct net_buf* buf, event_t** event_ptr)
{
    int ret = EVENT_ALLOC(&msg_event, sizeof(struct msg_event_payload), event_ptr);
    if (ret != SUCCESS)
    {
        return ret;
    }

    struct msg_event_payload* payload = (struct msg_event_payload*)(*event_ptr)->data.buf;
    payload->buf = buf;

    return SUCCESS;
}
```

## src/session_manager.c
```c
/*
 * Copyright (c) 2026 Demizo
 *
 * SPDX-License-Identifier: Apache-2.0
 */

/**
 * @file
 * @brief Session Manager
 *
 * @author Demizo (demizodemazo@gmail.com)
 *
 */

#include "session_manager.h"

#include <gantry/cobs_framer.h>
#include <gantry/error.h>
#include <gantry/module.h>
#include <gantry/stow/stow_cobs_transport.h>
#include <gantry/stow/stow_protocol.h>
#include <generated_stow_items.h>
#include <zephyr/logging/log.h>
#include <zephyr/net_buf.h>

#include "ble_interface.h"
#include "uart_interface.h"

/**
 * @brief Logger for module
 */
LOG_MODULE_REGISTER(session_manager, CONFIG_SESSION_MANAGER_LOG_LEVEL);

//**********************************************************
//* Local Definitions
//**********************************************************

#define MESSAGE_BUF_COUNT 10U
#define FRAME_BUF_SIZE COBS_ENCODE_MAX_SIZE(CONFIG_SESSION_MANAGER_MAX_MESSAGE_SIZE)
#define FRAME_BUF_COUNT 4U

//**********************************************************
//* Static Function Declarations
//**********************************************************

static int queue_frame(struct net_buf* frame, void* user_data);
static void session_manager_init(void);

//**********************************************************
//* Static Variable Definitions
//**********************************************************

NET_BUF_POOL_DEFINE(message_pool, MESSAGE_BUF_COUNT, CONFIG_SESSION_MANAGER_MAX_MESSAGE_SIZE, 0, NULL);
NET_BUF_POOL_DEFINE(uart_frame_pool, FRAME_BUF_COUNT, FRAME_BUF_SIZE, 0, NULL);
NET_BUF_POOL_DEFINE(ble_frame_pool, FRAME_BUF_COUNT, FRAME_BUF_SIZE, 0, NULL);

struct stow_cobs_transport uart_link;
struct stow_cobs_transport ble_link;

// Module registration
GANTRY_LIBRARY_MODULE_DEFINE(session_manager, session_manager_init);

//**********************************************************
//* Static Function Definitions
//**********************************************************

/**
 * @brief Queue an encoded frame for an interface's thread to send
 *
 * @details Matches @ref stow_cobs_write_t.
 *
 * @param frame Encoded frame
 * @param user_data The interface's transmit queue
 *
 * @return SUCCESS when the frame was queued
 * @return -ENOBUFS when the queue is full
 */
static int queue_frame(struct net_buf* frame, void* user_data)
{
    return (k_msgq_put((struct k_msgq*)user_data, (const void*)&frame, K_NO_WAIT) == 0) ? SUCCESS : -ENOBUFS;
}

static void session_manager_init(void)
{
    const struct stow_cobs_transport_config uart_config = {
        .server = &stow_protocol_endpoint,
        .session_id = UART_SESSION_ID,
        .roles = UART_SESSION_ROLES,
        .message_pool = &message_pool,
        .frame_pool = &uart_frame_pool,
        .write = queue_frame,
        .user_data = &uart_tx_queue,
    };
    int ret = stow_cobs_transport_init(&uart_link, &uart_config);
    ASSERT(ret == SUCCESS, "Failed to initialize the UART transport");

    const struct stow_cobs_transport_config ble_config = {
        .server = &stow_protocol_endpoint,
        .session_id = BLE_SESSION_ID,
        .roles = BLE_SESSION_ROLES,
        .message_pool = &message_pool,
        .frame_pool = &ble_frame_pool,
        .write = queue_frame,
        .user_data = &ble_tx_queue,
    };
    ret = stow_cobs_transport_init(&ble_link, &ble_config);
    ASSERT(ret == SUCCESS, "Failed to initialize the BLE transport");

    // The UART session is always open
    ret = stow_cobs_transport_open(&uart_link);
    if (ret != SUCCESS)
    {
        LOG_ERR("Failed to open UART session: %d", ret);
    }
}

//**********************************************************
//* Public Function Definitions
//**********************************************************
```

## src/uart_interface.c
```c
/*
 * Copyright (c) 2026 Demizo
 *
 * SPDX-License-Identifier: Apache-2.0
 */

/**
 * @file
 * @brief UART Interface
 *
 * @author Demizo (demizodemazo@gmail.com)
 *
 */

#include "uart_interface.h"

#include <gantry/error.h>
#include <gantry/module.h>
#include <gantry/stow/stow_cobs_transport.h>
#include <zephyr/drivers/uart.h>
#include <zephyr/kernel.h>
#include <zephyr/logging/log.h>
#include <zephyr/net_buf.h>
#include <zephyr/sys/ring_buffer.h>

#include "session_manager.h"

/**
 * @brief Logger for module
 */
LOG_MODULE_REGISTER(uart_interface, CONFIG_UART_INTERFACE_LOG_LEVEL);

//**********************************************************
//* Local Definitions
//**********************************************************

//**********************************************************
//* Static Function Declarations
//**********************************************************

static void uart_isr(const struct device* dev, void* user_data);
static void uart_interface_init(void);
static void uart_interface_thread(void* arg1, void* arg2, void* arg3);

//**********************************************************
//* Static Variable Definitions
//**********************************************************

K_MSGQ_DEFINE(uart_tx_queue, sizeof(struct net_buf*), CONFIG_UART_INTERFACE_QUEUE_DEPTH, sizeof(void*));

static const struct device* uart_dev = DEVICE_DT_GET(DT_CHOSEN(zephyr_console));

// Module registration
GANTRY_MODULE_DEFINE(
    uart_interface, uart_interface_init, uart_interface_thread, CONFIG_UART_INTERFACE_STACK_SIZE,
    CONFIG_UART_INTERFACE_THREAD_PRIORITY);

// Semaphore for signalling when data has been received
K_SEM_DEFINE(rx_sem, 0, 1);

// Ring buffer for incoming data
RING_BUF_DECLARE(rx_ring_buf, CONFIG_UART_INTERFACE_RX_RING_BUF_SIZE);

//**********************************************************
//* Static Function Definitions
//**********************************************************

static void uart_isr(const struct device* dev, void* user_data)
{
    ARG_UNUSED(user_data);

    uart_irq_update(dev);
    while (uart_irq_rx_ready(dev))
    {
        uint8_t byte = 0U;
        if (uart_fifo_read(dev, &byte, 1) == 1)
        {
            ring_buf_put(&rx_ring_buf, &byte, 1);
        }
    }

    // Signal that data is available
    k_sem_give(&rx_sem);
}

static void uart_interface_init(void)
{
    // Initialize the UART device
    if (!device_is_ready(uart_dev))
    {
        LOG_ERR("UART device not ready");
        return;
    }

    // Configure UART interrupts
    uart_irq_callback_user_data_set(uart_dev, uart_isr, NULL);
    uart_irq_rx_enable(uart_dev);

    LOG_INF("UART interface initialized");
}

static void uart_interface_thread(void* arg1, void* arg2, void* arg3)
{
    ARG_UNUSED(arg1);
    ARG_UNUSED(arg2);
    ARG_UNUSED(arg3);

    struct net_buf* frame = NULL;
    bool rx_failing = false;

    struct k_poll_event poll_events[2] = {
        K_POLL_EVENT_STATIC_INITIALIZER(K_POLL_TYPE_SEM_AVAILABLE, K_POLL_MODE_NOTIFY_ONLY, &rx_sem, 0),
        K_POLL_EVENT_STATIC_INITIALIZER(K_POLL_TYPE_MSGQ_DATA_AVAILABLE, K_POLL_MODE_NOTIFY_ONLY, &uart_tx_queue, 0),
    };

    LOG_INF("UART interface thread started");

    while (true)
    {
        k_poll(poll_events, ARRAY_SIZE(poll_events), K_FOREVER);

        // RX bytes received
        if (poll_events[0].state == K_POLL_STATE_SEM_AVAILABLE)
        {
            k_sem_take(&rx_sem, K_NO_WAIT);

            // Feed received bytes to the COBS decoder
            uint8_t byte;
            while (ring_buf_get(&rx_ring_buf, &byte, 1) == 1)
            {
                int ret = stow_cobs_transport_feed(&uart_link, &byte, 1);
                if (ret != SUCCESS && !rx_failing)
                {
                    LOG_WRN("Failed to receive UART frame: %d", ret);
                }
                rx_failing = (ret != SUCCESS);
            }

            poll_events[0].state = K_POLL_STATE_NOT_READY;
        }

        if (poll_events[1].state == K_POLL_STATE_MSGQ_DATA_AVAILABLE)
        {
            while (k_msgq_get(&uart_tx_queue, (void*)&frame, K_NO_WAIT) == 0)
            {
                // Transmit the COBS encoded message
                for (size_t i = 0; i < frame->len; i++)
                {
                    uart_poll_out(uart_dev, frame->data[i]);
                }

                net_buf_unref(frame);
            }

            poll_events[1].state = K_POLL_STATE_NOT_READY;
        }
    }
}

//**********************************************************
//* Public Function Definitions
//**********************************************************
```

## prj.conf
```kconfig
# Gantry, with a Stow server and a Stow client
CONFIG_GANTRY=y
CONFIG_GANTRY_MODULE=y
CONFIG_GANTRY_EVENTS=y
CONFIG_GANTRY_STOW=y
CONFIG_STOW_PROTOCOL=y
CONFIG_STOW_CLIENT=y
CONFIG_STOW_CLIENT_TIMEOUT_MS=1000
CONFIG_STOW_COBS_TRANSPORT=y
CONFIG_ZCBOR=y

# Every item is ephemeral
CONFIG_SETTINGS=y
CONFIG_SETTINGS_NONE=y

CONFIG_GANTRY_MEMORY=y
CONFIG_MEM_POOL_COUNT=3
CONFIG_MEM_POOL1_BLOCK_SIZE=16
CONFIG_MEM_POOL1_BLOCK_COUNT=64
CONFIG_MEM_POOL2_BLOCK_SIZE=128
CONFIG_MEM_POOL2_BLOCK_COUNT=32
CONFIG_MEM_POOL3_BLOCK_SIZE=512
CONFIG_MEM_POOL3_BLOCK_COUNT=8

# The link to the peer
CONFIG_SERIAL=y
CONFIG_UART_INTERRUPT_DRIVEN=y
CONFIG_RING_BUFFER=y
CONFIG_POLL=y

# A console with one parseable line per result or event
CONFIG_SHELL=y
CONFIG_SHELL_PROMPT_UART=""
CONFIG_SHELL_ECHO_STATUS=n
CONFIG_SHELL_VT100_COLORS=n
CONFIG_CBPRINTF_FP_SUPPORT=y
CONFIG_LOG=y
CONFIG_LOG_DEFAULT_LEVEL=2
```

## boards/native_sim_native_64.overlay
```dts
/ {
	chosen {
		gantry,peer-uart = &uart1;
	};
};

&uart1 {
	status = "okay";
};
```

## boards/nrf52840dk_nrf52840.overlay
```dts
/ {
	chosen {
		gantry,peer-uart = &uart1;
	};
};

&uart1 {
	status = "okay";
	current-speed = <115200>;
};
```

## inc/peer.h
```c
/*
 * Copyright (c) 2026 Demizo
 *
 * SPDX-License-Identifier: Apache-2.0
 */

/**
 * @file
 * @brief The link to the peer and the client endpoint for its Stow
 *
 * @author Demizo (demizodemazo@gmail.com)
 */

#pragma once

#include <gantry/stow/stow_client.h>

//**********************************************************
//* Typedefs, Enums, and Structs
//**********************************************************

/**
 * @brief Client endpoint for the peer's Stow, defined by each app
 */
extern const struct stow_client_endpoint peer_client;

//**********************************************************
//* Functions
//**********************************************************

/**
 * @brief The link came up; open its server session for the peer's client
 *
 * @return SUCCESS, or the transport's error
 */
int peer_link_up(void);

/**
 * @brief Open a client session to the peer's server over the link
 *
 * @details Call once the peer's side of the link is up too.
 *
 * @return SUCCESS, or the transport's error
 */
int peer_link_connect(void);

/**
 * @brief The link went down; close its client and server sessions
 */
void peer_link_down(void);
```

## src/peer_console.c
```c
/*
 * Copyright (c) 2026 Demizo
 *
 * SPDX-License-Identifier: Apache-2.0
 */

/**
 * @file
 * @brief A test console: drives the link, and observes and drives the peer's Stow and the local Stow
 *
 * @details Every result and client event is printed as one line starting with `@`, in the order the client reports
 * them. A request to the peer prints `@sent <n>`, then `@done <n> <err> [<item>=<value>]` once it completes. Items
 * are named on the command line, so they are looked up in the generated tables by name.
 *
 * @author Demizo (demizodemazo@gmail.com)
 */

#include <gantry/error.h>
#include <gantry/event.h>
#include <gantry/module.h>
#include <gantry/ownership.h>
#include <gantry/stow/stow.h>
#include <generated_stow_items.h>
#include <stdio.h>
#include <stdlib.h>
#include <string.h>
#include <zephyr/kernel.h>
#include <zephyr/logging/log.h>
#include <zephyr/shell/shell.h>
#include <zephyr/shell/shell_uart.h>
#include <zephyr/sys/atomic.h>

#include "peer.h"

LOG_MODULE_REGISTER(peer_console, LOG_LEVEL_INF);

//**********************************************************
//* Local Definitions
//**********************************************************

#define QUEUE_DEPTH 16U
#define VALUE_SIZE 48U
#define STACK_SIZE 2048U
#define PRIORITY 8

/**
 * @brief A client event for the console thread to print
 */
struct console_msg
{
    event_t* event;    /**< Update or result event, owned by the message, or NULL for a hook */
    uint32_t request;  /**< Request number of a result */
    bool disconnected; /**< Whether a hook was disconnected rather than connected */
    int err;           /**< Error of a connect */
};

//**********************************************************
//* Static Function Declarations
//**********************************************************

static const struct shell* console(void);
static void format_value(char* out, enum stow_item_type type, const union stow_constraints* c, data_value_t value);
static int parse_value(enum stow_item_type type, const union stow_constraints* c, char* text, data_value_t* out);
static int peer_item_id(const char* name);
static const struct stow_item_const_metadata* local_item(const char* name);
static struct stow_client_peer* take_peer(void);
static void post(const struct console_msg* msg);
static void post_event(event_t* event, uint32_t request);
static void print_peer_value(const char* prefix, const struct stow_client_value* value);
static void on_connected(struct stow_client_peer* peer, int err);
static void on_disconnected(struct stow_client_peer* peer);
static void on_update(event_t* event);
static void on_result(event_t* event, void* user_data);
static void peer_console_init(void);
static void peer_console_thread(void* arg1, void* arg2, void* arg3);
static int cmd_peer(const struct shell* sh, size_t argc, char** argv);
static int cmd_peer_connect(const struct shell* sh, size_t argc, char** argv);
static int cmd_link_up(const struct shell* sh, size_t argc, char** argv);
static int cmd_link_down(const struct shell* sh, size_t argc, char** argv);
static int cmd_local_get(const struct shell* sh, size_t argc, char** argv);
static int cmd_local_set(const struct shell* sh, size_t argc, char** argv);

//**********************************************************
//* Static Variable Definitions
//**********************************************************

K_MSGQ_DEFINE(console_queue, sizeof(struct console_msg), QUEUE_DEPTH, sizeof(void*));
K_MUTEX_DEFINE(peer_lock);

static struct stow_client_peer* connected_peer;
static atomic_t last_request;

STOW_CLIENT_CB_DEFINE(peer_console_hooks) = {
    .connected = on_connected,
    .disconnected = on_disconnected,
    .update = on_update,
};

GANTRY_MODULE_DEFINE(peer_console, peer_console_init, peer_console_thread, STACK_SIZE, PRIORITY);

//**********************************************************
//* Static Function Definitions
//**********************************************************

static const struct shell* console(void) { return shell_backend_uart_get_ptr(); }

/**
 * @brief Format an int, enum or string value of up to @ref VALUE_SIZE characters
 *
 * @param out Output buffer of @ref VALUE_SIZE
 * @param type Type of the item
 * @param c Constraints of the item, for enum names
 * @param value The value
 */
static void format_value(char* out, enum stow_item_type type, const union stow_constraints* c, data_value_t value)
{
    snprintf(out, VALUE_SIZE, "%d", value.data.int_value);
    if (type == STOW_ITEM_TYPE_STRING)
    {
        snprintf(out, VALUE_SIZE, "%s", value.data.string_value);
    }
    for (uint16_t i = 0; type == STOW_ITEM_TYPE_ENUM && i < c->enum_constraints.value_count; i++)
    {
        if (c->enum_constraints.values[i].value == value.data.int_value)
        {
            snprintf(out, VALUE_SIZE, "%s", c->enum_constraints.values[i].name);
        }
    }
}

/**
 * @brief Parse an int, enum or string value; a string points into @p text
 *
 * @param type Type of the item
 * @param c Constraints of the item, for enum names
 * @param text The text
 * @param out Parsed value
 *
 * @return SUCCESS, or -EINVAL for text that is not a value of @p type
 */
static int parse_value(enum stow_item_type type, const union stow_constraints* c, char* text, data_value_t* out)
{
    out->type = type;
    out->data.string_value = text;
    if (type == STOW_ITEM_TYPE_INT)
    {
        char* end = NULL;
        out->data.int_value = (int)strtol(text, &end, 0);
        return (end != text && *end == '\0') ? SUCCESS : -EINVAL;
    }
    for (uint16_t i = 0; type == STOW_ITEM_TYPE_ENUM && i < c->enum_constraints.value_count; i++)
    {
        if (strcmp(c->enum_constraints.values[i].name, text) == 0)
        {
            out->data.int_value = c->enum_constraints.values[i].value;
            return SUCCESS;
        }
    }
    return (type == STOW_ITEM_TYPE_STRING) ? SUCCESS : -EINVAL;
}

/**
 * @brief Look up a peer item by name
 *
 * @param name Item name
 *
 * @return the generated item ID, or -ENOENT
 */
static int peer_item_id(const char* name)
{
    for (uint16_t id = 0; id < peer_client.schema->item_count; id++)
    {
        if (strcmp(peer_client.schema->items[id].name, name) == 0)
        {
            return id;
        }
    }
    return -ENOENT;
}

/**
 * @brief Look up a local item by name
 *
 * @param name Item name
 *
 * @return the item's metadata, or NULL
 */
static const struct stow_item_const_metadata* local_item(const char* name)
{
    return stow_item_find(name, strlen(name));
}

/**
 * @brief Take a reference to the connected peer
 *
 * @return the peer, or NULL when none is connected
 *
 * @acquires stow_client_peer return
 */
static struct stow_client_peer* take_peer(void)
{
    struct stow_client_peer* peer = NULL;
    k_mutex_lock(&peer_lock, K_FOREVER);
    if (connected_peer != NULL)
    {
        peer = stow_client_peer_ref(connected_peer);
    }
    k_mutex_unlock(&peer_lock);
    return peer;
}

static void post(const struct console_msg* msg)
{
    if (k_msgq_put(&console_queue, msg, K_NO_WAIT) != 0)
    {
        LOG_WRN("Console queue full, event dropped");
    }
}

/**
 * @brief Queue a client event for the console thread, keeping a reference
 *
 * @param event Update or result event
 * @param request Request number of a result
 */
static void post_event(event_t* event, uint32_t request)
{
    EVENT_REF(event);
    const struct console_msg msg = { .event = event, .request = request };
    if (k_msgq_put(&console_queue, &msg, K_NO_WAIT) != 0)
    {
        LOG_WRN("Console queue full, event dropped");
        EVENT_UNREF(&event);
    }
    else
    {
        PASS_OWNERSHIP(event);
    }
}

/**
 * @brief Print a line with a peer value
 *
 * @param prefix Start of the line
 * @param value The value, or NULL for none
 */
static void print_peer_value(const char* prefix, const struct stow_client_value* value)
{
    if (value == NULL)
    {
        shell_print(console(), "%s", prefix);
        return;
    }
    const struct stow_client_item* item = &peer_client.schema->items[value->id];
    char text[VALUE_SIZE];
    format_value(text, item->type, &item->constraints, value->value);
    shell_print(console(), "%s %s=%s", prefix, item->name, text);
}

static void on_connected(struct stow_client_peer* peer, int err)
{
    if (err == SUCCESS)
    {
        k_mutex_lock(&peer_lock, K_FOREVER);
        stow_client_peer_unref(&connected_peer);
        connected_peer = stow_client_peer_ref(peer);
        PASS_OWNERSHIP(connected_peer);
        k_mutex_unlock(&peer_lock);
    }
    post(&(struct console_msg){ .err = err });
}

static void on_disconnected(struct stow_client_peer* peer)
{
    ARG_UNUSED(peer);
    k_mutex_lock(&peer_lock, K_FOREVER);
    stow_client_peer_unref(&connected_peer);
    k_mutex_unlock(&peer_lock);
    post(&(struct console_msg){ .disconnected = true });
}

static void on_update(event_t* event) { post_event(event, 0U); }

static void on_result(event_t* event, void* user_data) { post_event(event, (uint32_t)(uintptr_t)user_data); }

static void peer_console_init(void) {}

static void peer_console_thread(void* arg1, void* arg2, void* arg3)
{
    ARG_UNUSED(arg1);
    ARG_UNUSED(arg2);
    ARG_UNUSED(arg3);

    while (true)
    {
        struct console_msg msg;
        k_msgq_get(&console_queue, &msg, K_FOREVER);
        event_t* event = msg.event;
        if (event == NULL && msg.disconnected)
        {
            shell_print(console(), "@disconnected");
        }
        else if (event == NULL)
        {
            shell_print(console(), "@connected %d", msg.err);
        }
        else if (event->type == &stow_client_update_event)
        {
            const struct stow_client_update_payload* update = (const void*)event->data.buf;
            print_peer_value("@update", &update->value);
            EVENT_UNREF(&event);
        }
        else
        {
            const struct stow_client_result_payload* result = (const void*)event->data.buf;
            char prefix[32];
            snprintf(prefix, sizeof(prefix), "@done %u %d", msg.request, result->err);
            print_peer_value(prefix, (result->count > 0U) ? &result->values[0] : NULL);
            EVENT_UNREF(&event);
        }
    }
}

/**
 * @brief `peer get <item>` and `peer set <item> <value>`: an asynchronous request to the peer
 *
 * @param sh The shell
 * @param argc Argument count, the command name first
 * @param argv The command name, the item name, and for Set the value
 *
 * @return 0
 */
static int cmd_peer(const struct shell* sh, size_t argc, char** argv)
{
    uint32_t request = (uint32_t)atomic_inc(&last_request) + 1U;
    void* user_data = (void*)(uintptr_t)request;
    shell_print(sh, "@sent %u", request);

    int id = peer_item_id(argv[1]);
    int ret = (id < 0) ? id : SUCCESS;
    data_value_t value = { 0 };
    if (ret == SUCCESS && argc == 3U)
    {
        const struct stow_client_item* item = &peer_client.schema->items[id];
        ret = parse_value(item->type, &item->constraints, argv[2], &value);
    }
    struct stow_client_peer* peer = take_peer();
    if (ret == SUCCESS && peer == NULL)
    {
        ret = -ENOTCONN;
    }
    if (ret == SUCCESS)
    {
        ret = (argc == 3U) ? stow_client_set_one_async(peer, (uint16_t)id, value, on_result, user_data)
                           : stow_client_get_one_async(peer, (uint16_t)id, on_result, user_data);
    }
    stow_client_peer_unref(&peer);
    if (ret != SUCCESS)
    {
        shell_print(sh, "@done %u %d", request, ret);
    }
    return 0;
}

static int cmd_peer_connect(const struct shell* sh, size_t argc, char** argv)
{
    ARG_UNUSED(argc);
    ARG_UNUSED(argv);
    shell_print(sh, "@connect %d", peer_link_connect());
    return 0;
}

static int cmd_link_up(const struct shell* sh, size_t argc, char** argv)
{
    ARG_UNUSED(argc);
    ARG_UNUSED(argv);
    shell_print(sh, "@link up %d", peer_link_up());
    return 0;
}

static int cmd_link_down(const struct shell* sh, size_t argc, char** argv)
{
    ARG_UNUSED(argc);
    ARG_UNUSED(argv);
    peer_link_down();
    shell_print(sh, "@link down");
    return 0;
}

static int cmd_local_get(const struct shell* sh, size_t argc, char** argv)
{
    ARG_UNUSED(argc);
    const struct stow_item_const_metadata* item = local_item(argv[1]);
    if (item == NULL)
    {
        shell_print(sh, "@local %d", -ENOENT);
        return 0;
    }
    data_value_t value;
    int ret = stow_get(item->id, &value);
    if (ret != SUCCESS)
    {
        shell_print(sh, "@local %d", ret);
        return 0;
    }
    char text[VALUE_SIZE];
    format_value(text, item->type, &item->constraints, value);
    stow_release(item->id, &value);
    shell_print(sh, "@local 0 %s=%s", item->name, text);
    return 0;
}

static int cmd_local_set(const struct shell* sh, size_t argc, char** argv)
{
    ARG_UNUSED(argc);
    const struct stow_item_const_metadata* item = local_item(argv[1]);
    data_value_t value;
    int ret = (item != NULL) ? parse_value(item->type, &item->constraints, argv[2], &value) : -ENOENT;
    if (ret == SUCCESS)
    {
        ret = stow_set(item->id, value);
    }
    shell_print(sh, "@local %d", ret);
    return 0;
}

SHELL_STATIC_SUBCMD_SET_CREATE(
    link_cmds, SHELL_CMD(up, NULL, "The link came up", cmd_link_up),
    SHELL_CMD(down, NULL, "The link went down", cmd_link_down), SHELL_SUBCMD_SET_END);
SHELL_CMD_REGISTER(link, &link_cmds, "Link to the peer", NULL);

SHELL_STATIC_SUBCMD_SET_CREATE(
    peer_cmds, SHELL_CMD(connect, NULL, "Open a client session to the peer", cmd_peer_connect),
    SHELL_CMD_ARG(get, NULL, "Get an item: <item>", cmd_peer, 2, 0),
    SHELL_CMD_ARG(set, NULL, "Set an item: <item> <value>", cmd_peer, 3, 0), SHELL_SUBCMD_SET_END);
SHELL_CMD_REGISTER(peer, &peer_cmds, "The peer's Stow", NULL);

SHELL_STATIC_SUBCMD_SET_CREATE(
    local_cmds, SHELL_CMD_ARG(get, NULL, "Get an item: <item>", cmd_local_get, 2, 0),
    SHELL_CMD_ARG(set, NULL, "Set an item: <item> <value>", cmd_local_set, 3, 0), SHELL_SUBCMD_SET_END);
SHELL_CMD_REGISTER(local, &local_cmds, "This node's Stow", NULL);
```

## src/peer_link.c
```c
/*
 * Copyright (c) 2026 Demizo
 *
 * SPDX-License-Identifier: Apache-2.0
 */

/**
 * @file
 * @brief The UART link to the peer, carrying Stow in both directions over the raw COBS transport
 *
 * @author Demizo (demizodemazo@gmail.com)
 */

#include <gantry/error.h>
#include <gantry/module.h>
#include <gantry/stow/stow_cobs_transport.h>
#include <gantry/stow/stow_protocol.h>
#include <zephyr/drivers/uart.h>
#include <zephyr/kernel.h>
#include <zephyr/logging/log.h>
#include <zephyr/net_buf.h>
#include <zephyr/sys/ring_buffer.h>

#include "peer.h"

LOG_MODULE_REGISTER(peer_link, LOG_LEVEL_INF);

//**********************************************************
//* Local Definitions
//**********************************************************

#define MESSAGE_SIZE 512U
#define MESSAGE_COUNT 8U
#define FRAME_COUNT 8U
#define SESSION_ID 1U
#define RX_RING_SIZE 1024U
#define STACK_SIZE 2048U
#define PRIORITY 6

//**********************************************************
//* Static Function Declarations
//**********************************************************

static int queue_frame(struct net_buf* frame, void* user_data);
static void uart_isr(const struct device* dev, void* user_data);
static void peer_link_init(void);
static void peer_link_thread(void* arg1, void* arg2, void* arg3);

//**********************************************************
//* Static Variable Definitions
//**********************************************************

NET_BUF_POOL_DEFINE(message_pool, MESSAGE_COUNT, MESSAGE_SIZE, 0, NULL);
NET_BUF_POOL_DEFINE(frame_pool, FRAME_COUNT, COBS_ENCODE_MAX_SIZE(MESSAGE_SIZE), 0, NULL);
K_MSGQ_DEFINE(tx_queue, sizeof(struct net_buf*), FRAME_COUNT, sizeof(void*));
K_SEM_DEFINE(rx_sem, 0, 1);
RING_BUF_DECLARE(rx_ring, RX_RING_SIZE);

static const struct device* uart_dev = DEVICE_DT_GET(DT_CHOSEN(gantry_peer_uart));
static struct stow_cobs_transport link;

GANTRY_MODULE_DEFINE(peer_link, peer_link_init, peer_link_thread, STACK_SIZE, PRIORITY);

//**********************************************************
//* Static Function Definitions
//**********************************************************

/**
 * @brief Queue an encoded frame for the link thread to send
 *
 * @details Matches @ref stow_cobs_write_t.
 *
 * @param frame Encoded frame
 * @param user_data Unused
 *
 * @return SUCCESS when the frame was queued
 * @return -ENOBUFS when the queue is full
 */
static int queue_frame(struct net_buf* frame, void* user_data)
{
    ARG_UNUSED(user_data);
    return (k_msgq_put(&tx_queue, (const void*)&frame, K_NO_WAIT) == 0) ? SUCCESS : -ENOBUFS;
}

static void uart_isr(const struct device* dev, void* user_data)
{
    ARG_UNUSED(user_data);

    uint8_t data[64];
    int len;
    uart_irq_update(dev);
    while (uart_irq_rx_ready(dev) && (len = uart_fifo_read(dev, data, sizeof(data))) > 0)
    {
        if (ring_buf_put(&rx_ring, data, len) < (uint32_t)len)
        {
            LOG_WRN("Peer UART receive overflow");
        }
    }
    k_sem_give(&rx_sem);
}

static void peer_link_init(void)
{
    const struct stow_cobs_transport_config config = {
        .server = &stow_protocol_endpoint,
        .session_id = SESSION_ID,
        .roles = STOW_ROLE_ANY,
        .message_pool = &message_pool,
        .frame_pool = &frame_pool,
        .write = queue_frame,
        .user_data = NULL,
    };
    int ret = stow_cobs_transport_init(&link, &config);
    ASSERT(ret == SUCCESS, "Failed to initialize the peer link");

    ASSERT(device_is_ready(uart_dev), "Peer UART not ready");
    uart_irq_callback_user_data_set(uart_dev, uart_isr, NULL);
    uart_irq_rx_enable(uart_dev);
}

static void peer_link_thread(void* arg1, void* arg2, void* arg3)
{
    ARG_UNUSED(arg1);
    ARG_UNUSED(arg2);
    ARG_UNUSED(arg3);

    struct k_poll_event events[2] = {
        K_POLL_EVENT_STATIC_INITIALIZER(K_POLL_TYPE_SEM_AVAILABLE, K_POLL_MODE_NOTIFY_ONLY, &rx_sem, 0),
        K_POLL_EVENT_STATIC_INITIALIZER(K_POLL_TYPE_MSGQ_DATA_AVAILABLE, K_POLL_MODE_NOTIFY_ONLY, &tx_queue, 0),
    };

    while (true)
    {
        k_poll(events, ARRAY_SIZE(events), K_FOREVER);

        if (events[0].state == K_POLL_STATE_SEM_AVAILABLE)
        {
            k_sem_take(&rx_sem, K_NO_WAIT);
            uint8_t data[64];
            uint32_t len;
            while ((len = ring_buf_get(&rx_ring, data, sizeof(data))) > 0U)
            {
                int ret = stow_cobs_transport_feed(&link, data, len);
                if (ret != SUCCESS)
                {
                    LOG_WRN("Dropped received bytes: %d", ret);
                }
            }
            events[0].state = K_POLL_STATE_NOT_READY;
        }

        if (events[1].state == K_POLL_STATE_MSGQ_DATA_AVAILABLE)
        {
            struct net_buf* frame = NULL;
            while (k_msgq_get(&tx_queue, (void*)&frame, K_NO_WAIT) == 0)
            {
                for (size_t i = 0; i < frame->len; i++)
                {
                    uart_poll_out(uart_dev, frame->data[i]);
                }
                net_buf_unref(frame);
            }
            events[1].state = K_POLL_STATE_NOT_READY;
        }
    }
}

//**********************************************************
//* Public Function Definitions
//**********************************************************

int peer_link_up(void) { return stow_cobs_transport_open(&link); }

int peer_link_connect(void) { return stow_cobs_transport_open_client(&link, &peer_client.endpoint); }

void peer_link_down(void) { stow_cobs_transport_close(&link); }
```

## west.yml
```yaml
manifest:

  remotes:
    - name: zephyrproject-rtos
      url-base: https://github.com/zephyrproject-rtos

  projects:
    - name: zephyr
      remote: zephyrproject-rtos
      repo-path: zephyr
      revision: v4.4.0
      clone-depth: 1
      import:
        path-prefix: deps
        name-allowlist:
          - cmsis
          - cmsis_6
          - hal_nordic
          - mbedtls
          - segger
          - nrfxlib
          - trusted-firmware-m
          - zcbor

  self:
    path: .
```

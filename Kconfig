## Kconfig
```kconfig
menuconfig GANTRY
    bool "Gantry module"
    default n
    help
      Enable the Gantry module.

if GANTRY

rsource "config/Kconfig.analysis"

config GANTRY_BUILD_LIBRARY
    bool "Build Gantry sources as a Zephyr library"
    default y
    help
      When enabled, the module compiles its sources into a Zephyr library
      that is linked into the consumer app. Disable when an external build
      (e.g. the in-tree unit tests) wants to compile the sources directly.

config UNIT_TESTING
    bool "Enable unit testing build modifications"
    default n
    help
      Changes the firmware to unit testing mode (e.g. exposing some
      static functions publicly).

menuconfig GANTRY_FLAGS
    bool "Flags"
    default y
    help
      Enable runtime flag validation helpers.

if GANTRY_FLAGS
    rsource "config/Kconfig.flags"
endif

menuconfig GANTRY_MEMORY
    bool "Memory management"
    default y
    help
      Enable the reference-counted memory pool subsystem.

if GANTRY_MEMORY
    rsource "config/Kconfig.memory"
endif

menuconfig GANTRY_EVENTS
    bool "Events"
    default y
    help
      Enable the event/message-passing subsystem.

if GANTRY_EVENTS
    rsource "config/Kconfig.events"
endif

menuconfig GANTRY_STOW
    bool "Stow"
    default y
    select SETTINGS
    select FLASH
    select FLASH_MAP
    select NVS
    help
      Enable the Stow.

if GANTRY_STOW
    rsource "config/Kconfig.stow"
endif

menuconfig GANTRY_MODULE
    bool "Modules"
    default y
    help
      Enable composable application modules. A module declares its own init function and
      its own thread via GANTRY_MODULE_DEFINE, or GANTRY_LIBRARY_MODULE_DEFINE for a library
      module with init logic but no thread of its own. All registered modules are started
      automatically at boot, after Stow is initialized and before main is executed.

if GANTRY_MODULE
    rsource "config/Kconfig.module"
endif

menuconfig GANTRY_COBS_FRAMER
    bool "COBS framer"
    default n
    select NET_BUF
    help
      Enable the COBS framing module used to encode and decode COBS frames

if GANTRY_COBS_FRAMER
    rsource "config/Kconfig.cobs_framer"
endif

endif # GANTRY
```

## app/kconfig/Kconfig.datastore
```kconfig
config DATASTORE_LOG_LEVEL
    int "Datastore log level"
    default 3

config DATASTORE_TYPES_LOG_LEVEL
    int "Datastore type parsing log level"
    default 3
    
config DATASTORE_STORAGE_LOG_LEVEL
    int "Datastore storage backend log level"
    default 3

config DATASTORE_ITEM_STORAGE_SIZE_MAX
    int "The maximum encoded size in bytes for datastore items stored in persistent storage"
    default 1024
```

## app/kconfig/Kconfig.memory
```kconfig
config MEM_LOG_LEVEL
    int "Memory log level"
    default 3

config MEM_TRACE
    bool "Trace where memory is being managed"
    default y if DEBUG
    help
      Trace where memory is being allocated, referenced, and dereferenced

config MEM_POOL_COUNT
    int "Number of active memory pools"
    range 1 6
    default 3
    help
        The block size must increase for each subsequent memory pool

config MEM_POOL1_BLOCK_SIZE
    int "Pool 1 block size"
    default 16
config MEM_POOL1_BLOCK_COUNT
    int "Pool 1 block count"
    default 128

config MEM_POOL2_BLOCK_SIZE
    int "Pool 2 block size"
    depends on MEM_POOL_COUNT >= 2
    default 32
config MEM_POOL2_BLOCK_COUNT
    int "Pool 2 block count"
    depends on MEM_POOL_COUNT >= 2
    default 64

config MEM_POOL3_BLOCK_SIZE
    int "Pool 3 block size"
    depends on MEM_POOL_COUNT >= 3
    default 64
config MEM_POOL3_BLOCK_COUNT
    int "Pool 3 block count"
    depends on MEM_POOL_COUNT >= 3
    default 32

config MEM_POOL4_BLOCK_SIZE
    int "Pool 4 block size"
    depends on MEM_POOL_COUNT >= 4
    default 128
config MEM_POOL4_BLOCK_COUNT
    int "Pool 4 block count"
    depends on MEM_POOL_COUNT >= 4
    default 16

config MEM_POOL5_BLOCK_SIZE
    int "Pool 5 block size"
    depends on MEM_POOL_COUNT >= 5
    default 512
config MEM_POOL5_BLOCK_COUNT
    int "Pool 5 block count"
    depends on MEM_POOL_COUNT >= 5
    default 8

config MEM_POOL6_BLOCK_SIZE
    int "Pool 6 block size"
    depends on MEM_POOL_COUNT >= 6
    default 1024
config MEM_POOL6_BLOCK_COUNT
    int "Pool 6 block count"
    depends on MEM_POOL_COUNT >= 6
    default 4
```

## config/Kconfig.analysis
```kconfig
config GANTRY_ANALYSIS_CPPCHECK
    bool "Run cppcheck on application code"
    depends on GANTRY
    default n
    help
      Enable cppcheck static analysis on the consuming application's src/
      directory during the build.
```

## config/Kconfig.cobs_framer
```kconfig
config GANTRY_COBS_FRAMER_LOG_LEVEL
    int "COBS framer log level"
    default 3
```

## config/Kconfig.flags
```kconfig
config FLAGS_VALIDATION
    bool "Enable runtime flag validation"
    default y if DEBUG
    help
      Whenever a flag changes validate the flag rules to catch invalid states at runtime.
```

## config/Kconfig.stow
```kconfig
config STOW_LOG_LEVEL
    int "Stow log level"
    default 3

config STOW_TYPES_LOG_LEVEL
    int "Stow type parsing log level"
    default 3
    
config STOW_STORAGE_LOG_LEVEL
    int "Stow storage backend log level"
    default 3

config STOW_ITEM_STORAGE_SIZE_MAX
    int "The maximum encoded size in bytes for stow items stored in persistent storage"
    default 1024

config STOW_INIT_PRIORITY
    int "Stow SYS_INIT priority (POST_KERNEL level)"
    default 0
    help
      SYS_INIT priority, within the POST_KERNEL init level, at which stow_init() is run
      automatically at boot.

menuconfig STOW_PROTOCOL
    bool "Enable the Stow protocol module"
    default n
    select NET_BUF
    help
      Enables the Stow protocol thread and serde layer. The protocol
      orchestrates external sessions, mapping CBOR-encoded protocol
      messages to internal Stow API calls. Outgoing messages are
      produced as net_bufs so the consuming application can prepend
      headers and append footers without copying.

if STOW_PROTOCOL

config STOW_PROTOCOL_LOG_LEVEL
    int "Stow protocol log level"
    default 3

config STOW_SERDE_LOG_LEVEL
    int "Stow serde log level"
    default 3

config STOW_PROTOCOL_THREAD_STACK_SIZE
    int "Stow protocol thread stack size"
    default 4096

config STOW_PROTOCOL_THREAD_PRIORITY
    int "Stow protocol thread priority"
    default 7

config STOW_PROTOCOL_QUEUE_SIZE
    int "Stow protocol queue size"
    default 16

config STOW_PROTOCOL_MAX_SESSIONS
    int "Maximum concurrent Stow protocol sessions"
    default 4

config STOW_PROTOCOL_DESCRIBE_CHUNK_SIZE
    int "Maximum describe chunk size in bytes"
    default 512

config STOW_PROTOCOL_MULTI_MAX_ITEMS
    int "Maximum number of items per Multi-Get or Multi-Set request"
    default 10

endif # STOW_PROTOCOL
```

## config/Kconfig.stow_client
```kconfig
config STOW_CLIENT_LOG_LEVEL
    int "Stow client log level"
    default 3

config STOW_CLIENT_THREAD_STACK_SIZE
    int "Stow client thread stack size"
    default 2048

config STOW_CLIENT_THREAD_PRIORITY
    int "Stow client thread priority"
    default 7

config STOW_CLIENT_MAX_PEERS
    int "Maximum number of Stow client peers"
    range 1 255
    default 2
    help
      A closed peer still referenced by the app or by events counts
      against this limit.

config STOW_CLIENT_MAX_PENDING
    int "Maximum requests in flight per peer"
    range 1 24
    default 4

config STOW_CLIENT_TIMEOUT_MS
    int "Default Stow client request timeout, in milliseconds"
    default 5000
    help
      Counted from when the transport takes a request, so it must cover
      transfer and queueing time on the slowest expected link.
```

## config/Kconfig.stow_common
```kconfig
config GANTRY_STOW_TYPES
    bool
    select ZCBOR
    help
      Stow value codecs, shared by the local Stow and the Stow client.

config STOW_TYPES_LOG_LEVEL
    int "Stow type parsing log level"
    default 3
    depends on GANTRY_STOW_TYPES

config STOW_COBS_TRANSPORT
    bool "Raw COBS Stow transport"
    default n
    depends on STOW_PROTOCOL || STOW_CLIENT
    select GANTRY_COBS_FRAMER
    select COBS
    help
      An interim transport that carries Stow messages as COBS frames over a byte stream.
```

## kconfig/Kconfig.analysis
```kconfig
config ZDS_ANALYSIS_CPPCHECK
    bool "Run cppcheck on application code"
    depends on ZDS
    default n
    help
      Enable cppcheck static analysis on the consuming application's src/
      directory during the build.

config ZDS_ANALYSIS_CHECK_LIBRARY
    bool "Include ZDS library sources in static analysis"
    depends on ZDS
    default n
    help
      When enabled, cppcheck and the resource-leak checker also run over the
      ZDS library source tree. Enable during library development; leave off
      for normal application builds.
```

## kconfig/Kconfig.module
```kconfig
config GANTRY_MODULE_LOG_LEVEL
    int "Module log level"
    default 3

config GANTRY_MODULE_INIT_PRIORITY
    int "Module start SYS_INIT priority (APPLICATION level)"
    default 0
    help
      SYS_INIT priority, within the APPLICATION init level, at which all registered modules
      are started.
```

## kconfig/Kconfig.stow
```kconfig
config STOW_LOG_LEVEL
    int "Stow log level"
    default 3

config STOW_TYPES_LOG_LEVEL
    int "Stow type parsing log level"
    default 3
    
config STOW_STORAGE_LOG_LEVEL
    int "Stow storage backend log level"
    default 3

config STOW_ITEM_STORAGE_SIZE_MAX
    int "The maximum encoded size in bytes for stow items stored in persistent storage"
    default 1024
```

## samples/example_app/config/Kconfig.session
```kconfig
menu "Session"

config SESSION_MANAGER_LOG_LEVEL
    int "Session manager log level"
    default 3

config SESSION_MANAGER_MAX_MESSAGE_SIZE
    int "Maximum Stow message size (bytes)"
    default 1024


endmenu
```

## samples/example_app/config/Kconfig.uart
```kconfig
menu "UART"

config UART_INTERFACE_LOG_LEVEL
    int "UART interface log level"
    default 3

config UART_INTERFACE_STACK_SIZE
    int "UART interface thread stack size"
    default 2048

config UART_INTERFACE_THREAD_PRIORITY
    int "UART interface thread priority"
    default 6

config UART_INTERFACE_QUEUE_DEPTH
    int "UART interface thread queue depth"
    default 4

config UART_INTERFACE_RX_RING_BUF_SIZE
    int "UART interface RX ring buffer size (bytes)"
    default 1024


endmenu
```

## samples/example_app/kconfig/Kconfig.ble
```kconfig
menu "BLE"


menu "BLE Manager"

config BLE_MANAGER_LOG_LEVEL
    int "BLE manager log level"
    default 3

config BLE_MANAGER_STACK_SIZE
    int "BLE manager thread stack size"
    default 2048

config BLE_MANAGER_THREAD_PRIORITY
    int "BLE manager thread priority"
    default 7

config BLE_MANAGER_QUEUE_DEPTH
    int "BLE manager thread queue depth"
    default 4

endmenu


menu "BLE Interface"

config BLE_INTERFACE_LOG_LEVEL
    int "BLE interface log level"
    default 3

config BLE_INTERFACE_STACK_SIZE
    int "BLE interface thread stack size"
    default 2048

config BLE_INTERFACE_THREAD_PRIORITY
    int "BLE interface thread priority"
    default 6

config BLE_INTERFACE_QUEUE_DEPTH
    int "BLE interface message queue queue depth"
    default 8

config BLE_INTERFACE_RX_POOL_COUNT
    int "BLE interface RX net_buf pool count"
    default 8

config BLE_INTERFACE_RX_POOL_BUF_SIZE
    int "BLE interface RX net_buf size (bytes)"
    default 1024

endmenu

endmenu
```

## tests/cobs_framer/testcase.yaml
```yaml
common:
  extra_args: CONF_FILE='prj.conf;../test_prj.conf'
tests:
  cobs_framer.native:
    tags: unit_testing
    platform_allow: native_sim
```

## tests/datastore/testcase.yaml
```yaml
common:
  extra_args: CONF_FILE='prj.conf;../test_prj.conf'
tests:
  datastore.native:
    tags: unit_testing
    platform_allow: native_sim
```

## tests/stow/testcase.yaml
```yaml
common:
  extra_args: CONF_FILE='prj.conf;../test_prj.conf'
tests:
  stow.native:
    tags: unit_testing
    platform_allow: native_sim
```

## tests/stow_client/testcase.yaml
```yaml
common:
  extra_args: CONF_FILE='prj.conf;../test_prj.conf'
tests:
  stow_client.native:
    tags: unit_testing
    platform_allow: native_sim
  stow_client.release:
    tags: unit_testing
    platform_allow: native_sim
    build_only: true
    extra_configs:
      - CONFIG_ASSERT=n
      - CONFIG_COMPILER_WARNINGS_AS_ERRORS=y
```

## tests/stow_client_only/testcase.yaml
```yaml
tests:
  stow_client_only.native:
    tags: unit_testing
    platform_allow: native_sim
```

## tests/stow_msg/testcase.yaml
```yaml
common:
  extra_args: CONF_FILE='prj.conf;../test_prj.conf'
tests:
  stow_msg.native:
    tags: unit_testing
    platform_allow: native_sim
```

## tests/stow_protocol/testcase.yaml
```yaml
common:
  extra_args: CONF_FILE='prj.conf;../test_prj.conf'
tests:
  stow_protocol.native:
    tags: unit_testing
    platform_allow: native_sim
```

## tests/stow_runtime/testcase.yaml
```yaml
common:
  extra_args: CONF_FILE='prj.conf;../test_prj.conf'
tests:
  stow_runtime.native:
    tags: unit_testing
    platform_allow: native_sim
```

## tests/stow_storage/testcase.yaml
```yaml
common:
  extra_args: CONF_FILE='prj.conf;../test_prj.conf'
tests:
  stow_storage.native:
    tags: unit_testing
    platform_allow: native_sim
```

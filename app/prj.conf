## CMakeLists.txt
```
cmake_minimum_required(VERSION 3.13.1)

find_package(Zephyr REQUIRED HINTS ../zephyr)
project(app)

zephyr_cc_option(-Wfatal-errors)

find_program(UV_CMD NAMES uv)
if(UV_CMD)
    set(DATASTORE_YAML  ${CMAKE_CURRENT_SOURCE_DIR}/datastore.yaml)
    set(GENERATOR_DIR   ${CMAKE_CURRENT_SOURCE_DIR}/../tools/datastore)
    set(GENERATED_DIR   ${CMAKE_CURRENT_BINARY_DIR}/generated)
    set(GENERATED_H     ${GENERATED_DIR}/inc/datastore/generated_datastore_items.h)
    set(GENERATED_C     ${GENERATED_DIR}/src/datastore/generated_datastore_items.c)
    set(GENERATED_ENUMS_H ${GENERATED_DIR}/inc/datastore/generated_datastore_enums.h)
    set(GENERATED_ENUMS_C ${GENERATED_DIR}/src/datastore/generated_datastore_enums.c)

    set_property(DIRECTORY APPEND PROPERTY CMAKE_CONFIGURE_DEPENDS ${DATASTORE_YAML})

    file(MAKE_DIRECTORY ${GENERATED_DIR}/inc/datastore)
    file(MAKE_DIRECTORY ${GENERATED_DIR}/src/datastore)

    message(STATUS "Generating datastore items from datastore.yaml...")
    execute_process(
        COMMAND ${UV_CMD} run ${GENERATOR_DIR}/generate_datastore.py
                --yaml       ${DATASTORE_YAML}
                --output-dir ${GENERATED_DIR}
        WORKING_DIRECTORY ${CMAKE_CURRENT_SOURCE_DIR}/..
        RESULT_VARIABLE gen_result
    )

    if(NOT gen_result EQUAL 0)
        message(FATAL_ERROR "Datastore generation failed!")
    endif()

    file(GLOB GENERATED_STRUCT_SOURCES
        ${GENERATED_DIR}/src/datastore/generated_struct_*.c)

else()
    message(WARNING "uv not found: datastore items will not be regenerated automatically")
endif()

find_program(JUST_CMD NAMES just)
if(JUST_CMD)
    add_custom_target(
        code_format ALL

        COMMAND ${JUST_CMD}
            format
        
        WORKING_DIRECTORY ${CMAKE_CURRENT_SOURCE_DIR}
        COMMENT "Formatting code..."
        VERBATIM
    )
    add_dependencies(app code_format)
else()
    message(WARNING "just not found: code will not be formatted")
endif()


target_sources(app PRIVATE
    src/main.c
    src/string_utils.c
    src/memory.c
    src/event.c
    src/datastore/datastore.c
    src/datastore/datastore_describe.c
    src/datastore/datastore_event.c
    src/datastore/datastore_storage.c
    src/datastore/types/datastore_type_enum.c
    src/datastore/types/datastore_type_int.c
    src/datastore/types/datastore_type_float.c
    src/datastore/types/datastore_type_string.c
    src/datastore/types/datastore_type_byte_array.c
    src/datastore/types/datastore_type_buffer.c
    ${GENERATED_C}
    ${GENERATED_ENUMS_C}
    ${GENERATED_STRUCT_SOURCES}
)

target_include_directories(app PRIVATE 
    inc
    inc/datastore
    inc/datastore/types
    ${GENERATED_DIR}/inc/datastore
)

find_program(CPPCHECK_CMD NAMES cppcheck)
if(CPPCHECK_CMD)
    add_custom_target(
        static_analysis ALL

        COMMAND ${CPPCHECK_CMD}
            --quiet
            --inline-suppr
            --enable=warning,performance,portability
            --check-level=exhaustive
            --error-exitcode=1
            --inconclusive
            ${CMAKE_CURRENT_SOURCE_DIR}/src/
        
        WORKING_DIRECTORY ${CMAKE_CURRENT_SOURCE_DIR}
        COMMENT "Running cppcheck..."
        VERBATIM
    )
    add_dependencies(app static_analysis)
else()
    message(WARNING "cppcheck not found!")
endif()

find_program(SPATCH_CMD NAMES spatch)
if(SPATCH_CMD)
    add_custom_target(
        check_mem_leaks ALL

        COMMAND ${SPATCH_CMD}
            --sp-file "${CMAKE_CURRENT_SOURCE_DIR}/../tools/memory_analysis/generated_leak_check.cocci"
            --dir "${CMAKE_CURRENT_SOURCE_DIR}/src/"
            --no-includes
            --very-quiet
        
        WORKING_DIRECTORY ${CMAKE_CURRENT_SOURCE_DIR}
        COMMENT "Running memory leak check..."
        VERBATIM
    )
    add_dependencies(app check_mem_leaks)
else()
    message(WARNING "spatch not found!")
endif()

target_compile_options(app PRIVATE -Wall -Wextra)
```

## Kconfig
```
source "$ZEPHYR_BASE/Kconfig.zephyr"

menu "ZDS"

config MAIN_LOG_LEVEL
    int "Main log level"
    default 3


menu "Flags"

config FLAGS_VALIDATION
    bool "Enable runtime flag validation"
    default n if DEBUG
    help
      Whenever a flag changes validate the flag rules to catch invalid states at runtime.

endmenu


menu "Memory"

config MEM_LOG_LEVEL
    int "Memory log level"
    default 3

config MEM_SMALL_BLOCK_SIZE
    int "Small memory block size in bytes"
    default 128
    help
      Size in bytes for small memory blocks.

config MEM_SMALL_BLOCK_COUNT
    int "Number of small memory blocks"
    default 16
    help
      Number of blocks in the small pool.

config MEM_MEDIUM_BLOCK_SIZE
    int "Medium memory block size in bytes"
    default 512
    help
      Size in bytes for medium memory blocks.

config MEM_MEDIUM_BLOCK_COUNT
    int "Number of medium memory blocks"
    default 8
    help
      Number of blocks in the medium pool.

config MEM_LARGE_BLOCK_SIZE
    int "Large memory block size in bytes"
    default 1024
    help
      Size in bytes for large memory blocks.

config MEM_LARGE_BLOCK_COUNT
    int "Number of large memory blocks"
    default 12
    help
      Number of blocks in the large pool.

endmenu


endmenu
```

## west.yml
```
manifest:

  remotes:
    - name: zephyrproject-rtos
      url-base: https://github.com/zephyrproject-rtos

  projects:
    - name: zephyr
      remote: zephyrproject-rtos
      repo-path: zephyr
      revision: v4.4.0
      clone-depth: 1
      import:
        name-allowlist:
          - cmsis
          - cmsis_6
          - hal_nordic
          - mbedtls
          - segger
          - nrfxlib
          - trusted-firmware-m
          - zcbor
```

## prj.conf
```kconfig
CONFIG_DEBUG=y
CONFIG_GPIO=y
CONFIG_LOG=y
CONFIG_LOG_BUFFER_SIZE=2048
CONFIG_CBPRINTF_FP_SUPPORT=y

CONFIG_NO_OPTIMIZATIONS=n
CONFIG_SIZE_OPTIMIZATIONS=y

CONFIG_ZCBOR=y
```

## src/main.c
```c
#include <autoconf.h>
#include <zephyr/app_version.h>
#include <zephyr/kernel.h>
#include <zephyr/logging/log.h>

LOG_MODULE_REGISTER(main, CONFIG_MAIN_LOG_LEVEL);

//**********************************************************
//* Local Definitions
//**********************************************************

//**********************************************************
//* Local typedefs
//**********************************************************

//**********************************************************
//* Static Function Declarations
//**********************************************************

//**********************************************************
//* Static Variable Definitions
//**********************************************************

//**********************************************************
//* Static Function Definitions
//**********************************************************

//**********************************************************
//* Public Function Definitions
//**********************************************************

int main(void) {
  LOG_INF("Starting ZDS version %s", APP_VERSION_STRING);

  // Initialize modules

  // Spawn threads

  while (1) {
  }

  return 0;
}
```

## inc/buffer.h
```c
/**
 * @file buffer.h
 *
 * @brief Buffer data type
 *
 * @details Buffers are arbitrary pointers with a length field. They are used throughout the application when
 * dynamically sized variables are needed.
 *
 * @author Demizo (demizodemazo@gmail.com)
 * @version 0.1
 * @date 2026-03-05
 *
 * @copyright Copyright (c) 2026
 *
 */

#ifndef BUFFER_H
#define BUFFER_H

#include <stdint.h>

/**
 * @brief Buffer with length
 *
 * @details Used to store data of a variable length.
 *
 */
typedef struct
{
    uint16_t len; /**< Buffer length in bytes */
    void* buf;    /**< Pointer to buffer data */
} buffer_t;

#endif  // BUFFER_H
```

## inc/error.h
```c
#ifndef ERROR_H
#define ERROR_H

#include <zephyr/logging/log.h>
#include <zephyr/logging/log_ctrl.h>

//**********************************************************
//* Definitions
//**********************************************************

#define SUCCESS 0

#define ASSERT(test, ...)                                                      \
  if (!(test)) {                                                               \
    LOG_ERR("%s: %d", __FILE__, __LINE__);                                     \
    LOG_ERR(__VA_ARGS__);                                                      \
                                                                               \
    LOG_PANIC();                                                               \
    k_sys_fatal_error_handler(0, NULL);                                        \
  }

//**********************************************************
//* Typedefs, Enums, and Structs
//**********************************************************

//**********************************************************
//* Functions
//**********************************************************

#endif // ERROR_H
```

## inc/event.h
```c
/**
 * @file event.h
 *
 * @brief Events for interprocess communication
 *
 * @details Communication between threads is accomplished by passing events. There is a single event structure with a
 * type field to indicate event type. This ensures that all modules can communicate without needing to agree on
 * arbitrary event structures. Applications can define event types using @ref DEFINE_EVENT_TYPE.
 *
 * Events are pointers to reference counted memory blocks. Modules are responsible for
 * dereferencing events when finished. Modules may pass events to other modules via function calls, but it is the
 * receiving module's responsibility to reference count the event if it wishes to retain it.
 *
 * Events may be linked to other events. When an event is referenced or dereferenced all events in the chain have their
 * reference counts updated.
 *
 * @author Demizo (demizodemazo@gmail.com)
 * @version 0.1
 * @date 2026-03-01
 *
 * @copyright Copyright (c) 2026
 *
 */

#ifndef EVENT_H
#define EVENT_H

#include <stddef.h>
#include <zephyr/kernel.h>

#include "buffer.h"
#include "memory.h"

/**
 * @addtogroup data_management
 * @{
 */

//**********************************************************
//* Definitions
//**********************************************************

/**
 * @brief Declare a custom @ref event_type_t to be used by other modules. The event must be defined using @ref
 * DEFINE_EVENT_TYPE in the corresponding source file.
 */
#define DECLARE_EVENT_TYPE(_name) extern const event_type_t _name

/**
 * @brief Define an @ref event_type_t. Event IDs will automatically be checked for collisions.
 */
#define DEFINE_EVENT_TYPE(_id, _name, _on_free)              \
    const uint8_t CONCAT(__event_collision_check_, _id) = 0; \
    const event_type_t _name = {                             \
        .id = _id,                                           \
        .on_free = _on_free,                                 \
    };

//**********************************************************
//* Typedefs, Enums, and Structs
//**********************************************************

/**
 * @brief Forward declaration of universal event structure
 */
typedef struct event_t event_t;

/**
 * @brief Event direction
 */
typedef enum
{
    EVENT_DIRECTION_RX = 0, /**< Receive event */
    EVENT_DIRECTION_TX = 1, /**< Transmit event */
    EVENT_DIRECTION_IX = 2, /**< Internal event */
} event_direction_t;

/**
 * @brief Function called before an event is freed
 *
 * @param event The event being freed
 */
typedef void (*event_on_free_t)(event_t* event);

/**
 * @brief Event type
 *
 * @details Applications can define event types using @ref DEFINE_EVENT_TYPE. Event types may contain reference counted
 * memory in the payload. In this case @ref on_free should be defined to dereference the event payload when the event is
 * freed.
 */
typedef struct
{
    uint32_t id;             /**< Numeric ID representing the event type */
    event_on_free_t on_free; /**< Optional function to be called before the event is freed, can be NULL */
} event_type_t;

/**
 * @brief Universal event structure
 */
struct event_t
{
    event_t* next_event;         /**< Linked event */
    struct k_msgq* return_queue; /**< Optional return queue for responses */
    event_type_t* type;          /**< Event type */
    event_direction_t direction; /**< Event direction */
    buffer_t data;               /**< Event data buffer */
};

//**********************************************************
//* Functions
//**********************************************************

/**
 * @brief Allocate an event
 *
 * @details An event will be allocated based on the requested size.
 *
 * @note It is recommended that you always use the EVENT_ALLOC macro which calls this function with the debug
 * information filled in.
 *
 * @param[in] size The requested event buffer size in bytes
 * @param[in] direction The direction of the event
 * @param[in] type The type of the event
 * @param[out] event_ptr Pointer to be populated with the address of an event. This pointer must point to a NULL
 * pointer when this function is called. It is only populated when the allocation succeeds.
 *
 * @return result of @ref mem_alloc
 */
int event_alloc(size_t size, event_direction_t direction, event_type_t* type, event_t** event_ptr);

/**
 * @brief Convenience macro for @ref event_alloc with memory tracing
 */
#define EVENT_ALLOC(size, direction, format, event) TRACE_WRAP(event_alloc(size, direction, format, event))

/**
 * @brief Increment the reference count of an event and all linked events
 *
 * @note It is recommended that you always use the EVENT_REF macro which calls this function with the debug
 * information filled in.
 *
 * @param[in] event The event pointer to be reference counted
 *
 * @return result of @ref mem_ref
 */
int event_ref(event_t* event);

/**
 * @brief Convenience macro for @ref event_ref with memory tracing
 */
#define EVENT_REF(event) TRACE_WRAP(event_ref(event))

/**
 * @brief Dencrement the reference count of an event and all linked events
 *
 * @note It is recommended that you always use the EVENT_UNREF macro which calls this function with the debug
 * information filled in.
 *
 * @note If event_ptr already points to a NULL pointer, this function will assume that the event was already freed and
 * return SUCCESS.
 *
 * @param[in,out] event_ptr A pointer to the event pointer to be dereferenced. If the reference count reaches 0,
 * the event pointer will be set to NULL.
 *
 * @return result of @ref mem_unref
 */
int event_unref(event_t** event_ptr);

/**
 * @brief Convenience macro for @ref event_unref with memory tracing
 */
#define EVENT_UNREF(event) TRACE_WRAP(event_unref(event))

/**
 * @brief Initialize an event structure
 *
 * @details If there is a need to initialize an event in a pre-existing memory block, this helper can be used.
 *
 * @note The size is only the length of the event data buffer. When initializing in
 * a memory block ensure the size needed to hold the event header is taken into account.
 *
 * @param[in,out] event Pointer to the event structure to initialize
 * @param[in] size Size of the event buffer
 * @param[in] direction The direction of the event
 * @param[in] type The type of the event
 */
void event_init(event_t* event, size_t size, event_direction_t direction, event_type_t* type);

/**
 * @}
 */

#endif  // EVENT_H
```

## inc/flags.h
```c
#ifndef FLAGS_H
#define FLAGS_H

#include <zephyr/sys/atomic.h>

//**********************************************************
//* Definitions
//**********************************************************

#define NO_FLAG_RULES ;

// CONFIG_FLAGS_VALIDATION controls whether flag rules will be validated
// whenever flags change.
#ifdef CONFIG_FLAGS_VALIDATION

#define FLAGS_DEFINE(name, flags, rules)                                       \
  enum name##_flags{__DEBRACKET flags, name##_MAX};                            \
  ATOMIC_DEFINE(name, name##_MAX);                                             \
  static inline void name##_validate(void) {                                   \
    atomic_t *name_ptr = name;                                                 \
    (void)name_ptr;                                                            \
    rules                                                                      \
  }

#define _VALIDATE_FLAGS(name) name##_validate()

#define FLAG_REQUIRES(flag1, flag2)                                            \
  if (CHECK_FLAG(name_ptr, flag1) && !CHECK_FLAG(name_ptr, flag2)) {           \
    __ASSERT(false, "Flag Violation: %s requires %s", #flag1, #flag2);         \
  }

#define FLAG_EXCLUSIVE(flag1, flag2)                                           \
  if (CHECK_FLAG(name_ptr, flag1) && CHECK_FLAG(name_ptr, flag2)) {            \
    __ASSERT(false, "Flag Violation: %s and %s are mutually exclusive",        \
             #flag1, #flag2);                                                  \
  }

#else

#define FLAGS_DEFINE(name, flags, rules)                                       \
  enum name##_flags{__DEBRACKET flags, name##_MAX};                            \
  ATOMIC_DEFINE(name, name##_MAX);

#define _VALIDATE_FLAGS(name) ((void)0)
#define FLAG_REQUIRES(flag1, flag2)
#define FLAG_EXCLUSIVE(flag1, flag2)
#endif

#define SET_FLAG(name, flag)                                                   \
  atomic_set_bit(name, flag);                                                  \
  LOG_DBG("Set " #flag ": %lu", atomic_get(name));                             \
  _VALIDATE_FLAGS(name);

#define CLEAR_FLAG(name, flag)                                                 \
  atomic_clear_bit(name, flag);                                                \
  LOG_DBG("Cleared " #flag ": %lu", atomic_get(name));                         \
  _VALIDATE_FLAGS(name);

#define CHECK_FLAG(name, flag) atomic_test_bit(name, flag)

#endif // FLAGS_H
```

## inc/memory.h
```c
/**
 * @file memory.h
 *
 * @brief Provides the ability to allocate, reference, and dereference blocks of memory.
 *
 * @details Memory blocks are allocated from pools of fixed-size memory blocks (e.g. small, medium, large). The caller
 * can request a buffer size and the smallest available memory block will be returned. Memory blocks are reference
 * counted and start with a reference count of 1 when allocated. When unreferenced, the reference count is decremented.
 * Once the reference count is 0 the block is freed and can be reused.
 *
 * Each memory block has a header that stores a magic value (to identify the block as a valid memory block) and metadata
 * such as the reference count and function that originally allocated it (used for debugging). This header is only used
 * internally by the memory module. From the perspective of the caller, memory blocks are just void pointers. The header
 * metadata is stored at the start of each memory block, but the caller is given a pointer directly after the block
 * header.
 *
 * @author Demizo (demizodemazo@gmail.com)
 * @version 0.1
 * @date 2026-02-28
 *
 * @copyright Copyright (c) 2026
 *
 */

#ifndef MEMORY_H
#define MEMORY_H

#include <stddef.h>
#include <zephyr/kernel.h>

/**
 * @defgroup data_management Data Management
 *
 * @brief Data is shared by passing around reference counted events.
 *
 * @details For how memory is allocated, see @ref memory.h. For how events are used, see @ref event.h.
 *
 * @{
 */

//**********************************************************
//* Definitions
//**********************************************************

#ifdef CONFIG_MEM_TRACE
typedef struct
{
    const char* func;
    const char* file;
    int line;
} mem_trace_info_t;

extern volatile mem_trace_info_t g_current_mem_trace;

#define TRACE_WRAP(func_call)                                                     \
    ({                                                                            \
        mem_trace_info_t _prev;                                                   \
        unsigned int _key = irq_lock();                                           \
        _prev = g_current_mem_trace;                                              \
        g_current_mem_trace = (mem_trace_info_t){ __func__, __FILE__, __LINE__ }; \
        irq_unlock(_key);                                                         \
        __auto_type _ret = (func_call);                                           \
        _key = irq_lock();                                                        \
        g_current_mem_trace = _prev;                                              \
        irq_unlock(_key);                                                         \
        _ret;                                                                     \
    })

#define TRACE_WRAP_VOID(func_call)                                                \
    do                                                                            \
    {                                                                             \
        mem_trace_info_t _prev;                                                   \
        unsigned int _key = irq_lock();                                           \
        _prev = g_current_mem_trace;                                              \
        g_current_mem_trace = (mem_trace_info_t){ __func__, __FILE__, __LINE__ }; \
        irq_unlock(_key);                                                         \
        (func_call);                                                              \
        _key = irq_lock();                                                        \
        g_current_mem_trace = _prev;                                              \
        irq_unlock(_key);                                                         \
    } while (0)

#else

/**
 * @brief Call a function with the current location as the memory trace
 *
 * @details This macro sets and restores the trace in a threadsafe manner.
 * It can be used in ISR contexts. When tracing is disabled this wrapper has no effect.
 */
#define TRACE_WRAP(func_call) (func_call)

/**
 * @brief Call a function with the current location as the memory trace
 *
 * @details Variant of @ref TRACE_WRAP for functions that have no return value.
 */
#define TRACE_WRAP_VOID(func_call) (func_call)

#endif

//**********************************************************
//* Typedefs, Enums, and Structs
//**********************************************************

//**********************************************************
//* Functions
//**********************************************************

/**
 * @brief Allocate a block of memory
 *
 * @details The block will be allocated from a memory pool based on the requested size. The block will be provided from
 * the smallest possible memory pool capable of holding the requested size.
 *
 * @note It is recommended that you always use the MEM_ALLOC macro which calls this function with the debug information
 * filled in.
 *
 * @param[in] size The requested buffer size in bytes
 * @param[out] block_ptr Pointer to be populated with the address of memory block. This pointer must point to a NULL
 * pointer when this function is called. It is only populated when the allocation succeeds.
 *
 * @return SUCCESS when the allocation is successful.
 * @return -EINVAL the provided pointer was NULL, a size of 0 was requested, or the requested size was larger than the
 * maximum block size.
 * @return -ENOTEMPTY the block pointer was not pointing to a NULL pointer.
 * @return -ENOMEM No blocks were available that could fit the requested size.
 */
int mem_alloc(size_t size, void** block_ptr);

/**
 * @brief Convenience macro for @ref mem_alloc with memory tracing
 */
#define MEM_ALLOC(size, data) TRACE_WRAP(mem_alloc(size, data))

/**
 * @brief Increment the reference count of a memory block
 *
 * @note It is recommended that you always use the MEM_REF macro which calls this function with the debug
 * information filled in.
 *
 * @param[in] block The memory block pointer to be reference counted
 */
void mem_ref(void* block);

/**
 * @brief Convenience macro for @ref mem_ref with memory tracing
 */
#define MEM_REF(data) TRACE_WRAP_VOID(mem_ref(data))

/**
 * @brief Dencrement the reference count of a memory block
 *
 * @note It is recommended that you always use the MEM_UNREF macro which calls this function with the debug
 * information filled in.
 *
 * @note If block_ptr already points to a NULL pointer, this function will assume that the block was already freed and
 * do nothing.
 *
 * @param[in,out] block_ptr A pointer to the memory block pointer to be dereferenced. If the reference count reaches 0,
 * the block pointer will be set to NULL.
 */
void mem_unref(void** block_ptr);

/**
 * @brief Convenience macro for @ref mem_unref with memory tracing
 */
#define MEM_UNREF(data) TRACE_WRAP_VOID(mem_unref(data))

/**
 * @brief Get the current reference count for a memory block
 *
 * @param block The memory block to get the reference count of
 *
 * @return The current reference count of the provided memory block
 */
uint32_t mem_get_ref_count(void* block);

/**
 * @brief Get the number of active memory pools
 *
 * @return The number of configured memory pools
 */
uint8_t mem_get_pool_count(void);

/**
 * @brief Get the usage of a memory pool
 *
 * @param[in] pool_index The pool index (e.g. POOL1 = 0)
 * @param[out] used_out Number of currently allocated blocks
 * @param[out] total_out Total number of blocks in the pool
 *
 * @return SUCCESS on success
 * @return -EINVAL if pool_index is out of range or either output pointer is NULL
 */
int mem_get_pool_usage(uint8_t pool_index, uint32_t* used_out, uint32_t* total_out);

#ifdef CONFIG_MEM_WATERMARK
/**
 * @brief Callback type for pool watermark notifications
 *
 * @param pool_index The pool index that hit the watermark
 * @param percent The watermark percentage that was hit
 */
typedef void (*mem_watermark_cb_t)(uint8_t pool_index, uint8_t percent);

/**
 * @brief Register a watermark callback for a memory pool
 *
 * @details The callback is invoked the first time pool usage reaches or exceeds the given
 * percentage. It will not fire again unless mem_set_watermark is called again.
 *
 * @param[in] pool_index The pool index (e.g. POOL1 = 0)
 * @param[in] percent Usage percentage threshold (0-100)
 * @param[in] callback Function to call when the watermark is first reached
 *
 * @return SUCCESS on success
 * @return -EINVAL if pool_index is out of range, percent > 100, or callback is NULL
 */
int mem_set_watermark(uint8_t pool_index, uint8_t percent, mem_watermark_cb_t callback);
#endif

/**
 * @brief Indicates to static analysis that ownership over the memory will be the responsibility of the caller
 */
#define PASS_OWNERSHIP(data)

/**
 * @brief Indicates to static analysis that the memory was not allocated or referenced
 */
#define NOT_REFERENCED(data)

/**
 * @}
 */

#endif  // MEMORY_H
```

## inc/string_utils.h
```c
/**
 * @file string_utils.h
 *
 * @brief Provides safe alternatives to common string functions
 *
 * @author Demizo (demizodemazo@gmail.com)
 * @version 0.1
 * @date 2026-03-01
 *
 * @copyright Copyright (c) 2026
 *
 */

#ifndef STRING_UTILS_H
#define STRING_UTILS_H

#include <stddef.h>

/**
 * @brief Copy a NUL-terminated string into a sized buffer.
 *
 * @param dest   Where to copy the string to.
 * @param src    Where to copy the string from.
 * @param count  Size of destination buffer.
 *
 * @return Number of characters copied (excluding NUL)
 * @return -E2BIG if the destination buffer was too small.
 */
size_t strscpy(char* dest, const char* src, size_t count);

#endif  // STRING_UTILS_H
```

## src/event.c
```c
/**
 * @file event.c
 * @author Demizo (demizodemazo@gmail.com)
 * @brief Event implementation
 * @version 0.1
 * @date 2026-03-01
 *
 * @copyright Copyright (c) 2026
 *
 */

#include "event.h"

#include <string.h>
#include <zephyr/kernel.h>
#include <zephyr/logging/log.h>

#include "error.h"
#include "memory.h"

LOG_MODULE_REGISTER(event, CONFIG_EVENT_LOG_LEVEL);

//**********************************************************
//* Local Definitions
//**********************************************************

// The maximum depth of linked events
#define LINKED_EVENT_CHAIN_LEN_MAX 10

//**********************************************************
//* Static Function Declarations
//**********************************************************

//**********************************************************
//* Static Variable Definitions
//**********************************************************

//**********************************************************
//* Static Function Definitions
//**********************************************************

//**********************************************************
//* Public Function Definitions
//**********************************************************

int event_alloc(size_t size, event_direction_t direction, event_format_t format, event_t** event)
{
    int ret = SUCCESS;

    // Account for event header size in total size
    size_t total_size = sizeof(event_t) + size;
    void** event_block = (void**)event;
    ret = mem_alloc(total_size, event_block);
    if (ret)
    {
        LOG_ERR("Failed to allocate event: %d", ret);

        NOT_REFERENCED(event_block);
        return ret;
    }

    event_init(*event, size, direction, format);

    LOG_DBG("Event allocated: size: %zu, direction: %d, format: %d", size, direction, format);

    PASS_OWNERSHIP(event_block);
    return SUCCESS;
}

int event_ref(event_t* event)
{
    int ret = SUCCESS;
    event_t* current = NULL;

    // Iterate over linked events, incrementing the reference count
    current = event;
    while (current != NULL)
    {
        ret = mem_ref(current);
        if (ret)
        {
            LOG_ERR("Failed to reference event: %d", ret);

            NOT_REFERENCED(current);
            return ret;
        }

        current = current->next_event;
    }

    LOG_DBG("Incremented reference count for event");

    PASS_OWNERSHIP(current);
    return SUCCESS;
}

int event_unref(event_t** event)
{
    int ret = SUCCESS;
    event_t* current = NULL;
    event_t* next = NULL;
    int chain_length = 0;

    // Iterate over linked events, decrementing the reference count
    current = *event;
    while (current != NULL && (chain_length < LINKED_EVENT_CHAIN_LEN_MAX))
    {
        // Get the linked event first in case the block is freed
        next = current->next_event;

        void** current_block = (void**)&current;
        ret = mem_unref(current_block);
        if (ret)
        {
            LOG_ERR("Failed to dereference event: %d", ret);
            return ret;
        }

        current = next;

        chain_length++;
    }

    LOG_DBG("Decremented reference count for event");
    return SUCCESS;
}

void event_init(event_t* event, size_t size, event_direction_t direction, event_format_t format)
{
    event->next_event = NULL;
    event->return_queue = NULL;
    event->direction = direction;
    event->format = format;
    event->data.len = size;
}
```

## src/memory.c
```c
/**
 * @file manager.c
 * @author Demizo (demizodemazo@gmail.com)
 * @brief Memory module implementation
 * @version 0.1
 * @date 2026-02-28
 *
 * @copyright Copyright (c) 2026
 *
 */

#include "memory.h"

#include <autoconf.h>
#include <stdint.h>
#include <sys/errno.h>
#include <zephyr/logging/log.h>

#include "error.h"

LOG_MODULE_REGISTER(mem_mgr, CONFIG_MEM_LOG_LEVEL);

//**********************************************************
//* Local Definitions
//**********************************************************

//**********************************************************
//* Local typedefs
//**********************************************************

typedef struct
{
    struct k_mem_slab* slab;
    size_t block_size;
    size_t block_count;
} mem_pool_metadata_t;

typedef enum
{
    POOL_SMALL = 0,
    POOL_MEDIUM,
    POOL_LARGE,
    POOL_COUNT
} mem_pool_size_t;

// Header stored at the start of each memory block
typedef struct __attribute__((packed))
{
    uint8_t magic[8];      // Magic number for block validation
    mem_pool_size_t pool;  // Pool the block belongs to
    const char* func;      // Function name that allocated the block
    uint32_t ref_count;    // Reference count
} mem_block_header_t;

//**********************************************************
//* Static Function Declarations
//**********************************************************

static void* block_to_header(void* data);
static void* header_to_block(void* block);
static mem_block_header_t* validate_and_get_header(void* data);

//**********************************************************
//* Static Variable Definitions
//**********************************************************

static const uint8_t magic[8] = {'M', 'E', 'M', 'B', 'L', 'O', 'C', 'K'};

K_MEM_SLAB_DEFINE_STATIC(small_slab, CONFIG_MEM_SMALL_BLOCK_SIZE, CONFIG_MEM_SMALL_BLOCK_COUNT, sizeof(void*));
K_MEM_SLAB_DEFINE_STATIC(medium_slab, CONFIG_MEM_MEDIUM_BLOCK_SIZE, CONFIG_MEM_MEDIUM_BLOCK_COUNT, sizeof(void*));
K_MEM_SLAB_DEFINE_STATIC(large_slab, CONFIG_MEM_LARGE_BLOCK_SIZE, CONFIG_MEM_LARGE_BLOCK_COUNT, sizeof(void*));

static mem_pool_metadata_t mem_pools[POOL_COUNT] = {
    [POOL_SMALL] =
        {
            .slab = &small_slab,
            .block_size = CONFIG_MEM_SMALL_BLOCK_SIZE,
            .block_count = CONFIG_MEM_SMALL_BLOCK_COUNT,
        },
    [POOL_MEDIUM] =
        {
            .slab = &medium_slab,
            .block_size = CONFIG_MEM_MEDIUM_BLOCK_SIZE,
            .block_count = CONFIG_MEM_MEDIUM_BLOCK_COUNT,
        },
    [POOL_LARGE] =
        {
            .slab = &large_slab,
            .block_size = CONFIG_MEM_LARGE_BLOCK_SIZE,
            .block_count = CONFIG_MEM_LARGE_BLOCK_COUNT,
        },
};

//**********************************************************
//* Static Function Definitions
//**********************************************************

/**
 * @brief Convert a block pointer to a block header pointer
 *
 * @param block block pointer
 * @return header pointer for the provided block
 */
static void* block_to_header(void* block) { return (uint8_t*)block - sizeof(mem_block_header_t); }

/**
 * @brief Get block pointer from a block header pointer
 *
 * @param header pointer to a block header
 * @return block pointer for the provided header
 */
static void* header_to_block(void* header) { return (uint8_t*)header + sizeof(mem_block_header_t); }

/**
 * @brief Validate that the block pointer points to a valid memory block and return the header
 *
 * @param block block pointer
 * @return pointer to the block header if the block was valid, otherwise NULL
 */
static mem_block_header_t* validate_and_get_header(void* block)
{
    if (block == NULL) return NULL;

    mem_block_header_t* header = (mem_block_header_t*)block_to_header(block);

    // Check magic value
    if (memcmp(header->magic, magic, sizeof(magic)) != 0)
    {
        return NULL;
    }

    if (header->pool >= POOL_COUNT)
    {
        return NULL;
    }

    return header;
}

//**********************************************************
//* Public Function Definitions
//**********************************************************

int mem_alloc(size_t size, void** block_ptr, const char* func, const char* file, int line)
{
    int ret = SUCCESS;
    void* block = NULL;

    if (block_ptr == NULL)
    {
        LOG_ERR("NULL pointer provided");
        return -EINVAL;
    }

    if (*block_ptr != NULL)
    {
        LOG_ERR("Block pointer to populate is not NULL");
        return -ENOTEMPTY;
    }

    if (size == 0)
    {
        LOG_ERR("Requested an empty block");
        return -EINVAL;
    }

    // The total size must include room for the block header alongside the requested size
    size_t total_size = size + sizeof(mem_block_header_t);

    uint32_t key = irq_lock();

    // Find the smallest possible pool that can fit the requested size
    for (int i = 0; i < POOL_COUNT; i++)
    {
        mem_pool_metadata_t* pool = &mem_pools[i];
        if (total_size <= pool->block_size)
        {
            mem_pool_size_t pool_size = (mem_pool_size_t)i;
            uint32_t available_blocks = k_mem_slab_num_free_get(pool->slab);
            if (available_blocks == 0)
            {
                if (i == POOL_COUNT - 1)
                {
                    // No more pools to check
                    LOG_ERR("No memory blocks found for size %zu", size);
                    irq_unlock(key);
                    return -ENOMEM;
                }
                else
                {
                    // Check the next pool
                    continue;
                }
            }

            // Allocate block
            ret = k_mem_slab_alloc(pool->slab, &block, K_NO_WAIT);
            if (ret)
            {
                irq_unlock(key);
                LOG_WRN("Failed to allocate from pool %d: %d", pool_size, ret);
                return -ENOMEM;
            }

            // Initialize block
            mem_block_header_t* header = (mem_block_header_t*)block;
            memcpy(header->magic, magic, sizeof(magic));
            header->pool = pool_size;
            header->func = func;
            header->ref_count = 1;

            *block_ptr = header_to_block(block);

            LOG_DBG("Allocated %zu bytes from pool %d, block: %p, ([%s:%d]: %s)", size, pool_size, *block_ptr,
                    file ? file : "unknown", line, func ? func : "unknown");
            break;
        }
        else
        {
            if (i == POOL_COUNT - 1)
            {
                LOG_ERR("Requested size %zu exceeds the maximum block size", size);
                irq_unlock(key);
                return -EINVAL;
            }
        }
    }

    irq_unlock(key);

    return SUCCESS;
}

int mem_ref(void* block, const char* file, int line)
{
    if (block == NULL)
    {
        LOG_ERR("NULL pointer provided");
        return -EINVAL;
    }

    uint32_t key = irq_lock();

    mem_block_header_t* header = validate_and_get_header(block);
    if (header == NULL || header->ref_count == 0)
    {
        irq_unlock(key);
        LOG_ERR("Invalid memory block");
        return -EINVAL;
    }

    if (header->ref_count == UINT32_MAX)
    {
        irq_unlock(key);
        LOG_ERR("Max references reached");
        return -ENOMEM;
    }

    header->ref_count++;

    LOG_DBG("Referenced block %p (count: %d), allocated by %s ([%s:%d])", block, header->ref_count,
            header->func ? header->func : "unknown", file ? file : "unknown", line);

    irq_unlock(key);

    return SUCCESS;
}

int mem_unref(void** block_ptr, const char* file, int line)
{
    if (block_ptr == NULL)
    {
        LOG_ERR("NULL pointer provided");
        return -EINVAL;
    }

    if (*block_ptr == NULL)
    {
        // Assume that the data is already freed
        return SUCCESS;
    }

    uint32_t key = irq_lock();

    mem_block_header_t* header = validate_and_get_header(*block_ptr);
    if (header == NULL)
    {
        irq_unlock(key);
        LOG_ERR("Invalid memory block");
        return -EINVAL;
    }

    ASSERT(header->ref_count > 0, "Reference count of an allocated block was zero");
    header->ref_count--;

    if (header->ref_count == 0)
    {
        // Free the block when there are no more references
        mem_pool_metadata_t* pool = &mem_pools[header->pool];
        void* block_header = block_to_header(*block_ptr);

        k_mem_slab_free(pool->slab, block_header);
        LOG_DBG("Freed block %p, allocated by %s ([%s:%d])", *block_ptr, header->func ? header->func : "unknown",
                file ? file : "unknown", line);
        *block_ptr = NULL;
    }
    else
    {
        LOG_DBG("Dereferenced block %p (count: %d), allocated by %s ([%s:%d])", *block_ptr, header->ref_count,
                header->func ? header->func : "unknown", file ? file : "unknown", line);
    }

    irq_unlock(key);

    return SUCCESS;
}
```

## src/string_utils.c
```c
#include <stddef.h>
#include <sys/errno.h>

size_t strscpy(char* dest, const char* src, size_t count)
{
    size_t res = 0;

    if (count == 0)
    {
        return -E2BIG;
    }

    while (res < count)
    {
        dest[res] = src[res];
        if (dest[res] == '\0')
        {
            return res;
        }
        res++;
    }

    // If we reach here, we ran out of space.
    // Force null-termination at the very end of the buffer.
    dest[count - 1] = '\0';
    return -E2BIG;
}
```
